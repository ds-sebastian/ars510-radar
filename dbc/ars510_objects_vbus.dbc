VERSION "ARS510 reassembled object / shell records on a virtual bus (generated by tools/build_cabana_route.py)"

NS_ :

BS_:

BU_: RADAR XXX

BO_ 1805 ARS510_OBJ_13: 48 RADAR
 SG_ STATE_CODE : 0|2@1+ (1,0) [0|3] "raw" XXX
 SG_ SLOT_INDEX_CODE : 2|6@1+ (1,0) [0|63] "raw" XXX
 SG_ UNK_8_6 : 8|6@1+ (1,0) [0|63] "raw" XXX
 SG_ ONCOMING_FLAG : 14|1@1+ (1,0) [0|1] "" XXX
 SG_ UNK_15_1 : 15|1@1+ (1,0) [0|1] "raw" XXX
 SG_ SCORE_CODE : 16|8@1+ (1,0) [0|255] "raw" XXX
 SG_ AGE : 24|7@1+ (1,0) [0|126] "cycles" XXX
 SG_ CONST_31_1 : 31|1@1+ (1,0) [0|1] "raw" XXX
 SG_ DREL : 32|12@1+ (0.0625,-10) [-10|245.9375] "m" XXX
 SG_ YREL_LEFT : 44|12@1+ (0.015,-30.72) [-30.72|30.705] "m" XXX
 SG_ UNK_56_7 : 56|7@1+ (1,0) [0|127] "raw" XXX
 SG_ UNK_63_1 : 63|1@1+ (1,0) [0|1] "raw" XXX
 SG_ VLONG_OVER_GROUND : 64|10@1+ (0.15,-76.575) [-76.575|76.875] "m/s" XXX
 SG_ VLAT_OVER_GROUND_PROV : 74|10@1+ (0.15,-76.575) [-76.575|76.875] "m/s" XXX
 SG_ ALONG_LIKE_84 : 84|10@1+ (1,-511) [-511|512] "code" XXX
 SG_ CONST_94_2 : 94|2@1+ (1,0) [0|3] "raw" XXX
 SG_ UNK_96 : 96|10@1+ (1,0) [0|1023] "raw" XXX
 SG_ UNK_106_1 : 106|1@1+ (1,0) [0|1] "raw" XXX
 SG_ UNK_107_1 : 107|1@1+ (1,0) [0|1] "raw" XXX
 SG_ CONST_108_1 : 108|1@1+ (1,0) [0|1] "raw" XXX
 SG_ MOVE_STATE : 109|2@1+ (1,0) [0|3] "" XXX
 SG_ UNK_111_1 : 111|1@1+ (1,0) [0|1] "raw" XXX
 SG_ UNK_112_3 : 112|3@1+ (1,0) [0|7] "raw" XXX
 SG_ UNK_115_5 : 115|5@1+ (1,0) [0|31] "raw" XXX
 SG_ UNK_120_3 : 120|3@1+ (1,0) [0|7] "raw" XXX
 SG_ CONST_123_5 : 123|5@1+ (1,0) [0|31] "raw" XXX
 SG_ UNK_128_2 : 128|2@1+ (1,0) [0|3] "raw" XXX
 SG_ UNK_130_1 : 130|1@1+ (1,0) [0|1] "raw" XXX
 SG_ UNK_131_4 : 131|4@1+ (1,0) [0|15] "raw" XXX
 SG_ CONST_135_1 : 135|1@1+ (1,0) [0|1] "raw" XXX
 SG_ UNK_136_4 : 136|4@1+ (1,0) [0|15] "raw" XXX
 SG_ UNK_140_3 : 140|3@1+ (1,0) [0|7] "raw" XXX
 SG_ CONST_143_5 : 143|5@1+ (1,0) [0|31] "raw" XXX
 SG_ UNK_148_8 : 148|8@1+ (1,0) [0|255] "raw" XXX
 SG_ UNK_156_4 : 156|4@1+ (1,0) [0|15] "raw" XXX
 SG_ CONST_160_3 : 160|3@1+ (1,0) [0|7] "raw" XXX
 SG_ UNK_163_3 : 163|3@1+ (1,0) [0|7] "raw" XXX
 SG_ UNK_166_2 : 166|2@1+ (1,0) [0|3] "raw" XXX
 SG_ UNK_168_10 : 168|10@1+ (1,0) [0|1023] "raw" XXX
 SG_ CONST_178_3 : 178|3@1+ (1,0) [0|7] "raw" XXX
 SG_ UNK_181_1 : 181|1@1+ (1,0) [0|1] "raw" XXX
 SG_ UNK_182_1 : 182|1@1+ (1,0) [0|1] "raw" XXX
 SG_ UNK_183_7 : 183|7@1+ (1,0) [0|127] "raw" XXX
 SG_ UNK_190_10 : 190|10@1+ (1,0) [0|1023] "raw" XXX
 SG_ UNK_200_7 : 200|7@1+ (1,0) [0|127] "raw" XXX
 SG_ CONST_207_1 : 207|1@1+ (1,0) [0|1] "raw" XXX
 SG_ UNK_208_6 : 208|6@1+ (1,0) [0|63] "raw" XXX
 SG_ CONST_214_2 : 214|2@1+ (1,0) [0|3] "raw" XXX
 SG_ UNK_216_6 : 216|6@1+ (1,0) [0|63] "raw" XXX
 SG_ CONST_222_2 : 222|2@1+ (1,0) [0|3] "raw" XXX
 SG_ UNK_224_7 : 224|7@1+ (1,0) [0|127] "raw" XXX
 SG_ CONST_231_1 : 231|1@1+ (1,0) [0|1] "raw" XXX
 SG_ UNK_232_8 : 232|8@1+ (1,0) [0|255] "raw" XXX
 SG_ UNK_240_7 : 240|7@1+ (1,0) [0|127] "raw" XXX
 SG_ CONST_247_1 : 247|1@1+ (1,0) [0|1] "raw" XXX
 SG_ UNK_248_7 : 248|7@1+ (1,0) [0|127] "raw" XXX
 SG_ CONST_255_1 : 255|1@1+ (1,0) [0|1] "raw" XXX
 SG_ UNK_256_8 : 256|8@1+ (1,0) [0|255] "raw" XXX
 SG_ UNK_264_8 : 264|8@1+ (1,0) [0|255] "raw" XXX
 SG_ UNK_272_5 : 272|5@1+ (1,0) [0|31] "raw" XXX
 SG_ UNK_277_11 : 277|11@1+ (1,0) [0|2047] "raw" XXX

BO_ 1806 ARS510_OBJ_14: 48 RADAR
 SG_ STATE_CODE : 0|2@1+ (1,0) [0|3] "raw" XXX
 SG_ SLOT_INDEX_CODE : 2|6@1+ (1,0) [0|63] "raw" XXX
 SG_ UNK_8_6 : 8|6@1+ (1,0) [0|63] "raw" XXX
 SG_ ONCOMING_FLAG : 14|1@1+ (1,0) [0|1] "" XXX
 SG_ UNK_15_1 : 15|1@1+ (1,0) [0|1] "raw" XXX
 SG_ SCORE_CODE : 16|8@1+ (1,0) [0|255] "raw" XXX
 SG_ AGE : 24|7@1+ (1,0) [0|126] "cycles" XXX
 SG_ CONST_31_1 : 31|1@1+ (1,0) [0|1] "raw" XXX
 SG_ DREL : 32|12@1+ (0.0625,-10) [-10|245.9375] "m" XXX
 SG_ YREL_LEFT : 44|12@1+ (0.015,-30.72) [-30.72|30.705] "m" XXX
 SG_ UNK_56_7 : 56|7@1+ (1,0) [0|127] "raw" XXX
 SG_ UNK_63_1 : 63|1@1+ (1,0) [0|1] "raw" XXX
 SG_ VLONG_OVER_GROUND : 64|10@1+ (0.15,-76.575) [-76.575|76.875] "m/s" XXX
 SG_ VLAT_OVER_GROUND_PROV : 74|10@1+ (0.15,-76.575) [-76.575|76.875] "m/s" XXX
 SG_ ALONG_LIKE_84 : 84|10@1+ (1,-511) [-511|512] "code" XXX
 SG_ CONST_94_2 : 94|2@1+ (1,0) [0|3] "raw" XXX
 SG_ UNK_96 : 96|10@1+ (1,0) [0|1023] "raw" XXX
 SG_ UNK_106_1 : 106|1@1+ (1,0) [0|1] "raw" XXX
 SG_ UNK_107_1 : 107|1@1+ (1,0) [0|1] "raw" XXX
 SG_ CONST_108_1 : 108|1@1+ (1,0) [0|1] "raw" XXX
 SG_ MOVE_STATE : 109|2@1+ (1,0) [0|3] "" XXX
 SG_ UNK_111_1 : 111|1@1+ (1,0) [0|1] "raw" XXX
 SG_ UNK_112_3 : 112|3@1+ (1,0) [0|7] "raw" XXX
 SG_ UNK_115_5 : 115|5@1+ (1,0) [0|31] "raw" XXX
 SG_ UNK_120_3 : 120|3@1+ (1,0) [0|7] "raw" XXX
 SG_ CONST_123_5 : 123|5@1+ (1,0) [0|31] "raw" XXX
 SG_ UNK_128_2 : 128|2@1+ (1,0) [0|3] "raw" XXX
 SG_ UNK_130_1 : 130|1@1+ (1,0) [0|1] "raw" XXX
 SG_ UNK_131_4 : 131|4@1+ (1,0) [0|15] "raw" XXX
 SG_ CONST_135_1 : 135|1@1+ (1,0) [0|1] "raw" XXX
 SG_ UNK_136_4 : 136|4@1+ (1,0) [0|15] "raw" XXX
 SG_ UNK_140_3 : 140|3@1+ (1,0) [0|7] "raw" XXX
 SG_ CONST_143_5 : 143|5@1+ (1,0) [0|31] "raw" XXX
 SG_ UNK_148_8 : 148|8@1+ (1,0) [0|255] "raw" XXX
 SG_ UNK_156_4 : 156|4@1+ (1,0) [0|15] "raw" XXX
 SG_ CONST_160_3 : 160|3@1+ (1,0) [0|7] "raw" XXX
 SG_ UNK_163_3 : 163|3@1+ (1,0) [0|7] "raw" XXX
 SG_ UNK_166_2 : 166|2@1+ (1,0) [0|3] "raw" XXX
 SG_ UNK_168_10 : 168|10@1+ (1,0) [0|1023] "raw" XXX
 SG_ CONST_178_3 : 178|3@1+ (1,0) [0|7] "raw" XXX
 SG_ UNK_181_1 : 181|1@1+ (1,0) [0|1] "raw" XXX
 SG_ UNK_182_1 : 182|1@1+ (1,0) [0|1] "raw" XXX
 SG_ UNK_183_7 : 183|7@1+ (1,0) [0|127] "raw" XXX
 SG_ UNK_190_10 : 190|10@1+ (1,0) [0|1023] "raw" XXX
 SG_ UNK_200_7 : 200|7@1+ (1,0) [0|127] "raw" XXX
 SG_ CONST_207_1 : 207|1@1+ (1,0) [0|1] "raw" XXX
 SG_ UNK_208_6 : 208|6@1+ (1,0) [0|63] "raw" XXX
 SG_ CONST_214_2 : 214|2@1+ (1,0) [0|3] "raw" XXX
 SG_ UNK_216_6 : 216|6@1+ (1,0) [0|63] "raw" XXX
 SG_ CONST_222_2 : 222|2@1+ (1,0) [0|3] "raw" XXX
 SG_ UNK_224_7 : 224|7@1+ (1,0) [0|127] "raw" XXX
 SG_ CONST_231_1 : 231|1@1+ (1,0) [0|1] "raw" XXX
 SG_ UNK_232_8 : 232|8@1+ (1,0) [0|255] "raw" XXX
 SG_ UNK_240_7 : 240|7@1+ (1,0) [0|127] "raw" XXX
 SG_ CONST_247_1 : 247|1@1+ (1,0) [0|1] "raw" XXX
 SG_ UNK_248_7 : 248|7@1+ (1,0) [0|127] "raw" XXX
 SG_ CONST_255_1 : 255|1@1+ (1,0) [0|1] "raw" XXX
 SG_ UNK_256_8 : 256|8@1+ (1,0) [0|255] "raw" XXX
 SG_ UNK_264_8 : 264|8@1+ (1,0) [0|255] "raw" XXX
 SG_ UNK_272_5 : 272|5@1+ (1,0) [0|31] "raw" XXX
 SG_ UNK_277_11 : 277|11@1+ (1,0) [0|2047] "raw" XXX

BO_ 1807 ARS510_OBJ_15: 48 RADAR
 SG_ STATE_CODE : 0|2@1+ (1,0) [0|3] "raw" XXX
 SG_ SLOT_INDEX_CODE : 2|6@1+ (1,0) [0|63] "raw" XXX
 SG_ UNK_8_6 : 8|6@1+ (1,0) [0|63] "raw" XXX
 SG_ ONCOMING_FLAG : 14|1@1+ (1,0) [0|1] "" XXX
 SG_ UNK_15_1 : 15|1@1+ (1,0) [0|1] "raw" XXX
 SG_ SCORE_CODE : 16|8@1+ (1,0) [0|255] "raw" XXX
 SG_ AGE : 24|7@1+ (1,0) [0|126] "cycles" XXX
 SG_ CONST_31_1 : 31|1@1+ (1,0) [0|1] "raw" XXX
 SG_ DREL : 32|12@1+ (0.0625,-10) [-10|245.9375] "m" XXX
 SG_ YREL_LEFT : 44|12@1+ (0.015,-30.72) [-30.72|30.705] "m" XXX
 SG_ UNK_56_7 : 56|7@1+ (1,0) [0|127] "raw" XXX
 SG_ UNK_63_1 : 63|1@1+ (1,0) [0|1] "raw" XXX
 SG_ VLONG_OVER_GROUND : 64|10@1+ (0.15,-76.575) [-76.575|76.875] "m/s" XXX
 SG_ VLAT_OVER_GROUND_PROV : 74|10@1+ (0.15,-76.575) [-76.575|76.875] "m/s" XXX
 SG_ ALONG_LIKE_84 : 84|10@1+ (1,-511) [-511|512] "code" XXX
 SG_ CONST_94_2 : 94|2@1+ (1,0) [0|3] "raw" XXX
 SG_ UNK_96 : 96|10@1+ (1,0) [0|1023] "raw" XXX
 SG_ UNK_106_1 : 106|1@1+ (1,0) [0|1] "raw" XXX
 SG_ UNK_107_1 : 107|1@1+ (1,0) [0|1] "raw" XXX
 SG_ CONST_108_1 : 108|1@1+ (1,0) [0|1] "raw" XXX
 SG_ MOVE_STATE : 109|2@1+ (1,0) [0|3] "" XXX
 SG_ UNK_111_1 : 111|1@1+ (1,0) [0|1] "raw" XXX
 SG_ UNK_112_3 : 112|3@1+ (1,0) [0|7] "raw" XXX
 SG_ UNK_115_5 : 115|5@1+ (1,0) [0|31] "raw" XXX
 SG_ UNK_120_3 : 120|3@1+ (1,0) [0|7] "raw" XXX
 SG_ CONST_123_5 : 123|5@1+ (1,0) [0|31] "raw" XXX
 SG_ UNK_128_2 : 128|2@1+ (1,0) [0|3] "raw" XXX
 SG_ UNK_130_1 : 130|1@1+ (1,0) [0|1] "raw" XXX
 SG_ UNK_131_4 : 131|4@1+ (1,0) [0|15] "raw" XXX
 SG_ CONST_135_1 : 135|1@1+ (1,0) [0|1] "raw" XXX
 SG_ UNK_136_4 : 136|4@1+ (1,0) [0|15] "raw" XXX
 SG_ UNK_140_3 : 140|3@1+ (1,0) [0|7] "raw" XXX
 SG_ CONST_143_5 : 143|5@1+ (1,0) [0|31] "raw" XXX
 SG_ UNK_148_8 : 148|8@1+ (1,0) [0|255] "raw" XXX
 SG_ UNK_156_4 : 156|4@1+ (1,0) [0|15] "raw" XXX
 SG_ CONST_160_3 : 160|3@1+ (1,0) [0|7] "raw" XXX
 SG_ UNK_163_3 : 163|3@1+ (1,0) [0|7] "raw" XXX
 SG_ UNK_166_2 : 166|2@1+ (1,0) [0|3] "raw" XXX
 SG_ UNK_168_10 : 168|10@1+ (1,0) [0|1023] "raw" XXX
 SG_ CONST_178_3 : 178|3@1+ (1,0) [0|7] "raw" XXX
 SG_ UNK_181_1 : 181|1@1+ (1,0) [0|1] "raw" XXX
 SG_ UNK_182_1 : 182|1@1+ (1,0) [0|1] "raw" XXX
 SG_ UNK_183_7 : 183|7@1+ (1,0) [0|127] "raw" XXX
 SG_ UNK_190_10 : 190|10@1+ (1,0) [0|1023] "raw" XXX
 SG_ UNK_200_7 : 200|7@1+ (1,0) [0|127] "raw" XXX
 SG_ CONST_207_1 : 207|1@1+ (1,0) [0|1] "raw" XXX
 SG_ UNK_208_6 : 208|6@1+ (1,0) [0|63] "raw" XXX
 SG_ CONST_214_2 : 214|2@1+ (1,0) [0|3] "raw" XXX
 SG_ UNK_216_6 : 216|6@1+ (1,0) [0|63] "raw" XXX
 SG_ CONST_222_2 : 222|2@1+ (1,0) [0|3] "raw" XXX
 SG_ UNK_224_7 : 224|7@1+ (1,0) [0|127] "raw" XXX
 SG_ CONST_231_1 : 231|1@1+ (1,0) [0|1] "raw" XXX
 SG_ UNK_232_8 : 232|8@1+ (1,0) [0|255] "raw" XXX
 SG_ UNK_240_7 : 240|7@1+ (1,0) [0|127] "raw" XXX
 SG_ CONST_247_1 : 247|1@1+ (1,0) [0|1] "raw" XXX
 SG_ UNK_248_7 : 248|7@1+ (1,0) [0|127] "raw" XXX
 SG_ CONST_255_1 : 255|1@1+ (1,0) [0|1] "raw" XXX
 SG_ UNK_256_8 : 256|8@1+ (1,0) [0|255] "raw" XXX
 SG_ UNK_264_8 : 264|8@1+ (1,0) [0|255] "raw" XXX
 SG_ UNK_272_5 : 272|5@1+ (1,0) [0|31] "raw" XXX
 SG_ UNK_277_11 : 277|11@1+ (1,0) [0|2047] "raw" XXX

BO_ 1808 ARS510_OBJ_16: 48 RADAR
 SG_ STATE_CODE : 0|2@1+ (1,0) [0|3] "raw" XXX
 SG_ SLOT_INDEX_CODE : 2|6@1+ (1,0) [0|63] "raw" XXX
 SG_ UNK_8_6 : 8|6@1+ (1,0) [0|63] "raw" XXX
 SG_ ONCOMING_FLAG : 14|1@1+ (1,0) [0|1] "" XXX
 SG_ UNK_15_1 : 15|1@1+ (1,0) [0|1] "raw" XXX
 SG_ SCORE_CODE : 16|8@1+ (1,0) [0|255] "raw" XXX
 SG_ AGE : 24|7@1+ (1,0) [0|126] "cycles" XXX
 SG_ CONST_31_1 : 31|1@1+ (1,0) [0|1] "raw" XXX
 SG_ DREL : 32|12@1+ (0.0625,-10) [-10|245.9375] "m" XXX
 SG_ YREL_LEFT : 44|12@1+ (0.015,-30.72) [-30.72|30.705] "m" XXX
 SG_ UNK_56_7 : 56|7@1+ (1,0) [0|127] "raw" XXX
 SG_ UNK_63_1 : 63|1@1+ (1,0) [0|1] "raw" XXX
 SG_ VLONG_OVER_GROUND : 64|10@1+ (0.15,-76.575) [-76.575|76.875] "m/s" XXX
 SG_ VLAT_OVER_GROUND_PROV : 74|10@1+ (0.15,-76.575) [-76.575|76.875] "m/s" XXX
 SG_ ALONG_LIKE_84 : 84|10@1+ (1,-511) [-511|512] "code" XXX
 SG_ CONST_94_2 : 94|2@1+ (1,0) [0|3] "raw" XXX
 SG_ UNK_96 : 96|10@1+ (1,0) [0|1023] "raw" XXX
 SG_ UNK_106_1 : 106|1@1+ (1,0) [0|1] "raw" XXX
 SG_ UNK_107_1 : 107|1@1+ (1,0) [0|1] "raw" XXX
 SG_ CONST_108_1 : 108|1@1+ (1,0) [0|1] "raw" XXX
 SG_ MOVE_STATE : 109|2@1+ (1,0) [0|3] "" XXX
 SG_ UNK_111_1 : 111|1@1+ (1,0) [0|1] "raw" XXX
 SG_ UNK_112_3 : 112|3@1+ (1,0) [0|7] "raw" XXX
 SG_ UNK_115_5 : 115|5@1+ (1,0) [0|31] "raw" XXX
 SG_ UNK_120_3 : 120|3@1+ (1,0) [0|7] "raw" XXX
 SG_ CONST_123_5 : 123|5@1+ (1,0) [0|31] "raw" XXX
 SG_ UNK_128_2 : 128|2@1+ (1,0) [0|3] "raw" XXX
 SG_ UNK_130_1 : 130|1@1+ (1,0) [0|1] "raw" XXX
 SG_ UNK_131_4 : 131|4@1+ (1,0) [0|15] "raw" XXX
 SG_ CONST_135_1 : 135|1@1+ (1,0) [0|1] "raw" XXX
 SG_ UNK_136_4 : 136|4@1+ (1,0) [0|15] "raw" XXX
 SG_ UNK_140_3 : 140|3@1+ (1,0) [0|7] "raw" XXX
 SG_ CONST_143_5 : 143|5@1+ (1,0) [0|31] "raw" XXX
 SG_ UNK_148_8 : 148|8@1+ (1,0) [0|255] "raw" XXX
 SG_ UNK_156_4 : 156|4@1+ (1,0) [0|15] "raw" XXX
 SG_ CONST_160_3 : 160|3@1+ (1,0) [0|7] "raw" XXX
 SG_ UNK_163_3 : 163|3@1+ (1,0) [0|7] "raw" XXX
 SG_ UNK_166_2 : 166|2@1+ (1,0) [0|3] "raw" XXX
 SG_ UNK_168_10 : 168|10@1+ (1,0) [0|1023] "raw" XXX
 SG_ CONST_178_3 : 178|3@1+ (1,0) [0|7] "raw" XXX
 SG_ UNK_181_1 : 181|1@1+ (1,0) [0|1] "raw" XXX
 SG_ UNK_182_1 : 182|1@1+ (1,0) [0|1] "raw" XXX
 SG_ UNK_183_7 : 183|7@1+ (1,0) [0|127] "raw" XXX
 SG_ UNK_190_10 : 190|10@1+ (1,0) [0|1023] "raw" XXX
 SG_ UNK_200_7 : 200|7@1+ (1,0) [0|127] "raw" XXX
 SG_ CONST_207_1 : 207|1@1+ (1,0) [0|1] "raw" XXX
 SG_ UNK_208_6 : 208|6@1+ (1,0) [0|63] "raw" XXX
 SG_ CONST_214_2 : 214|2@1+ (1,0) [0|3] "raw" XXX
 SG_ UNK_216_6 : 216|6@1+ (1,0) [0|63] "raw" XXX
 SG_ CONST_222_2 : 222|2@1+ (1,0) [0|3] "raw" XXX
 SG_ UNK_224_7 : 224|7@1+ (1,0) [0|127] "raw" XXX
 SG_ CONST_231_1 : 231|1@1+ (1,0) [0|1] "raw" XXX
 SG_ UNK_232_8 : 232|8@1+ (1,0) [0|255] "raw" XXX
 SG_ UNK_240_7 : 240|7@1+ (1,0) [0|127] "raw" XXX
 SG_ CONST_247_1 : 247|1@1+ (1,0) [0|1] "raw" XXX
 SG_ UNK_248_7 : 248|7@1+ (1,0) [0|127] "raw" XXX
 SG_ CONST_255_1 : 255|1@1+ (1,0) [0|1] "raw" XXX
 SG_ UNK_256_8 : 256|8@1+ (1,0) [0|255] "raw" XXX
 SG_ UNK_264_8 : 264|8@1+ (1,0) [0|255] "raw" XXX
 SG_ UNK_272_5 : 272|5@1+ (1,0) [0|31] "raw" XXX
 SG_ UNK_277_11 : 277|11@1+ (1,0) [0|2047] "raw" XXX

BO_ 1809 ARS510_OBJ_17: 48 RADAR
 SG_ STATE_CODE : 0|2@1+ (1,0) [0|3] "raw" XXX
 SG_ SLOT_INDEX_CODE : 2|6@1+ (1,0) [0|63] "raw" XXX
 SG_ UNK_8_6 : 8|6@1+ (1,0) [0|63] "raw" XXX
 SG_ ONCOMING_FLAG : 14|1@1+ (1,0) [0|1] "" XXX
 SG_ UNK_15_1 : 15|1@1+ (1,0) [0|1] "raw" XXX
 SG_ SCORE_CODE : 16|8@1+ (1,0) [0|255] "raw" XXX
 SG_ AGE : 24|7@1+ (1,0) [0|126] "cycles" XXX
 SG_ CONST_31_1 : 31|1@1+ (1,0) [0|1] "raw" XXX
 SG_ DREL : 32|12@1+ (0.0625,-10) [-10|245.9375] "m" XXX
 SG_ YREL_LEFT : 44|12@1+ (0.015,-30.72) [-30.72|30.705] "m" XXX
 SG_ UNK_56_7 : 56|7@1+ (1,0) [0|127] "raw" XXX
 SG_ UNK_63_1 : 63|1@1+ (1,0) [0|1] "raw" XXX
 SG_ VLONG_OVER_GROUND : 64|10@1+ (0.15,-76.575) [-76.575|76.875] "m/s" XXX
 SG_ VLAT_OVER_GROUND_PROV : 74|10@1+ (0.15,-76.575) [-76.575|76.875] "m/s" XXX
 SG_ ALONG_LIKE_84 : 84|10@1+ (1,-511) [-511|512] "code" XXX
 SG_ CONST_94_2 : 94|2@1+ (1,0) [0|3] "raw" XXX
 SG_ UNK_96 : 96|10@1+ (1,0) [0|1023] "raw" XXX
 SG_ UNK_106_1 : 106|1@1+ (1,0) [0|1] "raw" XXX
 SG_ UNK_107_1 : 107|1@1+ (1,0) [0|1] "raw" XXX
 SG_ CONST_108_1 : 108|1@1+ (1,0) [0|1] "raw" XXX
 SG_ MOVE_STATE : 109|2@1+ (1,0) [0|3] "" XXX
 SG_ UNK_111_1 : 111|1@1+ (1,0) [0|1] "raw" XXX
 SG_ UNK_112_3 : 112|3@1+ (1,0) [0|7] "raw" XXX
 SG_ UNK_115_5 : 115|5@1+ (1,0) [0|31] "raw" XXX
 SG_ UNK_120_3 : 120|3@1+ (1,0) [0|7] "raw" XXX
 SG_ CONST_123_5 : 123|5@1+ (1,0) [0|31] "raw" XXX
 SG_ UNK_128_2 : 128|2@1+ (1,0) [0|3] "raw" XXX
 SG_ UNK_130_1 : 130|1@1+ (1,0) [0|1] "raw" XXX
 SG_ UNK_131_4 : 131|4@1+ (1,0) [0|15] "raw" XXX
 SG_ CONST_135_1 : 135|1@1+ (1,0) [0|1] "raw" XXX
 SG_ UNK_136_4 : 136|4@1+ (1,0) [0|15] "raw" XXX
 SG_ UNK_140_3 : 140|3@1+ (1,0) [0|7] "raw" XXX
 SG_ CONST_143_5 : 143|5@1+ (1,0) [0|31] "raw" XXX
 SG_ UNK_148_8 : 148|8@1+ (1,0) [0|255] "raw" XXX
 SG_ UNK_156_4 : 156|4@1+ (1,0) [0|15] "raw" XXX
 SG_ CONST_160_3 : 160|3@1+ (1,0) [0|7] "raw" XXX
 SG_ UNK_163_3 : 163|3@1+ (1,0) [0|7] "raw" XXX
 SG_ UNK_166_2 : 166|2@1+ (1,0) [0|3] "raw" XXX
 SG_ UNK_168_10 : 168|10@1+ (1,0) [0|1023] "raw" XXX
 SG_ CONST_178_3 : 178|3@1+ (1,0) [0|7] "raw" XXX
 SG_ UNK_181_1 : 181|1@1+ (1,0) [0|1] "raw" XXX
 SG_ UNK_182_1 : 182|1@1+ (1,0) [0|1] "raw" XXX
 SG_ UNK_183_7 : 183|7@1+ (1,0) [0|127] "raw" XXX
 SG_ UNK_190_10 : 190|10@1+ (1,0) [0|1023] "raw" XXX
 SG_ UNK_200_7 : 200|7@1+ (1,0) [0|127] "raw" XXX
 SG_ CONST_207_1 : 207|1@1+ (1,0) [0|1] "raw" XXX
 SG_ UNK_208_6 : 208|6@1+ (1,0) [0|63] "raw" XXX
 SG_ CONST_214_2 : 214|2@1+ (1,0) [0|3] "raw" XXX
 SG_ UNK_216_6 : 216|6@1+ (1,0) [0|63] "raw" XXX
 SG_ CONST_222_2 : 222|2@1+ (1,0) [0|3] "raw" XXX
 SG_ UNK_224_7 : 224|7@1+ (1,0) [0|127] "raw" XXX
 SG_ CONST_231_1 : 231|1@1+ (1,0) [0|1] "raw" XXX
 SG_ UNK_232_8 : 232|8@1+ (1,0) [0|255] "raw" XXX
 SG_ UNK_240_7 : 240|7@1+ (1,0) [0|127] "raw" XXX
 SG_ CONST_247_1 : 247|1@1+ (1,0) [0|1] "raw" XXX
 SG_ UNK_248_7 : 248|7@1+ (1,0) [0|127] "raw" XXX
 SG_ CONST_255_1 : 255|1@1+ (1,0) [0|1] "raw" XXX
 SG_ UNK_256_8 : 256|8@1+ (1,0) [0|255] "raw" XXX
 SG_ UNK_264_8 : 264|8@1+ (1,0) [0|255] "raw" XXX
 SG_ UNK_272_5 : 272|5@1+ (1,0) [0|31] "raw" XXX
 SG_ UNK_277_11 : 277|11@1+ (1,0) [0|2047] "raw" XXX

BO_ 1810 ARS510_OBJ_18: 48 RADAR
 SG_ STATE_CODE : 0|2@1+ (1,0) [0|3] "raw" XXX
 SG_ SLOT_INDEX_CODE : 2|6@1+ (1,0) [0|63] "raw" XXX
 SG_ UNK_8_6 : 8|6@1+ (1,0) [0|63] "raw" XXX
 SG_ ONCOMING_FLAG : 14|1@1+ (1,0) [0|1] "" XXX
 SG_ UNK_15_1 : 15|1@1+ (1,0) [0|1] "raw" XXX
 SG_ SCORE_CODE : 16|8@1+ (1,0) [0|255] "raw" XXX
 SG_ AGE : 24|7@1+ (1,0) [0|126] "cycles" XXX
 SG_ CONST_31_1 : 31|1@1+ (1,0) [0|1] "raw" XXX
 SG_ DREL : 32|12@1+ (0.0625,-10) [-10|245.9375] "m" XXX
 SG_ YREL_LEFT : 44|12@1+ (0.015,-30.72) [-30.72|30.705] "m" XXX
 SG_ UNK_56_7 : 56|7@1+ (1,0) [0|127] "raw" XXX
 SG_ UNK_63_1 : 63|1@1+ (1,0) [0|1] "raw" XXX
 SG_ VLONG_OVER_GROUND : 64|10@1+ (0.15,-76.575) [-76.575|76.875] "m/s" XXX
 SG_ VLAT_OVER_GROUND_PROV : 74|10@1+ (0.15,-76.575) [-76.575|76.875] "m/s" XXX
 SG_ ALONG_LIKE_84 : 84|10@1+ (1,-511) [-511|512] "code" XXX
 SG_ CONST_94_2 : 94|2@1+ (1,0) [0|3] "raw" XXX
 SG_ UNK_96 : 96|10@1+ (1,0) [0|1023] "raw" XXX
 SG_ UNK_106_1 : 106|1@1+ (1,0) [0|1] "raw" XXX
 SG_ UNK_107_1 : 107|1@1+ (1,0) [0|1] "raw" XXX
 SG_ CONST_108_1 : 108|1@1+ (1,0) [0|1] "raw" XXX
 SG_ MOVE_STATE : 109|2@1+ (1,0) [0|3] "" XXX
 SG_ UNK_111_1 : 111|1@1+ (1,0) [0|1] "raw" XXX
 SG_ UNK_112_3 : 112|3@1+ (1,0) [0|7] "raw" XXX
 SG_ UNK_115_5 : 115|5@1+ (1,0) [0|31] "raw" XXX
 SG_ UNK_120_3 : 120|3@1+ (1,0) [0|7] "raw" XXX
 SG_ CONST_123_5 : 123|5@1+ (1,0) [0|31] "raw" XXX
 SG_ UNK_128_2 : 128|2@1+ (1,0) [0|3] "raw" XXX
 SG_ UNK_130_1 : 130|1@1+ (1,0) [0|1] "raw" XXX
 SG_ UNK_131_4 : 131|4@1+ (1,0) [0|15] "raw" XXX
 SG_ CONST_135_1 : 135|1@1+ (1,0) [0|1] "raw" XXX
 SG_ UNK_136_4 : 136|4@1+ (1,0) [0|15] "raw" XXX
 SG_ UNK_140_3 : 140|3@1+ (1,0) [0|7] "raw" XXX
 SG_ CONST_143_5 : 143|5@1+ (1,0) [0|31] "raw" XXX
 SG_ UNK_148_8 : 148|8@1+ (1,0) [0|255] "raw" XXX
 SG_ UNK_156_4 : 156|4@1+ (1,0) [0|15] "raw" XXX
 SG_ CONST_160_3 : 160|3@1+ (1,0) [0|7] "raw" XXX
 SG_ UNK_163_3 : 163|3@1+ (1,0) [0|7] "raw" XXX
 SG_ UNK_166_2 : 166|2@1+ (1,0) [0|3] "raw" XXX
 SG_ UNK_168_10 : 168|10@1+ (1,0) [0|1023] "raw" XXX
 SG_ CONST_178_3 : 178|3@1+ (1,0) [0|7] "raw" XXX
 SG_ UNK_181_1 : 181|1@1+ (1,0) [0|1] "raw" XXX
 SG_ UNK_182_1 : 182|1@1+ (1,0) [0|1] "raw" XXX
 SG_ UNK_183_7 : 183|7@1+ (1,0) [0|127] "raw" XXX
 SG_ UNK_190_10 : 190|10@1+ (1,0) [0|1023] "raw" XXX
 SG_ UNK_200_7 : 200|7@1+ (1,0) [0|127] "raw" XXX
 SG_ CONST_207_1 : 207|1@1+ (1,0) [0|1] "raw" XXX
 SG_ UNK_208_6 : 208|6@1+ (1,0) [0|63] "raw" XXX
 SG_ CONST_214_2 : 214|2@1+ (1,0) [0|3] "raw" XXX
 SG_ UNK_216_6 : 216|6@1+ (1,0) [0|63] "raw" XXX
 SG_ CONST_222_2 : 222|2@1+ (1,0) [0|3] "raw" XXX
 SG_ UNK_224_7 : 224|7@1+ (1,0) [0|127] "raw" XXX
 SG_ CONST_231_1 : 231|1@1+ (1,0) [0|1] "raw" XXX
 SG_ UNK_232_8 : 232|8@1+ (1,0) [0|255] "raw" XXX
 SG_ UNK_240_7 : 240|7@1+ (1,0) [0|127] "raw" XXX
 SG_ CONST_247_1 : 247|1@1+ (1,0) [0|1] "raw" XXX
 SG_ UNK_248_7 : 248|7@1+ (1,0) [0|127] "raw" XXX
 SG_ CONST_255_1 : 255|1@1+ (1,0) [0|1] "raw" XXX
 SG_ UNK_256_8 : 256|8@1+ (1,0) [0|255] "raw" XXX
 SG_ UNK_264_8 : 264|8@1+ (1,0) [0|255] "raw" XXX
 SG_ UNK_272_5 : 272|5@1+ (1,0) [0|31] "raw" XXX
 SG_ UNK_277_11 : 277|11@1+ (1,0) [0|2047] "raw" XXX

BO_ 1811 ARS510_OBJ_19: 48 RADAR
 SG_ STATE_CODE : 0|2@1+ (1,0) [0|3] "raw" XXX
 SG_ SLOT_INDEX_CODE : 2|6@1+ (1,0) [0|63] "raw" XXX
 SG_ UNK_8_6 : 8|6@1+ (1,0) [0|63] "raw" XXX
 SG_ ONCOMING_FLAG : 14|1@1+ (1,0) [0|1] "" XXX
 SG_ UNK_15_1 : 15|1@1+ (1,0) [0|1] "raw" XXX
 SG_ SCORE_CODE : 16|8@1+ (1,0) [0|255] "raw" XXX
 SG_ AGE : 24|7@1+ (1,0) [0|126] "cycles" XXX
 SG_ CONST_31_1 : 31|1@1+ (1,0) [0|1] "raw" XXX
 SG_ DREL : 32|12@1+ (0.0625,-10) [-10|245.9375] "m" XXX
 SG_ YREL_LEFT : 44|12@1+ (0.015,-30.72) [-30.72|30.705] "m" XXX
 SG_ UNK_56_7 : 56|7@1+ (1,0) [0|127] "raw" XXX
 SG_ UNK_63_1 : 63|1@1+ (1,0) [0|1] "raw" XXX
 SG_ VLONG_OVER_GROUND : 64|10@1+ (0.15,-76.575) [-76.575|76.875] "m/s" XXX
 SG_ VLAT_OVER_GROUND_PROV : 74|10@1+ (0.15,-76.575) [-76.575|76.875] "m/s" XXX
 SG_ ALONG_LIKE_84 : 84|10@1+ (1,-511) [-511|512] "code" XXX
 SG_ CONST_94_2 : 94|2@1+ (1,0) [0|3] "raw" XXX
 SG_ UNK_96 : 96|10@1+ (1,0) [0|1023] "raw" XXX
 SG_ UNK_106_1 : 106|1@1+ (1,0) [0|1] "raw" XXX
 SG_ UNK_107_1 : 107|1@1+ (1,0) [0|1] "raw" XXX
 SG_ CONST_108_1 : 108|1@1+ (1,0) [0|1] "raw" XXX
 SG_ MOVE_STATE : 109|2@1+ (1,0) [0|3] "" XXX
 SG_ UNK_111_1 : 111|1@1+ (1,0) [0|1] "raw" XXX
 SG_ UNK_112_3 : 112|3@1+ (1,0) [0|7] "raw" XXX
 SG_ UNK_115_5 : 115|5@1+ (1,0) [0|31] "raw" XXX
 SG_ UNK_120_3 : 120|3@1+ (1,0) [0|7] "raw" XXX
 SG_ CONST_123_5 : 123|5@1+ (1,0) [0|31] "raw" XXX
 SG_ UNK_128_2 : 128|2@1+ (1,0) [0|3] "raw" XXX
 SG_ UNK_130_1 : 130|1@1+ (1,0) [0|1] "raw" XXX
 SG_ UNK_131_4 : 131|4@1+ (1,0) [0|15] "raw" XXX
 SG_ CONST_135_1 : 135|1@1+ (1,0) [0|1] "raw" XXX
 SG_ UNK_136_4 : 136|4@1+ (1,0) [0|15] "raw" XXX
 SG_ UNK_140_3 : 140|3@1+ (1,0) [0|7] "raw" XXX
 SG_ CONST_143_5 : 143|5@1+ (1,0) [0|31] "raw" XXX
 SG_ UNK_148_8 : 148|8@1+ (1,0) [0|255] "raw" XXX
 SG_ UNK_156_4 : 156|4@1+ (1,0) [0|15] "raw" XXX
 SG_ CONST_160_3 : 160|3@1+ (1,0) [0|7] "raw" XXX
 SG_ UNK_163_3 : 163|3@1+ (1,0) [0|7] "raw" XXX
 SG_ UNK_166_2 : 166|2@1+ (1,0) [0|3] "raw" XXX
 SG_ UNK_168_10 : 168|10@1+ (1,0) [0|1023] "raw" XXX
 SG_ CONST_178_3 : 178|3@1+ (1,0) [0|7] "raw" XXX
 SG_ UNK_181_1 : 181|1@1+ (1,0) [0|1] "raw" XXX
 SG_ UNK_182_1 : 182|1@1+ (1,0) [0|1] "raw" XXX
 SG_ UNK_183_7 : 183|7@1+ (1,0) [0|127] "raw" XXX
 SG_ UNK_190_10 : 190|10@1+ (1,0) [0|1023] "raw" XXX
 SG_ UNK_200_7 : 200|7@1+ (1,0) [0|127] "raw" XXX
 SG_ CONST_207_1 : 207|1@1+ (1,0) [0|1] "raw" XXX
 SG_ UNK_208_6 : 208|6@1+ (1,0) [0|63] "raw" XXX
 SG_ CONST_214_2 : 214|2@1+ (1,0) [0|3] "raw" XXX
 SG_ UNK_216_6 : 216|6@1+ (1,0) [0|63] "raw" XXX
 SG_ CONST_222_2 : 222|2@1+ (1,0) [0|3] "raw" XXX
 SG_ UNK_224_7 : 224|7@1+ (1,0) [0|127] "raw" XXX
 SG_ CONST_231_1 : 231|1@1+ (1,0) [0|1] "raw" XXX
 SG_ UNK_232_8 : 232|8@1+ (1,0) [0|255] "raw" XXX
 SG_ UNK_240_7 : 240|7@1+ (1,0) [0|127] "raw" XXX
 SG_ CONST_247_1 : 247|1@1+ (1,0) [0|1] "raw" XXX
 SG_ UNK_248_7 : 248|7@1+ (1,0) [0|127] "raw" XXX
 SG_ CONST_255_1 : 255|1@1+ (1,0) [0|1] "raw" XXX
 SG_ UNK_256_8 : 256|8@1+ (1,0) [0|255] "raw" XXX
 SG_ UNK_264_8 : 264|8@1+ (1,0) [0|255] "raw" XXX
 SG_ UNK_272_5 : 272|5@1+ (1,0) [0|31] "raw" XXX
 SG_ UNK_277_11 : 277|11@1+ (1,0) [0|2047] "raw" XXX

BO_ 1824 ARS510_OBJ_00_DERIVED: 16 XXX
 SG_ TRACK_ID_OP : 0|16@1+ (1,0) [0|65535] "" XXX
 SG_ TRACK_ID_RAW : 16|16@1+ (1,0) [0|65535] "" XXX
 SG_ PUBLISHED_OP : 32|1@1+ (1,0) [0|1] "" XXX
 SG_ SETTLED : 33|1@1+ (1,0) [0|1] "" XXX
 SG_ VREL_VALID : 34|1@1+ (1,0) [0|1] "" XXX
 SG_ DREL_FUSED_VALID : 35|1@1+ (1,0) [0|1] "" XXX
 SG_ VREL_KALMAN_VALID : 36|1@1+ (1,0) [0|1] "" XXX
 SG_ VREL : 40|16@1- (0.01,0) [-327.68|327.67] "m/s" XXX
 SG_ V_EGO_0xB4 : 56|16@1+ (0.01,0) [0|655.35] "m/s" XXX
 SG_ DREL_FUSED : 72|16@1+ (0.01,0) [0|655.35] "m" XXX
 SG_ VREL_KALMAN : 88|16@1- (0.01,0) [-327.68|327.67] "m/s" XXX

BO_ 1825 ARS510_OBJ_01_DERIVED: 16 XXX
 SG_ TRACK_ID_OP : 0|16@1+ (1,0) [0|65535] "" XXX
 SG_ TRACK_ID_RAW : 16|16@1+ (1,0) [0|65535] "" XXX
 SG_ PUBLISHED_OP : 32|1@1+ (1,0) [0|1] "" XXX
 SG_ SETTLED : 33|1@1+ (1,0) [0|1] "" XXX
 SG_ VREL_VALID : 34|1@1+ (1,0) [0|1] "" XXX
 SG_ DREL_FUSED_VALID : 35|1@1+ (1,0) [0|1] "" XXX
 SG_ VREL_KALMAN_VALID : 36|1@1+ (1,0) [0|1] "" XXX
 SG_ VREL : 40|16@1- (0.01,0) [-327.68|327.67] "m/s" XXX
 SG_ V_EGO_0xB4 : 56|16@1+ (0.01,0) [0|655.35] "m/s" XXX
 SG_ DREL_FUSED : 72|16@1+ (0.01,0) [0|655.35] "m" XXX
 SG_ VREL_KALMAN : 88|16@1- (0.01,0) [-327.68|327.67] "m/s" XXX

BO_ 1826 ARS510_OBJ_02_DERIVED: 16 XXX
 SG_ TRACK_ID_OP : 0|16@1+ (1,0) [0|65535] "" XXX
 SG_ TRACK_ID_RAW : 16|16@1+ (1,0) [0|65535] "" XXX
 SG_ PUBLISHED_OP : 32|1@1+ (1,0) [0|1] "" XXX
 SG_ SETTLED : 33|1@1+ (1,0) [0|1] "" XXX
 SG_ VREL_VALID : 34|1@1+ (1,0) [0|1] "" XXX
 SG_ DREL_FUSED_VALID : 35|1@1+ (1,0) [0|1] "" XXX
 SG_ VREL_KALMAN_VALID : 36|1@1+ (1,0) [0|1] "" XXX
 SG_ VREL : 40|16@1- (0.01,0) [-327.68|327.67] "m/s" XXX
 SG_ V_EGO_0xB4 : 56|16@1+ (0.01,0) [0|655.35] "m/s" XXX
 SG_ DREL_FUSED : 72|16@1+ (0.01,0) [0|655.35] "m" XXX
 SG_ VREL_KALMAN : 88|16@1- (0.01,0) [-327.68|327.67] "m/s" XXX

BO_ 1827 ARS510_OBJ_03_DERIVED: 16 XXX
 SG_ TRACK_ID_OP : 0|16@1+ (1,0) [0|65535] "" XXX
 SG_ TRACK_ID_RAW : 16|16@1+ (1,0) [0|65535] "" XXX
 SG_ PUBLISHED_OP : 32|1@1+ (1,0) [0|1] "" XXX
 SG_ SETTLED : 33|1@1+ (1,0) [0|1] "" XXX
 SG_ VREL_VALID : 34|1@1+ (1,0) [0|1] "" XXX
 SG_ DREL_FUSED_VALID : 35|1@1+ (1,0) [0|1] "" XXX
 SG_ VREL_KALMAN_VALID : 36|1@1+ (1,0) [0|1] "" XXX
 SG_ VREL : 40|16@1- (0.01,0) [-327.68|327.67] "m/s" XXX
 SG_ V_EGO_0xB4 : 56|16@1+ (0.01,0) [0|655.35] "m/s" XXX
 SG_ DREL_FUSED : 72|16@1+ (0.01,0) [0|655.35] "m" XXX
 SG_ VREL_KALMAN : 88|16@1- (0.01,0) [-327.68|327.67] "m/s" XXX

BO_ 1828 ARS510_OBJ_04_DERIVED: 16 XXX
 SG_ TRACK_ID_OP : 0|16@1+ (1,0) [0|65535] "" XXX
 SG_ TRACK_ID_RAW : 16|16@1+ (1,0) [0|65535] "" XXX
 SG_ PUBLISHED_OP : 32|1@1+ (1,0) [0|1] "" XXX
 SG_ SETTLED : 33|1@1+ (1,0) [0|1] "" XXX
 SG_ VREL_VALID : 34|1@1+ (1,0) [0|1] "" XXX
 SG_ DREL_FUSED_VALID : 35|1@1+ (1,0) [0|1] "" XXX
 SG_ VREL_KALMAN_VALID : 36|1@1+ (1,0) [0|1] "" XXX
 SG_ VREL : 40|16@1- (0.01,0) [-327.68|327.67] "m/s" XXX
 SG_ V_EGO_0xB4 : 56|16@1+ (0.01,0) [0|655.35] "m/s" XXX
 SG_ DREL_FUSED : 72|16@1+ (0.01,0) [0|655.35] "m" XXX
 SG_ VREL_KALMAN : 88|16@1- (0.01,0) [-327.68|327.67] "m/s" XXX

BO_ 1829 ARS510_OBJ_05_DERIVED: 16 XXX
 SG_ TRACK_ID_OP : 0|16@1+ (1,0) [0|65535] "" XXX
 SG_ TRACK_ID_RAW : 16|16@1+ (1,0) [0|65535] "" XXX
 SG_ PUBLISHED_OP : 32|1@1+ (1,0) [0|1] "" XXX
 SG_ SETTLED : 33|1@1+ (1,0) [0|1] "" XXX
 SG_ VREL_VALID : 34|1@1+ (1,0) [0|1] "" XXX
 SG_ DREL_FUSED_VALID : 35|1@1+ (1,0) [0|1] "" XXX
 SG_ VREL_KALMAN_VALID : 36|1@1+ (1,0) [0|1] "" XXX
 SG_ VREL : 40|16@1- (0.01,0) [-327.68|327.67] "m/s" XXX
 SG_ V_EGO_0xB4 : 56|16@1+ (0.01,0) [0|655.35] "m/s" XXX
 SG_ DREL_FUSED : 72|16@1+ (0.01,0) [0|655.35] "m" XXX
 SG_ VREL_KALMAN : 88|16@1- (0.01,0) [-327.68|327.67] "m/s" XXX

BO_ 1830 ARS510_OBJ_06_DERIVED: 16 XXX
 SG_ TRACK_ID_OP : 0|16@1+ (1,0) [0|65535] "" XXX
 SG_ TRACK_ID_RAW : 16|16@1+ (1,0) [0|65535] "" XXX
 SG_ PUBLISHED_OP : 32|1@1+ (1,0) [0|1] "" XXX
 SG_ SETTLED : 33|1@1+ (1,0) [0|1] "" XXX
 SG_ VREL_VALID : 34|1@1+ (1,0) [0|1] "" XXX
 SG_ DREL_FUSED_VALID : 35|1@1+ (1,0) [0|1] "" XXX
 SG_ VREL_KALMAN_VALID : 36|1@1+ (1,0) [0|1] "" XXX
 SG_ VREL : 40|16@1- (0.01,0) [-327.68|327.67] "m/s" XXX
 SG_ V_EGO_0xB4 : 56|16@1+ (0.01,0) [0|655.35] "m/s" XXX
 SG_ DREL_FUSED : 72|16@1+ (0.01,0) [0|655.35] "m" XXX
 SG_ VREL_KALMAN : 88|16@1- (0.01,0) [-327.68|327.67] "m/s" XXX

BO_ 1831 ARS510_OBJ_07_DERIVED: 16 XXX
 SG_ TRACK_ID_OP : 0|16@1+ (1,0) [0|65535] "" XXX
 SG_ TRACK_ID_RAW : 16|16@1+ (1,0) [0|65535] "" XXX
 SG_ PUBLISHED_OP : 32|1@1+ (1,0) [0|1] "" XXX
 SG_ SETTLED : 33|1@1+ (1,0) [0|1] "" XXX
 SG_ VREL_VALID : 34|1@1+ (1,0) [0|1] "" XXX
 SG_ DREL_FUSED_VALID : 35|1@1+ (1,0) [0|1] "" XXX
 SG_ VREL_KALMAN_VALID : 36|1@1+ (1,0) [0|1] "" XXX
 SG_ VREL : 40|16@1- (0.01,0) [-327.68|327.67] "m/s" XXX
 SG_ V_EGO_0xB4 : 56|16@1+ (0.01,0) [0|655.35] "m/s" XXX
 SG_ DREL_FUSED : 72|16@1+ (0.01,0) [0|655.35] "m" XXX
 SG_ VREL_KALMAN : 88|16@1- (0.01,0) [-327.68|327.67] "m/s" XXX

BO_ 1832 ARS510_OBJ_08_DERIVED: 16 XXX
 SG_ TRACK_ID_OP : 0|16@1+ (1,0) [0|65535] "" XXX
 SG_ TRACK_ID_RAW : 16|16@1+ (1,0) [0|65535] "" XXX
 SG_ PUBLISHED_OP : 32|1@1+ (1,0) [0|1] "" XXX
 SG_ SETTLED : 33|1@1+ (1,0) [0|1] "" XXX
 SG_ VREL_VALID : 34|1@1+ (1,0) [0|1] "" XXX
 SG_ DREL_FUSED_VALID : 35|1@1+ (1,0) [0|1] "" XXX
 SG_ VREL_KALMAN_VALID : 36|1@1+ (1,0) [0|1] "" XXX
 SG_ VREL : 40|16@1- (0.01,0) [-327.68|327.67] "m/s" XXX
 SG_ V_EGO_0xB4 : 56|16@1+ (0.01,0) [0|655.35] "m/s" XXX
 SG_ DREL_FUSED : 72|16@1+ (0.01,0) [0|655.35] "m" XXX
 SG_ VREL_KALMAN : 88|16@1- (0.01,0) [-327.68|327.67] "m/s" XXX

BO_ 1833 ARS510_OBJ_09_DERIVED: 16 XXX
 SG_ TRACK_ID_OP : 0|16@1+ (1,0) [0|65535] "" XXX
 SG_ TRACK_ID_RAW : 16|16@1+ (1,0) [0|65535] "" XXX
 SG_ PUBLISHED_OP : 32|1@1+ (1,0) [0|1] "" XXX
 SG_ SETTLED : 33|1@1+ (1,0) [0|1] "" XXX
 SG_ VREL_VALID : 34|1@1+ (1,0) [0|1] "" XXX
 SG_ DREL_FUSED_VALID : 35|1@1+ (1,0) [0|1] "" XXX
 SG_ VREL_KALMAN_VALID : 36|1@1+ (1,0) [0|1] "" XXX
 SG_ VREL : 40|16@1- (0.01,0) [-327.68|327.67] "m/s" XXX
 SG_ V_EGO_0xB4 : 56|16@1+ (0.01,0) [0|655.35] "m/s" XXX
 SG_ DREL_FUSED : 72|16@1+ (0.01,0) [0|655.35] "m" XXX
 SG_ VREL_KALMAN : 88|16@1- (0.01,0) [-327.68|327.67] "m/s" XXX

BO_ 1834 ARS510_OBJ_10_DERIVED: 16 XXX
 SG_ TRACK_ID_OP : 0|16@1+ (1,0) [0|65535] "" XXX
 SG_ TRACK_ID_RAW : 16|16@1+ (1,0) [0|65535] "" XXX
 SG_ PUBLISHED_OP : 32|1@1+ (1,0) [0|1] "" XXX
 SG_ SETTLED : 33|1@1+ (1,0) [0|1] "" XXX
 SG_ VREL_VALID : 34|1@1+ (1,0) [0|1] "" XXX
 SG_ DREL_FUSED_VALID : 35|1@1+ (1,0) [0|1] "" XXX
 SG_ VREL_KALMAN_VALID : 36|1@1+ (1,0) [0|1] "" XXX
 SG_ VREL : 40|16@1- (0.01,0) [-327.68|327.67] "m/s" XXX
 SG_ V_EGO_0xB4 : 56|16@1+ (0.01,0) [0|655.35] "m/s" XXX
 SG_ DREL_FUSED : 72|16@1+ (0.01,0) [0|655.35] "m" XXX
 SG_ VREL_KALMAN : 88|16@1- (0.01,0) [-327.68|327.67] "m/s" XXX

BO_ 1835 ARS510_OBJ_11_DERIVED: 16 XXX
 SG_ TRACK_ID_OP : 0|16@1+ (1,0) [0|65535] "" XXX
 SG_ TRACK_ID_RAW : 16|16@1+ (1,0) [0|65535] "" XXX
 SG_ PUBLISHED_OP : 32|1@1+ (1,0) [0|1] "" XXX
 SG_ SETTLED : 33|1@1+ (1,0) [0|1] "" XXX
 SG_ VREL_VALID : 34|1@1+ (1,0) [0|1] "" XXX
 SG_ DREL_FUSED_VALID : 35|1@1+ (1,0) [0|1] "" XXX
 SG_ VREL_KALMAN_VALID : 36|1@1+ (1,0) [0|1] "" XXX
 SG_ VREL : 40|16@1- (0.01,0) [-327.68|327.67] "m/s" XXX
 SG_ V_EGO_0xB4 : 56|16@1+ (0.01,0) [0|655.35] "m/s" XXX
 SG_ DREL_FUSED : 72|16@1+ (0.01,0) [0|655.35] "m" XXX
 SG_ VREL_KALMAN : 88|16@1- (0.01,0) [-327.68|327.67] "m/s" XXX

BO_ 1836 ARS510_OBJ_12_DERIVED: 16 XXX
 SG_ TRACK_ID_OP : 0|16@1+ (1,0) [0|65535] "" XXX
 SG_ TRACK_ID_RAW : 16|16@1+ (1,0) [0|65535] "" XXX
 SG_ PUBLISHED_OP : 32|1@1+ (1,0) [0|1] "" XXX
 SG_ SETTLED : 33|1@1+ (1,0) [0|1] "" XXX
 SG_ VREL_VALID : 34|1@1+ (1,0) [0|1] "" XXX
 SG_ DREL_FUSED_VALID : 35|1@1+ (1,0) [0|1] "" XXX
 SG_ VREL_KALMAN_VALID : 36|1@1+ (1,0) [0|1] "" XXX
 SG_ VREL : 40|16@1- (0.01,0) [-327.68|327.67] "m/s" XXX
 SG_ V_EGO_0xB4 : 56|16@1+ (0.01,0) [0|655.35] "m/s" XXX
 SG_ DREL_FUSED : 72|16@1+ (0.01,0) [0|655.35] "m" XXX
 SG_ VREL_KALMAN : 88|16@1- (0.01,0) [-327.68|327.67] "m/s" XXX

BO_ 1837 ARS510_OBJ_13_DERIVED: 16 XXX
 SG_ TRACK_ID_OP : 0|16@1+ (1,0) [0|65535] "" XXX
 SG_ TRACK_ID_RAW : 16|16@1+ (1,0) [0|65535] "" XXX
 SG_ PUBLISHED_OP : 32|1@1+ (1,0) [0|1] "" XXX
 SG_ SETTLED : 33|1@1+ (1,0) [0|1] "" XXX
 SG_ VREL_VALID : 34|1@1+ (1,0) [0|1] "" XXX
 SG_ DREL_FUSED_VALID : 35|1@1+ (1,0) [0|1] "" XXX
 SG_ VREL_KALMAN_VALID : 36|1@1+ (1,0) [0|1] "" XXX
 SG_ VREL : 40|16@1- (0.01,0) [-327.68|327.67] "m/s" XXX
 SG_ V_EGO_0xB4 : 56|16@1+ (0.01,0) [0|655.35] "m/s" XXX
 SG_ DREL_FUSED : 72|16@1+ (0.01,0) [0|655.35] "m" XXX
 SG_ VREL_KALMAN : 88|16@1- (0.01,0) [-327.68|327.67] "m/s" XXX

BO_ 1838 ARS510_OBJ_14_DERIVED: 16 XXX
 SG_ TRACK_ID_OP : 0|16@1+ (1,0) [0|65535] "" XXX
 SG_ TRACK_ID_RAW : 16|16@1+ (1,0) [0|65535] "" XXX
 SG_ PUBLISHED_OP : 32|1@1+ (1,0) [0|1] "" XXX
 SG_ SETTLED : 33|1@1+ (1,0) [0|1] "" XXX
 SG_ VREL_VALID : 34|1@1+ (1,0) [0|1] "" XXX
 SG_ DREL_FUSED_VALID : 35|1@1+ (1,0) [0|1] "" XXX
 SG_ VREL_KALMAN_VALID : 36|1@1+ (1,0) [0|1] "" XXX
 SG_ VREL : 40|16@1- (0.01,0) [-327.68|327.67] "m/s" XXX
 SG_ V_EGO_0xB4 : 56|16@1+ (0.01,0) [0|655.35] "m/s" XXX
 SG_ DREL_FUSED : 72|16@1+ (0.01,0) [0|655.35] "m" XXX
 SG_ VREL_KALMAN : 88|16@1- (0.01,0) [-327.68|327.67] "m/s" XXX

BO_ 1839 ARS510_OBJ_15_DERIVED: 16 XXX
 SG_ TRACK_ID_OP : 0|16@1+ (1,0) [0|65535] "" XXX
 SG_ TRACK_ID_RAW : 16|16@1+ (1,0) [0|65535] "" XXX
 SG_ PUBLISHED_OP : 32|1@1+ (1,0) [0|1] "" XXX
 SG_ SETTLED : 33|1@1+ (1,0) [0|1] "" XXX
 SG_ VREL_VALID : 34|1@1+ (1,0) [0|1] "" XXX
 SG_ DREL_FUSED_VALID : 35|1@1+ (1,0) [0|1] "" XXX
 SG_ VREL_KALMAN_VALID : 36|1@1+ (1,0) [0|1] "" XXX
 SG_ VREL : 40|16@1- (0.01,0) [-327.68|327.67] "m/s" XXX
 SG_ V_EGO_0xB4 : 56|16@1+ (0.01,0) [0|655.35] "m/s" XXX
 SG_ DREL_FUSED : 72|16@1+ (0.01,0) [0|655.35] "m" XXX
 SG_ VREL_KALMAN : 88|16@1- (0.01,0) [-327.68|327.67] "m/s" XXX

BO_ 1840 ARS510_OBJ_16_DERIVED: 16 XXX
 SG_ TRACK_ID_OP : 0|16@1+ (1,0) [0|65535] "" XXX
 SG_ TRACK_ID_RAW : 16|16@1+ (1,0) [0|65535] "" XXX
 SG_ PUBLISHED_OP : 32|1@1+ (1,0) [0|1] "" XXX
 SG_ SETTLED : 33|1@1+ (1,0) [0|1] "" XXX
 SG_ VREL_VALID : 34|1@1+ (1,0) [0|1] "" XXX
 SG_ DREL_FUSED_VALID : 35|1@1+ (1,0) [0|1] "" XXX
 SG_ VREL_KALMAN_VALID : 36|1@1+ (1,0) [0|1] "" XXX
 SG_ VREL : 40|16@1- (0.01,0) [-327.68|327.67] "m/s" XXX
 SG_ V_EGO_0xB4 : 56|16@1+ (0.01,0) [0|655.35] "m/s" XXX
 SG_ DREL_FUSED : 72|16@1+ (0.01,0) [0|655.35] "m" XXX
 SG_ VREL_KALMAN : 88|16@1- (0.01,0) [-327.68|327.67] "m/s" XXX

BO_ 1841 ARS510_OBJ_17_DERIVED: 16 XXX
 SG_ TRACK_ID_OP : 0|16@1+ (1,0) [0|65535] "" XXX
 SG_ TRACK_ID_RAW : 16|16@1+ (1,0) [0|65535] "" XXX
 SG_ PUBLISHED_OP : 32|1@1+ (1,0) [0|1] "" XXX
 SG_ SETTLED : 33|1@1+ (1,0) [0|1] "" XXX
 SG_ VREL_VALID : 34|1@1+ (1,0) [0|1] "" XXX
 SG_ DREL_FUSED_VALID : 35|1@1+ (1,0) [0|1] "" XXX
 SG_ VREL_KALMAN_VALID : 36|1@1+ (1,0) [0|1] "" XXX
 SG_ VREL : 40|16@1- (0.01,0) [-327.68|327.67] "m/s" XXX
 SG_ V_EGO_0xB4 : 56|16@1+ (0.01,0) [0|655.35] "m/s" XXX
 SG_ DREL_FUSED : 72|16@1+ (0.01,0) [0|655.35] "m" XXX
 SG_ VREL_KALMAN : 88|16@1- (0.01,0) [-327.68|327.67] "m/s" XXX

BO_ 1842 ARS510_OBJ_18_DERIVED: 16 XXX
 SG_ TRACK_ID_OP : 0|16@1+ (1,0) [0|65535] "" XXX
 SG_ TRACK_ID_RAW : 16|16@1+ (1,0) [0|65535] "" XXX
 SG_ PUBLISHED_OP : 32|1@1+ (1,0) [0|1] "" XXX
 SG_ SETTLED : 33|1@1+ (1,0) [0|1] "" XXX
 SG_ VREL_VALID : 34|1@1+ (1,0) [0|1] "" XXX
 SG_ DREL_FUSED_VALID : 35|1@1+ (1,0) [0|1] "" XXX
 SG_ VREL_KALMAN_VALID : 36|1@1+ (1,0) [0|1] "" XXX
 SG_ VREL : 40|16@1- (0.01,0) [-327.68|327.67] "m/s" XXX
 SG_ V_EGO_0xB4 : 56|16@1+ (0.01,0) [0|655.35] "m/s" XXX
 SG_ DREL_FUSED : 72|16@1+ (0.01,0) [0|655.35] "m" XXX
 SG_ VREL_KALMAN : 88|16@1- (0.01,0) [-327.68|327.67] "m/s" XXX

BO_ 1843 ARS510_OBJ_19_DERIVED: 16 XXX
 SG_ TRACK_ID_OP : 0|16@1+ (1,0) [0|65535] "" XXX
 SG_ TRACK_ID_RAW : 16|16@1+ (1,0) [0|65535] "" XXX
 SG_ PUBLISHED_OP : 32|1@1+ (1,0) [0|1] "" XXX
 SG_ SETTLED : 33|1@1+ (1,0) [0|1] "" XXX
 SG_ VREL_VALID : 34|1@1+ (1,0) [0|1] "" XXX
 SG_ DREL_FUSED_VALID : 35|1@1+ (1,0) [0|1] "" XXX
 SG_ VREL_KALMAN_VALID : 36|1@1+ (1,0) [0|1] "" XXX
 SG_ VREL : 40|16@1- (0.01,0) [-327.68|327.67] "m/s" XXX
 SG_ V_EGO_0xB4 : 56|16@1+ (0.01,0) [0|655.35] "m/s" XXX
 SG_ DREL_FUSED : 72|16@1+ (0.01,0) [0|655.35] "m" XXX
 SG_ VREL_KALMAN : 88|16@1- (0.01,0) [-327.68|327.67] "m/s" XXX

BO_ 1856 ARS510_REC_HEADER: 20 RADAR
 SG_ CONST_HDR0_8 : 0|8@1+ (1,0) [0|255] "raw" XXX
 SG_ UNK_HDR8_5 : 8|5@1+ (1,0) [0|31] "raw" XXX
 SG_ UNK_HDR13_4 : 13|4@1+ (1,0) [0|15] "raw" XXX
 SG_ UNK_HDR17_15 : 17|15@1+ (1,0) [0|32767] "raw" XXX
 SG_ CONST_HDR32_1 : 32|1@1+ (1,0) [0|1] "raw" XXX
 SG_ UNK_HDR33_1 : 33|1@1+ (1,0) [0|1] "raw" XXX
 SG_ CONST_HDR34_7 : 34|7@1+ (1,0) [0|127] "raw" XXX
 SG_ UNK_HDR41_15 : 41|15@1+ (1,0) [0|32767] "raw" XXX
 SG_ CONST_HDR56_12 : 56|12@1+ (1,0) [0|4095] "raw" XXX
 SG_ UNK_HDR68_4 : 68|4@1+ (1,0) [0|15] "raw" XXX
 SG_ CONST_HDR72_32 : 72|32@1+ (1,0) [0|4294967295] "raw" XXX
 SG_ UNK_HDR104_3 : 104|3@1+ (1,0) [0|7] "raw" XXX
 SG_ UNK_HDR107_4 : 107|4@1+ (1,0) [0|15] "raw" XXX
 SG_ UNK_HDR111_4 : 111|4@1+ (1,0) [0|15] "raw" XXX
 SG_ OBJECT_COUNT : 115|5@1+ (1,0) [0|20] "slots" XXX
 SG_ CONST_HDR120_16 : 120|16@1+ (1,0) [0|65535] "raw" XXX

BO_ 1857 ARS510_REC_TRAILER: 8 RADAR
 SG_ RECORD_CRC32 : 0|32@1+ (1,0) [0|4294967295] "" XXX
 SG_ RECORD_B741 : 32|8@1+ (1,0) [0|255] "raw" XXX

BO_ 1888 ARS510_SHELL85_HDR: 24 RADAR
 SG_ PREFIX_BYTE_00 : 0|8@1+ (1,0) [0|255] "raw" XXX
 SG_ PREFIX_BYTE_01 : 8|8@1+ (1,0) [0|255] "raw" XXX
 SG_ PREFIX_BYTE_02 : 16|8@1+ (1,0) [0|255] "raw" XXX
 SG_ PREFIX_BYTE_03 : 24|8@1+ (1,0) [0|255] "raw" XXX
 SG_ PREFIX_BYTE_04 : 32|8@1+ (1,0) [0|255] "raw" XXX
 SG_ PREFIX_BYTE_05 : 40|8@1+ (1,0) [0|255] "raw" XXX
 SG_ PREFIX_BYTE_06 : 48|8@1+ (1,0) [0|255] "raw" XXX
 SG_ PREFIX_BYTE_07 : 56|8@1+ (1,0) [0|255] "raw" XXX
 SG_ PREFIX_BYTE_08 : 64|8@1+ (1,0) [0|255] "raw" XXX
 SG_ PREFIX_BYTE_09 : 72|8@1+ (1,0) [0|255] "raw" XXX
 SG_ PREFIX_BYTE_10 : 80|8@1+ (1,0) [0|255] "raw" XXX
 SG_ PREFIX_BYTE_11 : 88|8@1+ (1,0) [0|255] "raw" XXX
 SG_ PREFIX_BYTE_12 : 96|8@1+ (1,0) [0|255] "raw" XXX
 SG_ PREFIX_BYTE_13 : 104|8@1+ (1,0) [0|255] "raw" XXX
 SG_ PREFIX_BYTE_14 : 112|8@1+ (1,0) [0|255] "raw" XXX
 SG_ PREFIX_BYTE_15 : 120|8@1+ (1,0) [0|255] "raw" XXX
 SG_ PREFIX_BYTE_16 : 128|8@1+ (1,0) [0|255] "raw" XXX
 SG_ PREFIX_BYTE_17 : 136|8@1+ (1,0) [0|255] "raw" XXX
 SG_ PREFIX_BYTE_18 : 144|8@1+ (1,0) [0|255] "raw" XXX
 SG_ PREFIX_BYTE_19 : 152|8@1+ (1,0) [0|255] "raw" XXX
 SG_ PREFIX_BYTE_20 : 160|8@1+ (1,0) [0|255] "raw" XXX

BO_ 1889 ARS510_SHELL85_CELL_00: 12 RADAR
 SG_ RAW_BYTE_00 : 0|8@1+ (1,0) [0|255] "raw" XXX
 SG_ RAW_BYTE_01 : 8|8@1+ (1,0) [0|255] "raw" XXX
 SG_ RAW_BYTE_02 : 16|8@1+ (1,0) [0|255] "raw" XXX
 SG_ RAW_BYTE_03 : 24|8@1+ (1,0) [0|255] "raw" XXX
 SG_ RAW_BYTE_04 : 32|8@1+ (1,0) [0|255] "raw" XXX
 SG_ RAW_BYTE_05 : 40|8@1+ (1,0) [0|255] "raw" XXX
 SG_ RAW_BYTE_06 : 48|8@1+ (1,0) [0|255] "raw" XXX
 SG_ RAW_BYTE_07 : 56|8@1+ (1,0) [0|255] "raw" XXX
 SG_ RAW_BYTE_08 : 64|8@1+ (1,0) [0|255] "raw" XXX
 SG_ RAW_BYTE_09 : 72|8@1+ (1,0) [0|255] "raw" XXX
 SG_ RAW_BYTE_10 : 80|8@1+ (1,0) [0|255] "raw" XXX
 SG_ RAW_BYTE_11 : 88|8@1+ (1,0) [0|255] "raw" XXX
 SG_ PARAMETERS_PRESENT : 30|1@1+ (1,0) [0|1] "" XXX
 SG_ CURVE_OFFSET_M : 32|12@1+ (0.01,-20) [-20|20.95] "m" XXX
 SG_ CURVE_HEADING_RAD : 48|16@1+ (-1.8e-05,0.5616) [-0.62|0.57] "rad" XXX
 SG_ CURVE_CURVATURE_PER_M : 64|15@1+ (2.5e-06,-0.04005) [-0.0401|0.0418] "1/m" XXX
 SG_ CURVE_RATE_PER_M2 : 10|10@1+ (4e-06,-0.002) [-0.0021|0.002] "1/m^2" XXX
 SG_ CURVE_FLAG : 79|1@1+ (1,0) [0|1] "raw" XXX

BO_ 1890 ARS510_SHELL85_CELL_01: 12 RADAR
 SG_ RAW_BYTE_00 : 0|8@1+ (1,0) [0|255] "raw" XXX
 SG_ RAW_BYTE_01 : 8|8@1+ (1,0) [0|255] "raw" XXX
 SG_ RAW_BYTE_02 : 16|8@1+ (1,0) [0|255] "raw" XXX
 SG_ RAW_BYTE_03 : 24|8@1+ (1,0) [0|255] "raw" XXX
 SG_ RAW_BYTE_04 : 32|8@1+ (1,0) [0|255] "raw" XXX
 SG_ RAW_BYTE_05 : 40|8@1+ (1,0) [0|255] "raw" XXX
 SG_ RAW_BYTE_06 : 48|8@1+ (1,0) [0|255] "raw" XXX
 SG_ RAW_BYTE_07 : 56|8@1+ (1,0) [0|255] "raw" XXX
 SG_ RAW_BYTE_08 : 64|8@1+ (1,0) [0|255] "raw" XXX
 SG_ RAW_BYTE_09 : 72|8@1+ (1,0) [0|255] "raw" XXX
 SG_ RAW_BYTE_10 : 80|8@1+ (1,0) [0|255] "raw" XXX
 SG_ RAW_BYTE_11 : 88|8@1+ (1,0) [0|255] "raw" XXX
 SG_ PARAMETERS_PRESENT : 30|1@1+ (1,0) [0|1] "" XXX
 SG_ CURVE_OFFSET_M : 32|12@1+ (0.01,-20) [-20|20.95] "m" XXX
 SG_ CURVE_HEADING_RAD : 48|16@1+ (-1.8e-05,0.5616) [-0.62|0.57] "rad" XXX
 SG_ CURVE_CURVATURE_PER_M : 64|15@1+ (2.5e-06,-0.04005) [-0.0401|0.0418] "1/m" XXX
 SG_ CURVE_RATE_PER_M2 : 10|10@1+ (4e-06,-0.002) [-0.0021|0.002] "1/m^2" XXX
 SG_ CURVE_FLAG : 79|1@1+ (1,0) [0|1] "raw" XXX

BO_ 1891 ARS510_SHELL85_CELL_02: 12 RADAR
 SG_ RAW_BYTE_00 : 0|8@1+ (1,0) [0|255] "raw" XXX
 SG_ RAW_BYTE_01 : 8|8@1+ (1,0) [0|255] "raw" XXX
 SG_ RAW_BYTE_02 : 16|8@1+ (1,0) [0|255] "raw" XXX
 SG_ RAW_BYTE_03 : 24|8@1+ (1,0) [0|255] "raw" XXX
 SG_ RAW_BYTE_04 : 32|8@1+ (1,0) [0|255] "raw" XXX
 SG_ RAW_BYTE_05 : 40|8@1+ (1,0) [0|255] "raw" XXX
 SG_ RAW_BYTE_06 : 48|8@1+ (1,0) [0|255] "raw" XXX
 SG_ RAW_BYTE_07 : 56|8@1+ (1,0) [0|255] "raw" XXX
 SG_ RAW_BYTE_08 : 64|8@1+ (1,0) [0|255] "raw" XXX
 SG_ RAW_BYTE_09 : 72|8@1+ (1,0) [0|255] "raw" XXX
 SG_ RAW_BYTE_10 : 80|8@1+ (1,0) [0|255] "raw" XXX
 SG_ RAW_BYTE_11 : 88|8@1+ (1,0) [0|255] "raw" XXX
 SG_ PARAMETERS_PRESENT : 30|1@1+ (1,0) [0|1] "" XXX
 SG_ CURVE_OFFSET_M : 32|12@1+ (0.01,-20) [-20|20.95] "m" XXX
 SG_ CURVE_HEADING_RAD : 48|16@1+ (-1.8e-05,0.5616) [-0.62|0.57] "rad" XXX
 SG_ CURVE_CURVATURE_PER_M : 64|15@1+ (2.5e-06,-0.04005) [-0.0401|0.0418] "1/m" XXX
 SG_ CURVE_RATE_PER_M2 : 10|10@1+ (4e-06,-0.002) [-0.0021|0.002] "1/m^2" XXX
 SG_ CURVE_FLAG : 79|1@1+ (1,0) [0|1] "raw" XXX

BO_ 1892 ARS510_SHELL85_CELL_03: 12 RADAR
 SG_ RAW_BYTE_00 : 0|8@1+ (1,0) [0|255] "raw" XXX
 SG_ RAW_BYTE_01 : 8|8@1+ (1,0) [0|255] "raw" XXX
 SG_ RAW_BYTE_02 : 16|8@1+ (1,0) [0|255] "raw" XXX
 SG_ RAW_BYTE_03 : 24|8@1+ (1,0) [0|255] "raw" XXX
 SG_ RAW_BYTE_04 : 32|8@1+ (1,0) [0|255] "raw" XXX
 SG_ RAW_BYTE_05 : 40|8@1+ (1,0) [0|255] "raw" XXX
 SG_ RAW_BYTE_06 : 48|8@1+ (1,0) [0|255] "raw" XXX
 SG_ RAW_BYTE_07 : 56|8@1+ (1,0) [0|255] "raw" XXX
 SG_ RAW_BYTE_08 : 64|8@1+ (1,0) [0|255] "raw" XXX
 SG_ RAW_BYTE_09 : 72|8@1+ (1,0) [0|255] "raw" XXX
 SG_ RAW_BYTE_10 : 80|8@1+ (1,0) [0|255] "raw" XXX
 SG_ RAW_BYTE_11 : 88|8@1+ (1,0) [0|255] "raw" XXX
 SG_ PARAMETERS_PRESENT : 30|1@1+ (1,0) [0|1] "" XXX
 SG_ CURVE_OFFSET_M : 32|12@1+ (0.01,-20) [-20|20.95] "m" XXX
 SG_ CURVE_HEADING_RAD : 48|16@1+ (-1.8e-05,0.5616) [-0.62|0.57] "rad" XXX
 SG_ CURVE_CURVATURE_PER_M : 64|15@1+ (2.5e-06,-0.04005) [-0.0401|0.0418] "1/m" XXX
 SG_ CURVE_RATE_PER_M2 : 10|10@1+ (4e-06,-0.002) [-0.0021|0.002] "1/m^2" XXX
 SG_ CURVE_FLAG : 79|1@1+ (1,0) [0|1] "raw" XXX

BO_ 1893 ARS510_SHELL85_CELL_04: 12 RADAR
 SG_ RAW_BYTE_00 : 0|8@1+ (1,0) [0|255] "raw" XXX
 SG_ RAW_BYTE_01 : 8|8@1+ (1,0) [0|255] "raw" XXX
 SG_ RAW_BYTE_02 : 16|8@1+ (1,0) [0|255] "raw" XXX
 SG_ RAW_BYTE_03 : 24|8@1+ (1,0) [0|255] "raw" XXX
 SG_ RAW_BYTE_04 : 32|8@1+ (1,0) [0|255] "raw" XXX
 SG_ RAW_BYTE_05 : 40|8@1+ (1,0) [0|255] "raw" XXX
 SG_ RAW_BYTE_06 : 48|8@1+ (1,0) [0|255] "raw" XXX
 SG_ RAW_BYTE_07 : 56|8@1+ (1,0) [0|255] "raw" XXX
 SG_ RAW_BYTE_08 : 64|8@1+ (1,0) [0|255] "raw" XXX
 SG_ RAW_BYTE_09 : 72|8@1+ (1,0) [0|255] "raw" XXX
 SG_ RAW_BYTE_10 : 80|8@1+ (1,0) [0|255] "raw" XXX
 SG_ RAW_BYTE_11 : 88|8@1+ (1,0) [0|255] "raw" XXX
 SG_ PARAMETERS_PRESENT : 30|1@1+ (1,0) [0|1] "" XXX
 SG_ CURVE_OFFSET_M : 32|12@1+ (0.01,-20) [-20|20.95] "m" XXX
 SG_ CURVE_HEADING_RAD : 48|16@1+ (-1.8e-05,0.5616) [-0.62|0.57] "rad" XXX
 SG_ CURVE_CURVATURE_PER_M : 64|15@1+ (2.5e-06,-0.04005) [-0.0401|0.0418] "1/m" XXX
 SG_ CURVE_RATE_PER_M2 : 10|10@1+ (4e-06,-0.002) [-0.0021|0.002] "1/m^2" XXX
 SG_ CURVE_FLAG : 79|1@1+ (1,0) [0|1] "raw" XXX

BO_ 1894 ARS510_SHELL85_CELL_05: 12 RADAR
 SG_ RAW_BYTE_00 : 0|8@1+ (1,0) [0|255] "raw" XXX
 SG_ RAW_BYTE_01 : 8|8@1+ (1,0) [0|255] "raw" XXX
 SG_ RAW_BYTE_02 : 16|8@1+ (1,0) [0|255] "raw" XXX
 SG_ RAW_BYTE_03 : 24|8@1+ (1,0) [0|255] "raw" XXX
 SG_ RAW_BYTE_04 : 32|8@1+ (1,0) [0|255] "raw" XXX
 SG_ RAW_BYTE_05 : 40|8@1+ (1,0) [0|255] "raw" XXX
 SG_ RAW_BYTE_06 : 48|8@1+ (1,0) [0|255] "raw" XXX
 SG_ RAW_BYTE_07 : 56|8@1+ (1,0) [0|255] "raw" XXX
 SG_ RAW_BYTE_08 : 64|8@1+ (1,0) [0|255] "raw" XXX
 SG_ RAW_BYTE_09 : 72|8@1+ (1,0) [0|255] "raw" XXX
 SG_ RAW_BYTE_10 : 80|8@1+ (1,0) [0|255] "raw" XXX
 SG_ RAW_BYTE_11 : 88|8@1+ (1,0) [0|255] "raw" XXX
 SG_ PARAMETERS_PRESENT : 30|1@1+ (1,0) [0|1] "" XXX
 SG_ CURVE_OFFSET_M : 32|12@1+ (0.01,-20) [-20|20.95] "m" XXX
 SG_ CURVE_HEADING_RAD : 48|16@1+ (-1.8e-05,0.5616) [-0.62|0.57] "rad" XXX
 SG_ CURVE_CURVATURE_PER_M : 64|15@1+ (2.5e-06,-0.04005) [-0.0401|0.0418] "1/m" XXX
 SG_ CURVE_RATE_PER_M2 : 10|10@1+ (4e-06,-0.002) [-0.0021|0.002] "1/m^2" XXX
 SG_ CURVE_FLAG : 79|1@1+ (1,0) [0|1] "raw" XXX

BO_ 1895 ARS510_SHELL85_CELL_06: 12 RADAR
 SG_ RAW_BYTE_00 : 0|8@1+ (1,0) [0|255] "raw" XXX
 SG_ RAW_BYTE_01 : 8|8@1+ (1,0) [0|255] "raw" XXX
 SG_ RAW_BYTE_02 : 16|8@1+ (1,0) [0|255] "raw" XXX
 SG_ RAW_BYTE_03 : 24|8@1+ (1,0) [0|255] "raw" XXX
 SG_ RAW_BYTE_04 : 32|8@1+ (1,0) [0|255] "raw" XXX
 SG_ RAW_BYTE_05 : 40|8@1+ (1,0) [0|255] "raw" XXX
 SG_ RAW_BYTE_06 : 48|8@1+ (1,0) [0|255] "raw" XXX
 SG_ RAW_BYTE_07 : 56|8@1+ (1,0) [0|255] "raw" XXX
 SG_ RAW_BYTE_08 : 64|8@1+ (1,0) [0|255] "raw" XXX
 SG_ RAW_BYTE_09 : 72|8@1+ (1,0) [0|255] "raw" XXX
 SG_ RAW_BYTE_10 : 80|8@1+ (1,0) [0|255] "raw" XXX
 SG_ RAW_BYTE_11 : 88|8@1+ (1,0) [0|255] "raw" XXX
 SG_ PARAMETERS_PRESENT : 30|1@1+ (1,0) [0|1] "" XXX
 SG_ CURVE_OFFSET_M : 32|12@1+ (0.01,-20) [-20|20.95] "m" XXX
 SG_ CURVE_HEADING_RAD : 48|16@1+ (-1.8e-05,0.5616) [-0.62|0.57] "rad" XXX
 SG_ CURVE_CURVATURE_PER_M : 64|15@1+ (2.5e-06,-0.04005) [-0.0401|0.0418] "1/m" XXX
 SG_ CURVE_RATE_PER_M2 : 10|10@1+ (4e-06,-0.002) [-0.0021|0.002] "1/m^2" XXX
 SG_ CURVE_FLAG : 79|1@1+ (1,0) [0|1] "raw" XXX

BO_ 1896 ARS510_SHELL85_CELL_07: 12 RADAR
 SG_ RAW_BYTE_00 : 0|8@1+ (1,0) [0|255] "raw" XXX
 SG_ RAW_BYTE_01 : 8|8@1+ (1,0) [0|255] "raw" XXX
 SG_ RAW_BYTE_02 : 16|8@1+ (1,0) [0|255] "raw" XXX
 SG_ RAW_BYTE_03 : 24|8@1+ (1,0) [0|255] "raw" XXX
 SG_ RAW_BYTE_04 : 32|8@1+ (1,0) [0|255] "raw" XXX
 SG_ RAW_BYTE_05 : 40|8@1+ (1,0) [0|255] "raw" XXX
 SG_ RAW_BYTE_06 : 48|8@1+ (1,0) [0|255] "raw" XXX
 SG_ RAW_BYTE_07 : 56|8@1+ (1,0) [0|255] "raw" XXX
 SG_ RAW_BYTE_08 : 64|8@1+ (1,0) [0|255] "raw" XXX
 SG_ RAW_BYTE_09 : 72|8@1+ (1,0) [0|255] "raw" XXX
 SG_ RAW_BYTE_10 : 80|8@1+ (1,0) [0|255] "raw" XXX
 SG_ RAW_BYTE_11 : 88|8@1+ (1,0) [0|255] "raw" XXX
 SG_ PARAMETERS_PRESENT : 30|1@1+ (1,0) [0|1] "" XXX
 SG_ CURVE_OFFSET_M : 32|12@1+ (0.01,-20) [-20|20.95] "m" XXX
 SG_ CURVE_HEADING_RAD : 48|16@1+ (-1.8e-05,0.5616) [-0.62|0.57] "rad" XXX
 SG_ CURVE_CURVATURE_PER_M : 64|15@1+ (2.5e-06,-0.04005) [-0.0401|0.0418] "1/m" XXX
 SG_ CURVE_RATE_PER_M2 : 10|10@1+ (4e-06,-0.002) [-0.0021|0.002] "1/m^2" XXX
 SG_ CURVE_FLAG : 79|1@1+ (1,0) [0|1] "raw" XXX

BO_ 1897 ARS510_SHELL85_CELL_08: 12 RADAR
 SG_ RAW_BYTE_00 : 0|8@1+ (1,0) [0|255] "raw" XXX
 SG_ RAW_BYTE_01 : 8|8@1+ (1,0) [0|255] "raw" XXX
 SG_ RAW_BYTE_02 : 16|8@1+ (1,0) [0|255] "raw" XXX
 SG_ RAW_BYTE_03 : 24|8@1+ (1,0) [0|255] "raw" XXX
 SG_ RAW_BYTE_04 : 32|8@1+ (1,0) [0|255] "raw" XXX
 SG_ RAW_BYTE_05 : 40|8@1+ (1,0) [0|255] "raw" XXX
 SG_ RAW_BYTE_06 : 48|8@1+ (1,0) [0|255] "raw" XXX
 SG_ RAW_BYTE_07 : 56|8@1+ (1,0) [0|255] "raw" XXX
 SG_ RAW_BYTE_08 : 64|8@1+ (1,0) [0|255] "raw" XXX
 SG_ RAW_BYTE_09 : 72|8@1+ (1,0) [0|255] "raw" XXX
 SG_ RAW_BYTE_10 : 80|8@1+ (1,0) [0|255] "raw" XXX
 SG_ RAW_BYTE_11 : 88|8@1+ (1,0) [0|255] "raw" XXX
 SG_ PARAMETERS_PRESENT : 30|1@1+ (1,0) [0|1] "" XXX
 SG_ CURVE_OFFSET_M : 32|12@1+ (0.01,-20) [-20|20.95] "m" XXX
 SG_ CURVE_HEADING_RAD : 48|16@1+ (-1.8e-05,0.5616) [-0.62|0.57] "rad" XXX
 SG_ CURVE_CURVATURE_PER_M : 64|15@1+ (2.5e-06,-0.04005) [-0.0401|0.0418] "1/m" XXX
 SG_ CURVE_RATE_PER_M2 : 10|10@1+ (4e-06,-0.002) [-0.0021|0.002] "1/m^2" XXX
 SG_ CURVE_FLAG : 79|1@1+ (1,0) [0|1] "raw" XXX

BO_ 1898 ARS510_SHELL85_CELL_09: 12 RADAR
 SG_ RAW_BYTE_00 : 0|8@1+ (1,0) [0|255] "raw" XXX
 SG_ RAW_BYTE_01 : 8|8@1+ (1,0) [0|255] "raw" XXX
 SG_ RAW_BYTE_02 : 16|8@1+ (1,0) [0|255] "raw" XXX
 SG_ RAW_BYTE_03 : 24|8@1+ (1,0) [0|255] "raw" XXX
 SG_ RAW_BYTE_04 : 32|8@1+ (1,0) [0|255] "raw" XXX
 SG_ RAW_BYTE_05 : 40|8@1+ (1,0) [0|255] "raw" XXX
 SG_ RAW_BYTE_06 : 48|8@1+ (1,0) [0|255] "raw" XXX
 SG_ RAW_BYTE_07 : 56|8@1+ (1,0) [0|255] "raw" XXX
 SG_ RAW_BYTE_08 : 64|8@1+ (1,0) [0|255] "raw" XXX
 SG_ RAW_BYTE_09 : 72|8@1+ (1,0) [0|255] "raw" XXX
 SG_ RAW_BYTE_10 : 80|8@1+ (1,0) [0|255] "raw" XXX
 SG_ RAW_BYTE_11 : 88|8@1+ (1,0) [0|255] "raw" XXX
 SG_ PARAMETERS_PRESENT : 30|1@1+ (1,0) [0|1] "" XXX
 SG_ CURVE_OFFSET_M : 32|12@1+ (0.01,-20) [-20|20.95] "m" XXX
 SG_ CURVE_HEADING_RAD : 48|16@1+ (-1.8e-05,0.5616) [-0.62|0.57] "rad" XXX
 SG_ CURVE_CURVATURE_PER_M : 64|15@1+ (2.5e-06,-0.04005) [-0.0401|0.0418] "1/m" XXX
 SG_ CURVE_RATE_PER_M2 : 10|10@1+ (4e-06,-0.002) [-0.0021|0.002] "1/m^2" XXX
 SG_ CURVE_FLAG : 79|1@1+ (1,0) [0|1] "raw" XXX

BO_ 1899 ARS510_SHELL85_CRC: 8 RADAR
 SG_ RECORD_CRC32 : 0|32@1+ (1,0) [0|4294967295] "raw" XXX
 SG_ TRAILER_BYTES : 32|16@1+ (1,0) [0|65535] "raw" XXX

CM_ BO_ 1805 "Reassembled 0x80 object slot 13 (record bytes 485-520), sent only when occupied. Little-endian bit field: bit 0 = LSB of slot byte 0.";
CM_ SG_ 1805 STATE_CODE "Track state: 0 deleted (the track's final age-0 record), 1 measured, 2 coasting (predicted without a new measurement). While 2, SCORE_CODE drops by 20 (or 1) per cycle.";
CM_ SG_ 1805 SLOT_INDEX_CODE "Physical slot index 0-19; 63 when the slot is unallocated.";
CM_ SG_ 1805 UNK_8_6 "Bits 8-12: startup code, min(30, floor(31 * (2/3)^max(age - 4, 0))) while the motion code is 5 (initializing). Bit 13: separate raw flag.";
CM_ SG_ 1805 ONCOMING_FLAG "Oncoming-like internal motion state. Can persist after slowing and reset before the native allocation ends.";
CM_ SG_ 1805 UNK_15_1 "Placeholder flag: set exactly on the age-1 first output whose range, lateral and size codes are placeholders.";
CM_ SG_ 1805 SCORE_CODE "Existence probability, percent (10-100): can decline in either state; drops by exactly 20 (or 1) per cycle in state 2 and may stay lowered after a return to state 1. Bits 20-22 are its bits 4-6 (score // 16). The slot is freed near 20.";
CM_ SG_ 1805 AGE "Track age in radar cycles (60 ms): 1 at birth, saturates at 126; 0 = slot retiring. A restart is a new track. Converged from about 60.";
CM_ SG_ 1805 CONST_31_1 "Constant in the captured data.";
CM_ SG_ 1805 DREL "Distance forward of the radar, m: (code - 160) / 16. Add 1.52 m (openpilot's RADAR_TO_CAMERA) for a camera-referenced distance; radard compares radar dRel with the vision distance minus 1.52 m.";
CM_ SG_ 1805 YREL_LEFT "Lateral offset, m, left positive: (code - 2048) * 0.015. |code - 2048| >= 2000 is a sentinel.";
CM_ SG_ 1805 UNK_56_7 "Object length, about 0.1 m per code: car ~4.9 m, large vehicle ~5.7 m, two-wheeler ~1.7 m, pedestrian ~0.4 m.";
CM_ SG_ 1805 UNK_63_1 "Raw, unnamed.";
CM_ SG_ 1805 VLONG_OVER_GROUND "Longitudinal velocity over ground, m/s: (code - 510.5) * 0.15. vRel = this - ego speed. Code 1023 is a saturated reading.";
CM_ SG_ 1805 VLAT_OVER_GROUND_PROV "Lateral velocity over ground, m/s, left positive: (code - 510.5) * about 0.142-0.155 (0.15 used).";
CM_ SG_ 1805 ALONG_LIKE_84 "Longitudinal acceleration over ground, filtered: (code - 510.3) * about 0.04-0.09 m/s^2 with ego stopped (estimate depends on drives and estimator); follows the track's own speed by about 0.3 s; moves by about 0.4 of ego's acceleration.";
CM_ SG_ 1805 CONST_94_2 "Constant in the captured data.";
CM_ SG_ 1805 UNK_96 "Lateral acceleration over ground, filtered: (code - 511) * 0.05 m/s^2; follows the kinematic value by about 0.5 s.";
CM_ SG_ 1805 UNK_106_1 "Raw, unnamed.";
CM_ SG_ 1805 UNK_107_1 "Predicted record (the radar's own prediction), like Tesla's Meas = 0: set on 45 % of a track's last five records, 2.6 % elsewhere.";
CM_ SG_ 1805 CONST_108_1 "Constant in the captured data.";
CM_ SG_ 1805 MOVE_STATE "Low two bits of the motion code. Full code = MOVE_STATE | (UNK_111_1 << 2): 0 moving forward, 1 slow or standing, 2 oncoming, 3 moving right, 4 moving left, 5 initializing, 7 stopped after moving.";
CM_ SG_ 1805 UNK_111_1 "Bit 2 of the motion code (see MOVE_STATE).";
CM_ SG_ 1805 UNK_112_3 "Camera-association state: 0 radar only, 1 (rarely 2-4) while the camera has the vehicle. By day non-zero on nearly all in-lane vehicles inside 40 m and almost never beyond 50 m; at night also at long range.";
CM_ SG_ 1805 UNK_115_5 "Class confidence in 5 % steps: mostly 0 while not yet classified (83 % of those rows), 4-20 otherwise (20 = 100 %); moves by one step per cycle on 95-96 % of its changes. A large vehicle is re-classified as a car when it falls to 5.";
CM_ SG_ 1805 UNK_120_3 "Raw; non-zero on 0.2 % of rows (mature cars).";
CM_ SG_ 1805 CONST_123_5 "Constant in the captured data.";
CM_ SG_ 1805 UNK_128_2 "Lane-assignment state, low bits (full = UNK_128_2 | UNK_130_1 << 2): 3 ego lane, 2 right lane, 4 left lane; 1, 5, 7 = no lane weights.";
CM_ SG_ 1805 UNK_130_1 "Lane-assignment state, bit 2 (see UNK_128_2).";
CM_ SG_ 1805 UNK_131_4 "Dominant lane weight: the largest of the three lane weights or one less (99.6 % of rows with a nonzero weight).";
CM_ SG_ 1805 CONST_135_1 "Constant in the captured data.";
CM_ SG_ 1805 UNK_136_4 "Camera-association confidence: 15 without association; restarts at 3-9 when UNK_112_3 becomes non-zero and climbs to 14.";
CM_ SG_ 1805 UNK_140_3 "Object class, second encoding of UNK_163_3: 0, 5, 7, 1, 3, 4 = class 1, 2, 3, 4, 5, 6.";
CM_ SG_ 1805 CONST_143_5 "Constant in the captured data.";
CM_ SG_ 1805 UNK_148_8 "Lane weights in 1/15 steps: low nibble (148|4) right lane, high nibble (152|4) left lane. With UNK_156_4 (ego lane) they sum to 15 or 16 whenever any is nonzero.";
CM_ SG_ 1805 UNK_156_4 "Ego-lane weight in 1/15 steps (see UNK_148_8).";
CM_ SG_ 1805 CONST_160_3 "Constant in the captured data.";
CM_ SG_ 1805 UNK_163_3 "Object class: 1 not yet classified, 2 car, 3 large vehicle, 4 pedestrian, 5 provisional (cyclist / person associations), 6 two-wheeler.";
CM_ SG_ 1805 UNK_166_2 "Raw, unnamed.";
CM_ SG_ 1805 UNK_168_10 "All ones or all zeros (768 / 832 rare): five sticky per-track latches by age mod 5; a phase latches on a cycle without a near-scan measurement, so most tracks born far out have it set from birth.";
CM_ SG_ 1805 CONST_178_3 "Constant in the captured data.";
CM_ SG_ 1805 UNK_181_1 "Daylight latch: one of five sticky per-track latches by age mod 5 (a phase latches after an existence dip); set on a quarter of mature vehicle rows by day, 2 of 59,988 night rows.";
CM_ SG_ 1805 UNK_182_1 "Raw, unnamed.";
CM_ SG_ 1805 UNK_183_7 "Bit 183: velocity re-initialisation latch (five sticky per-track latches by age mod 5); bits 184-189 are the low bits of a secondary score byte 184|8 (percent: 100 on 98 % of rows; lower mostly on young tracks, far lateral objects and stationary large vehicles / pedestrians).";
CM_ SG_ 1805 UNK_190_10 "Bits 190-191 = top of the secondary score byte 184|8; bits 192-199 are zero.";
CM_ SG_ 1805 UNK_200_7 "Orientation uncertainty: about 3.1 * UNK_248_7 / speed (m/s) on moving objects; 63 for stopped objects, 127 sentinel. Keep all seven bits.";
CM_ SG_ 1805 CONST_207_1 "Constant in the captured data.";
CM_ SG_ 1805 UNK_208_6 "Coarse heading over ground, left positive, about pi/64 rad per code: matches floor(max(atan2(vy, vx), 0) * 64 / pi) on 98 % of settled moving samples; can update while both velocity codes hold.";
CM_ SG_ 1805 CONST_214_2 "Constant in the captured data.";
CM_ SG_ 1805 UNK_216_6 "Object width, about (code + 1) * 0.1 m: car ~1.8 m, large vehicle ~2.0 m, two-wheeler ~0.7 m, pedestrian ~0.5 m.";
CM_ SG_ 1805 CONST_222_2 "Constant in the captured data.";
CM_ SG_ 1805 UNK_224_7 "Range standard deviation (sigma dRel), about 0.23 m per count (0.24 below 40 m; beyond 40 m a 4-8 m error floor dominates): grows with range, shrinks with track age.";
CM_ SG_ 1805 CONST_231_1 "Constant in the captured data.";
CM_ SG_ 1805 UNK_232_8 "Lateral standard deviation (sigma yRel), about 0.10 m per count: grows with |yRel|, shrinks with age. Eight bits: far young tracks reach 128-255 (255 = saturated).";
CM_ SG_ 1805 UNK_240_7 "Longitudinal velocity standard deviation (sigma vx), about 0.043-0.045 m/s per count against the ACC target: grows with range, higher during velocity excursions below 40 m. 127 accompanies saturated velocity.";
CM_ SG_ 1805 CONST_247_1 "Constant in the captured data.";
CM_ SG_ 1805 UNK_248_7 "Lateral velocity standard deviation (sigma vy), linear in the code: about 0.085 + 0.03 m/s per count against stationary objects, about 0.09 per count on moving leads.";
CM_ SG_ 1805 CONST_255_1 "Constant in the captured data.";
CM_ SG_ 1805 UNK_256_8 "Longitudinal-acceleration uncertainty (sigma ax candidate): grows with the spread between ALONG_LIKE_84 and the track's own speed slope (about 0.06-0.07 m/s^2 per code pooled); within a range band it grades that spread only within about 20 m.";
CM_ SG_ 1805 UNK_264_8 "Lateral-acceleration uncertainty (sigma ay candidate), covariance-like: moves with UNK_248_7 in every range band and shrinks with track age (about 11 at age 5-10, 2 from age 60).";
CM_ SG_ 1805 UNK_272_5 "Coarse length code: about round(length / 0.555 m) for vehicles (within one code on 91 %); not a length for pedestrians / two-wheelers.";
CM_ SG_ 1805 UNK_277_11 "Raw; bit 277 rarely set on newborn tracks.";
CM_ BO_ 1806 "Reassembled 0x80 object slot 14 (record bytes 521-556), sent only when occupied. Little-endian bit field: bit 0 = LSB of slot byte 0.";
CM_ SG_ 1806 STATE_CODE "Track state: 0 deleted (the track's final age-0 record), 1 measured, 2 coasting (predicted without a new measurement). While 2, SCORE_CODE drops by 20 (or 1) per cycle.";
CM_ SG_ 1806 SLOT_INDEX_CODE "Physical slot index 0-19; 63 when the slot is unallocated.";
CM_ SG_ 1806 UNK_8_6 "Bits 8-12: startup code, min(30, floor(31 * (2/3)^max(age - 4, 0))) while the motion code is 5 (initializing). Bit 13: separate raw flag.";
CM_ SG_ 1806 ONCOMING_FLAG "Oncoming-like internal motion state. Can persist after slowing and reset before the native allocation ends.";
CM_ SG_ 1806 UNK_15_1 "Placeholder flag: set exactly on the age-1 first output whose range, lateral and size codes are placeholders.";
CM_ SG_ 1806 SCORE_CODE "Existence probability, percent (10-100): can decline in either state; drops by exactly 20 (or 1) per cycle in state 2 and may stay lowered after a return to state 1. Bits 20-22 are its bits 4-6 (score // 16). The slot is freed near 20.";
CM_ SG_ 1806 AGE "Track age in radar cycles (60 ms): 1 at birth, saturates at 126; 0 = slot retiring. A restart is a new track. Converged from about 60.";
CM_ SG_ 1806 CONST_31_1 "Constant in the captured data.";
CM_ SG_ 1806 DREL "Distance forward of the radar, m: (code - 160) / 16. Add 1.52 m (openpilot's RADAR_TO_CAMERA) for a camera-referenced distance; radard compares radar dRel with the vision distance minus 1.52 m.";
CM_ SG_ 1806 YREL_LEFT "Lateral offset, m, left positive: (code - 2048) * 0.015. |code - 2048| >= 2000 is a sentinel.";
CM_ SG_ 1806 UNK_56_7 "Object length, about 0.1 m per code: car ~4.9 m, large vehicle ~5.7 m, two-wheeler ~1.7 m, pedestrian ~0.4 m.";
CM_ SG_ 1806 UNK_63_1 "Raw, unnamed.";
CM_ SG_ 1806 VLONG_OVER_GROUND "Longitudinal velocity over ground, m/s: (code - 510.5) * 0.15. vRel = this - ego speed. Code 1023 is a saturated reading.";
CM_ SG_ 1806 VLAT_OVER_GROUND_PROV "Lateral velocity over ground, m/s, left positive: (code - 510.5) * about 0.142-0.155 (0.15 used).";
CM_ SG_ 1806 ALONG_LIKE_84 "Longitudinal acceleration over ground, filtered: (code - 510.3) * about 0.04-0.09 m/s^2 with ego stopped (estimate depends on drives and estimator); follows the track's own speed by about 0.3 s; moves by about 0.4 of ego's acceleration.";
CM_ SG_ 1806 CONST_94_2 "Constant in the captured data.";
CM_ SG_ 1806 UNK_96 "Lateral acceleration over ground, filtered: (code - 511) * 0.05 m/s^2; follows the kinematic value by about 0.5 s.";
CM_ SG_ 1806 UNK_106_1 "Raw, unnamed.";
CM_ SG_ 1806 UNK_107_1 "Predicted record (the radar's own prediction), like Tesla's Meas = 0: set on 45 % of a track's last five records, 2.6 % elsewhere.";
CM_ SG_ 1806 CONST_108_1 "Constant in the captured data.";
CM_ SG_ 1806 MOVE_STATE "Low two bits of the motion code. Full code = MOVE_STATE | (UNK_111_1 << 2): 0 moving forward, 1 slow or standing, 2 oncoming, 3 moving right, 4 moving left, 5 initializing, 7 stopped after moving.";
CM_ SG_ 1806 UNK_111_1 "Bit 2 of the motion code (see MOVE_STATE).";
CM_ SG_ 1806 UNK_112_3 "Camera-association state: 0 radar only, 1 (rarely 2-4) while the camera has the vehicle. By day non-zero on nearly all in-lane vehicles inside 40 m and almost never beyond 50 m; at night also at long range.";
CM_ SG_ 1806 UNK_115_5 "Class confidence in 5 % steps: mostly 0 while not yet classified (83 % of those rows), 4-20 otherwise (20 = 100 %); moves by one step per cycle on 95-96 % of its changes. A large vehicle is re-classified as a car when it falls to 5.";
CM_ SG_ 1806 UNK_120_3 "Raw; non-zero on 0.2 % of rows (mature cars).";
CM_ SG_ 1806 CONST_123_5 "Constant in the captured data.";
CM_ SG_ 1806 UNK_128_2 "Lane-assignment state, low bits (full = UNK_128_2 | UNK_130_1 << 2): 3 ego lane, 2 right lane, 4 left lane; 1, 5, 7 = no lane weights.";
CM_ SG_ 1806 UNK_130_1 "Lane-assignment state, bit 2 (see UNK_128_2).";
CM_ SG_ 1806 UNK_131_4 "Dominant lane weight: the largest of the three lane weights or one less (99.6 % of rows with a nonzero weight).";
CM_ SG_ 1806 CONST_135_1 "Constant in the captured data.";
CM_ SG_ 1806 UNK_136_4 "Camera-association confidence: 15 without association; restarts at 3-9 when UNK_112_3 becomes non-zero and climbs to 14.";
CM_ SG_ 1806 UNK_140_3 "Object class, second encoding of UNK_163_3: 0, 5, 7, 1, 3, 4 = class 1, 2, 3, 4, 5, 6.";
CM_ SG_ 1806 CONST_143_5 "Constant in the captured data.";
CM_ SG_ 1806 UNK_148_8 "Lane weights in 1/15 steps: low nibble (148|4) right lane, high nibble (152|4) left lane. With UNK_156_4 (ego lane) they sum to 15 or 16 whenever any is nonzero.";
CM_ SG_ 1806 UNK_156_4 "Ego-lane weight in 1/15 steps (see UNK_148_8).";
CM_ SG_ 1806 CONST_160_3 "Constant in the captured data.";
CM_ SG_ 1806 UNK_163_3 "Object class: 1 not yet classified, 2 car, 3 large vehicle, 4 pedestrian, 5 provisional (cyclist / person associations), 6 two-wheeler.";
CM_ SG_ 1806 UNK_166_2 "Raw, unnamed.";
CM_ SG_ 1806 UNK_168_10 "All ones or all zeros (768 / 832 rare): five sticky per-track latches by age mod 5; a phase latches on a cycle without a near-scan measurement, so most tracks born far out have it set from birth.";
CM_ SG_ 1806 CONST_178_3 "Constant in the captured data.";
CM_ SG_ 1806 UNK_181_1 "Daylight latch: one of five sticky per-track latches by age mod 5 (a phase latches after an existence dip); set on a quarter of mature vehicle rows by day, 2 of 59,988 night rows.";
CM_ SG_ 1806 UNK_182_1 "Raw, unnamed.";
CM_ SG_ 1806 UNK_183_7 "Bit 183: velocity re-initialisation latch (five sticky per-track latches by age mod 5); bits 184-189 are the low bits of a secondary score byte 184|8 (percent: 100 on 98 % of rows; lower mostly on young tracks, far lateral objects and stationary large vehicles / pedestrians).";
CM_ SG_ 1806 UNK_190_10 "Bits 190-191 = top of the secondary score byte 184|8; bits 192-199 are zero.";
CM_ SG_ 1806 UNK_200_7 "Orientation uncertainty: about 3.1 * UNK_248_7 / speed (m/s) on moving objects; 63 for stopped objects, 127 sentinel. Keep all seven bits.";
CM_ SG_ 1806 CONST_207_1 "Constant in the captured data.";
CM_ SG_ 1806 UNK_208_6 "Coarse heading over ground, left positive, about pi/64 rad per code: matches floor(max(atan2(vy, vx), 0) * 64 / pi) on 98 % of settled moving samples; can update while both velocity codes hold.";
CM_ SG_ 1806 CONST_214_2 "Constant in the captured data.";
CM_ SG_ 1806 UNK_216_6 "Object width, about (code + 1) * 0.1 m: car ~1.8 m, large vehicle ~2.0 m, two-wheeler ~0.7 m, pedestrian ~0.5 m.";
CM_ SG_ 1806 CONST_222_2 "Constant in the captured data.";
CM_ SG_ 1806 UNK_224_7 "Range standard deviation (sigma dRel), about 0.23 m per count (0.24 below 40 m; beyond 40 m a 4-8 m error floor dominates): grows with range, shrinks with track age.";
CM_ SG_ 1806 CONST_231_1 "Constant in the captured data.";
CM_ SG_ 1806 UNK_232_8 "Lateral standard deviation (sigma yRel), about 0.10 m per count: grows with |yRel|, shrinks with age. Eight bits: far young tracks reach 128-255 (255 = saturated).";
CM_ SG_ 1806 UNK_240_7 "Longitudinal velocity standard deviation (sigma vx), about 0.043-0.045 m/s per count against the ACC target: grows with range, higher during velocity excursions below 40 m. 127 accompanies saturated velocity.";
CM_ SG_ 1806 CONST_247_1 "Constant in the captured data.";
CM_ SG_ 1806 UNK_248_7 "Lateral velocity standard deviation (sigma vy), linear in the code: about 0.085 + 0.03 m/s per count against stationary objects, about 0.09 per count on moving leads.";
CM_ SG_ 1806 CONST_255_1 "Constant in the captured data.";
CM_ SG_ 1806 UNK_256_8 "Longitudinal-acceleration uncertainty (sigma ax candidate): grows with the spread between ALONG_LIKE_84 and the track's own speed slope (about 0.06-0.07 m/s^2 per code pooled); within a range band it grades that spread only within about 20 m.";
CM_ SG_ 1806 UNK_264_8 "Lateral-acceleration uncertainty (sigma ay candidate), covariance-like: moves with UNK_248_7 in every range band and shrinks with track age (about 11 at age 5-10, 2 from age 60).";
CM_ SG_ 1806 UNK_272_5 "Coarse length code: about round(length / 0.555 m) for vehicles (within one code on 91 %); not a length for pedestrians / two-wheelers.";
CM_ SG_ 1806 UNK_277_11 "Raw; bit 277 rarely set on newborn tracks.";
CM_ BO_ 1807 "Reassembled 0x80 object slot 15 (record bytes 557-592), sent only when occupied. Little-endian bit field: bit 0 = LSB of slot byte 0.";
CM_ SG_ 1807 STATE_CODE "Track state: 0 deleted (the track's final age-0 record), 1 measured, 2 coasting (predicted without a new measurement). While 2, SCORE_CODE drops by 20 (or 1) per cycle.";
CM_ SG_ 1807 SLOT_INDEX_CODE "Physical slot index 0-19; 63 when the slot is unallocated.";
CM_ SG_ 1807 UNK_8_6 "Bits 8-12: startup code, min(30, floor(31 * (2/3)^max(age - 4, 0))) while the motion code is 5 (initializing). Bit 13: separate raw flag.";
CM_ SG_ 1807 ONCOMING_FLAG "Oncoming-like internal motion state. Can persist after slowing and reset before the native allocation ends.";
CM_ SG_ 1807 UNK_15_1 "Placeholder flag: set exactly on the age-1 first output whose range, lateral and size codes are placeholders.";
CM_ SG_ 1807 SCORE_CODE "Existence probability, percent (10-100): can decline in either state; drops by exactly 20 (or 1) per cycle in state 2 and may stay lowered after a return to state 1. Bits 20-22 are its bits 4-6 (score // 16). The slot is freed near 20.";
CM_ SG_ 1807 AGE "Track age in radar cycles (60 ms): 1 at birth, saturates at 126; 0 = slot retiring. A restart is a new track. Converged from about 60.";
CM_ SG_ 1807 CONST_31_1 "Constant in the captured data.";
CM_ SG_ 1807 DREL "Distance forward of the radar, m: (code - 160) / 16. Add 1.52 m (openpilot's RADAR_TO_CAMERA) for a camera-referenced distance; radard compares radar dRel with the vision distance minus 1.52 m.";
CM_ SG_ 1807 YREL_LEFT "Lateral offset, m, left positive: (code - 2048) * 0.015. |code - 2048| >= 2000 is a sentinel.";
CM_ SG_ 1807 UNK_56_7 "Object length, about 0.1 m per code: car ~4.9 m, large vehicle ~5.7 m, two-wheeler ~1.7 m, pedestrian ~0.4 m.";
CM_ SG_ 1807 UNK_63_1 "Raw, unnamed.";
CM_ SG_ 1807 VLONG_OVER_GROUND "Longitudinal velocity over ground, m/s: (code - 510.5) * 0.15. vRel = this - ego speed. Code 1023 is a saturated reading.";
CM_ SG_ 1807 VLAT_OVER_GROUND_PROV "Lateral velocity over ground, m/s, left positive: (code - 510.5) * about 0.142-0.155 (0.15 used).";
CM_ SG_ 1807 ALONG_LIKE_84 "Longitudinal acceleration over ground, filtered: (code - 510.3) * about 0.04-0.09 m/s^2 with ego stopped (estimate depends on drives and estimator); follows the track's own speed by about 0.3 s; moves by about 0.4 of ego's acceleration.";
CM_ SG_ 1807 CONST_94_2 "Constant in the captured data.";
CM_ SG_ 1807 UNK_96 "Lateral acceleration over ground, filtered: (code - 511) * 0.05 m/s^2; follows the kinematic value by about 0.5 s.";
CM_ SG_ 1807 UNK_106_1 "Raw, unnamed.";
CM_ SG_ 1807 UNK_107_1 "Predicted record (the radar's own prediction), like Tesla's Meas = 0: set on 45 % of a track's last five records, 2.6 % elsewhere.";
CM_ SG_ 1807 CONST_108_1 "Constant in the captured data.";
CM_ SG_ 1807 MOVE_STATE "Low two bits of the motion code. Full code = MOVE_STATE | (UNK_111_1 << 2): 0 moving forward, 1 slow or standing, 2 oncoming, 3 moving right, 4 moving left, 5 initializing, 7 stopped after moving.";
CM_ SG_ 1807 UNK_111_1 "Bit 2 of the motion code (see MOVE_STATE).";
CM_ SG_ 1807 UNK_112_3 "Camera-association state: 0 radar only, 1 (rarely 2-4) while the camera has the vehicle. By day non-zero on nearly all in-lane vehicles inside 40 m and almost never beyond 50 m; at night also at long range.";
CM_ SG_ 1807 UNK_115_5 "Class confidence in 5 % steps: mostly 0 while not yet classified (83 % of those rows), 4-20 otherwise (20 = 100 %); moves by one step per cycle on 95-96 % of its changes. A large vehicle is re-classified as a car when it falls to 5.";
CM_ SG_ 1807 UNK_120_3 "Raw; non-zero on 0.2 % of rows (mature cars).";
CM_ SG_ 1807 CONST_123_5 "Constant in the captured data.";
CM_ SG_ 1807 UNK_128_2 "Lane-assignment state, low bits (full = UNK_128_2 | UNK_130_1 << 2): 3 ego lane, 2 right lane, 4 left lane; 1, 5, 7 = no lane weights.";
CM_ SG_ 1807 UNK_130_1 "Lane-assignment state, bit 2 (see UNK_128_2).";
CM_ SG_ 1807 UNK_131_4 "Dominant lane weight: the largest of the three lane weights or one less (99.6 % of rows with a nonzero weight).";
CM_ SG_ 1807 CONST_135_1 "Constant in the captured data.";
CM_ SG_ 1807 UNK_136_4 "Camera-association confidence: 15 without association; restarts at 3-9 when UNK_112_3 becomes non-zero and climbs to 14.";
CM_ SG_ 1807 UNK_140_3 "Object class, second encoding of UNK_163_3: 0, 5, 7, 1, 3, 4 = class 1, 2, 3, 4, 5, 6.";
CM_ SG_ 1807 CONST_143_5 "Constant in the captured data.";
CM_ SG_ 1807 UNK_148_8 "Lane weights in 1/15 steps: low nibble (148|4) right lane, high nibble (152|4) left lane. With UNK_156_4 (ego lane) they sum to 15 or 16 whenever any is nonzero.";
CM_ SG_ 1807 UNK_156_4 "Ego-lane weight in 1/15 steps (see UNK_148_8).";
CM_ SG_ 1807 CONST_160_3 "Constant in the captured data.";
CM_ SG_ 1807 UNK_163_3 "Object class: 1 not yet classified, 2 car, 3 large vehicle, 4 pedestrian, 5 provisional (cyclist / person associations), 6 two-wheeler.";
CM_ SG_ 1807 UNK_166_2 "Raw, unnamed.";
CM_ SG_ 1807 UNK_168_10 "All ones or all zeros (768 / 832 rare): five sticky per-track latches by age mod 5; a phase latches on a cycle without a near-scan measurement, so most tracks born far out have it set from birth.";
CM_ SG_ 1807 CONST_178_3 "Constant in the captured data.";
CM_ SG_ 1807 UNK_181_1 "Daylight latch: one of five sticky per-track latches by age mod 5 (a phase latches after an existence dip); set on a quarter of mature vehicle rows by day, 2 of 59,988 night rows.";
CM_ SG_ 1807 UNK_182_1 "Raw, unnamed.";
CM_ SG_ 1807 UNK_183_7 "Bit 183: velocity re-initialisation latch (five sticky per-track latches by age mod 5); bits 184-189 are the low bits of a secondary score byte 184|8 (percent: 100 on 98 % of rows; lower mostly on young tracks, far lateral objects and stationary large vehicles / pedestrians).";
CM_ SG_ 1807 UNK_190_10 "Bits 190-191 = top of the secondary score byte 184|8; bits 192-199 are zero.";
CM_ SG_ 1807 UNK_200_7 "Orientation uncertainty: about 3.1 * UNK_248_7 / speed (m/s) on moving objects; 63 for stopped objects, 127 sentinel. Keep all seven bits.";
CM_ SG_ 1807 CONST_207_1 "Constant in the captured data.";
CM_ SG_ 1807 UNK_208_6 "Coarse heading over ground, left positive, about pi/64 rad per code: matches floor(max(atan2(vy, vx), 0) * 64 / pi) on 98 % of settled moving samples; can update while both velocity codes hold.";
CM_ SG_ 1807 CONST_214_2 "Constant in the captured data.";
CM_ SG_ 1807 UNK_216_6 "Object width, about (code + 1) * 0.1 m: car ~1.8 m, large vehicle ~2.0 m, two-wheeler ~0.7 m, pedestrian ~0.5 m.";
CM_ SG_ 1807 CONST_222_2 "Constant in the captured data.";
CM_ SG_ 1807 UNK_224_7 "Range standard deviation (sigma dRel), about 0.23 m per count (0.24 below 40 m; beyond 40 m a 4-8 m error floor dominates): grows with range, shrinks with track age.";
CM_ SG_ 1807 CONST_231_1 "Constant in the captured data.";
CM_ SG_ 1807 UNK_232_8 "Lateral standard deviation (sigma yRel), about 0.10 m per count: grows with |yRel|, shrinks with age. Eight bits: far young tracks reach 128-255 (255 = saturated).";
CM_ SG_ 1807 UNK_240_7 "Longitudinal velocity standard deviation (sigma vx), about 0.043-0.045 m/s per count against the ACC target: grows with range, higher during velocity excursions below 40 m. 127 accompanies saturated velocity.";
CM_ SG_ 1807 CONST_247_1 "Constant in the captured data.";
CM_ SG_ 1807 UNK_248_7 "Lateral velocity standard deviation (sigma vy), linear in the code: about 0.085 + 0.03 m/s per count against stationary objects, about 0.09 per count on moving leads.";
CM_ SG_ 1807 CONST_255_1 "Constant in the captured data.";
CM_ SG_ 1807 UNK_256_8 "Longitudinal-acceleration uncertainty (sigma ax candidate): grows with the spread between ALONG_LIKE_84 and the track's own speed slope (about 0.06-0.07 m/s^2 per code pooled); within a range band it grades that spread only within about 20 m.";
CM_ SG_ 1807 UNK_264_8 "Lateral-acceleration uncertainty (sigma ay candidate), covariance-like: moves with UNK_248_7 in every range band and shrinks with track age (about 11 at age 5-10, 2 from age 60).";
CM_ SG_ 1807 UNK_272_5 "Coarse length code: about round(length / 0.555 m) for vehicles (within one code on 91 %); not a length for pedestrians / two-wheelers.";
CM_ SG_ 1807 UNK_277_11 "Raw; bit 277 rarely set on newborn tracks.";
CM_ BO_ 1808 "Reassembled 0x80 object slot 16 (record bytes 593-628), sent only when occupied. Little-endian bit field: bit 0 = LSB of slot byte 0.";
CM_ SG_ 1808 STATE_CODE "Track state: 0 deleted (the track's final age-0 record), 1 measured, 2 coasting (predicted without a new measurement). While 2, SCORE_CODE drops by 20 (or 1) per cycle.";
CM_ SG_ 1808 SLOT_INDEX_CODE "Physical slot index 0-19; 63 when the slot is unallocated.";
CM_ SG_ 1808 UNK_8_6 "Bits 8-12: startup code, min(30, floor(31 * (2/3)^max(age - 4, 0))) while the motion code is 5 (initializing). Bit 13: separate raw flag.";
CM_ SG_ 1808 ONCOMING_FLAG "Oncoming-like internal motion state. Can persist after slowing and reset before the native allocation ends.";
CM_ SG_ 1808 UNK_15_1 "Placeholder flag: set exactly on the age-1 first output whose range, lateral and size codes are placeholders.";
CM_ SG_ 1808 SCORE_CODE "Existence probability, percent (10-100): can decline in either state; drops by exactly 20 (or 1) per cycle in state 2 and may stay lowered after a return to state 1. Bits 20-22 are its bits 4-6 (score // 16). The slot is freed near 20.";
CM_ SG_ 1808 AGE "Track age in radar cycles (60 ms): 1 at birth, saturates at 126; 0 = slot retiring. A restart is a new track. Converged from about 60.";
CM_ SG_ 1808 CONST_31_1 "Constant in the captured data.";
CM_ SG_ 1808 DREL "Distance forward of the radar, m: (code - 160) / 16. Add 1.52 m (openpilot's RADAR_TO_CAMERA) for a camera-referenced distance; radard compares radar dRel with the vision distance minus 1.52 m.";
CM_ SG_ 1808 YREL_LEFT "Lateral offset, m, left positive: (code - 2048) * 0.015. |code - 2048| >= 2000 is a sentinel.";
CM_ SG_ 1808 UNK_56_7 "Object length, about 0.1 m per code: car ~4.9 m, large vehicle ~5.7 m, two-wheeler ~1.7 m, pedestrian ~0.4 m.";
CM_ SG_ 1808 UNK_63_1 "Raw, unnamed.";
CM_ SG_ 1808 VLONG_OVER_GROUND "Longitudinal velocity over ground, m/s: (code - 510.5) * 0.15. vRel = this - ego speed. Code 1023 is a saturated reading.";
CM_ SG_ 1808 VLAT_OVER_GROUND_PROV "Lateral velocity over ground, m/s, left positive: (code - 510.5) * about 0.142-0.155 (0.15 used).";
CM_ SG_ 1808 ALONG_LIKE_84 "Longitudinal acceleration over ground, filtered: (code - 510.3) * about 0.04-0.09 m/s^2 with ego stopped (estimate depends on drives and estimator); follows the track's own speed by about 0.3 s; moves by about 0.4 of ego's acceleration.";
CM_ SG_ 1808 CONST_94_2 "Constant in the captured data.";
CM_ SG_ 1808 UNK_96 "Lateral acceleration over ground, filtered: (code - 511) * 0.05 m/s^2; follows the kinematic value by about 0.5 s.";
CM_ SG_ 1808 UNK_106_1 "Raw, unnamed.";
CM_ SG_ 1808 UNK_107_1 "Predicted record (the radar's own prediction), like Tesla's Meas = 0: set on 45 % of a track's last five records, 2.6 % elsewhere.";
CM_ SG_ 1808 CONST_108_1 "Constant in the captured data.";
CM_ SG_ 1808 MOVE_STATE "Low two bits of the motion code. Full code = MOVE_STATE | (UNK_111_1 << 2): 0 moving forward, 1 slow or standing, 2 oncoming, 3 moving right, 4 moving left, 5 initializing, 7 stopped after moving.";
CM_ SG_ 1808 UNK_111_1 "Bit 2 of the motion code (see MOVE_STATE).";
CM_ SG_ 1808 UNK_112_3 "Camera-association state: 0 radar only, 1 (rarely 2-4) while the camera has the vehicle. By day non-zero on nearly all in-lane vehicles inside 40 m and almost never beyond 50 m; at night also at long range.";
CM_ SG_ 1808 UNK_115_5 "Class confidence in 5 % steps: mostly 0 while not yet classified (83 % of those rows), 4-20 otherwise (20 = 100 %); moves by one step per cycle on 95-96 % of its changes. A large vehicle is re-classified as a car when it falls to 5.";
CM_ SG_ 1808 UNK_120_3 "Raw; non-zero on 0.2 % of rows (mature cars).";
CM_ SG_ 1808 CONST_123_5 "Constant in the captured data.";
CM_ SG_ 1808 UNK_128_2 "Lane-assignment state, low bits (full = UNK_128_2 | UNK_130_1 << 2): 3 ego lane, 2 right lane, 4 left lane; 1, 5, 7 = no lane weights.";
CM_ SG_ 1808 UNK_130_1 "Lane-assignment state, bit 2 (see UNK_128_2).";
CM_ SG_ 1808 UNK_131_4 "Dominant lane weight: the largest of the three lane weights or one less (99.6 % of rows with a nonzero weight).";
CM_ SG_ 1808 CONST_135_1 "Constant in the captured data.";
CM_ SG_ 1808 UNK_136_4 "Camera-association confidence: 15 without association; restarts at 3-9 when UNK_112_3 becomes non-zero and climbs to 14.";
CM_ SG_ 1808 UNK_140_3 "Object class, second encoding of UNK_163_3: 0, 5, 7, 1, 3, 4 = class 1, 2, 3, 4, 5, 6.";
CM_ SG_ 1808 CONST_143_5 "Constant in the captured data.";
CM_ SG_ 1808 UNK_148_8 "Lane weights in 1/15 steps: low nibble (148|4) right lane, high nibble (152|4) left lane. With UNK_156_4 (ego lane) they sum to 15 or 16 whenever any is nonzero.";
CM_ SG_ 1808 UNK_156_4 "Ego-lane weight in 1/15 steps (see UNK_148_8).";
CM_ SG_ 1808 CONST_160_3 "Constant in the captured data.";
CM_ SG_ 1808 UNK_163_3 "Object class: 1 not yet classified, 2 car, 3 large vehicle, 4 pedestrian, 5 provisional (cyclist / person associations), 6 two-wheeler.";
CM_ SG_ 1808 UNK_166_2 "Raw, unnamed.";
CM_ SG_ 1808 UNK_168_10 "All ones or all zeros (768 / 832 rare): five sticky per-track latches by age mod 5; a phase latches on a cycle without a near-scan measurement, so most tracks born far out have it set from birth.";
CM_ SG_ 1808 CONST_178_3 "Constant in the captured data.";
CM_ SG_ 1808 UNK_181_1 "Daylight latch: one of five sticky per-track latches by age mod 5 (a phase latches after an existence dip); set on a quarter of mature vehicle rows by day, 2 of 59,988 night rows.";
CM_ SG_ 1808 UNK_182_1 "Raw, unnamed.";
CM_ SG_ 1808 UNK_183_7 "Bit 183: velocity re-initialisation latch (five sticky per-track latches by age mod 5); bits 184-189 are the low bits of a secondary score byte 184|8 (percent: 100 on 98 % of rows; lower mostly on young tracks, far lateral objects and stationary large vehicles / pedestrians).";
CM_ SG_ 1808 UNK_190_10 "Bits 190-191 = top of the secondary score byte 184|8; bits 192-199 are zero.";
CM_ SG_ 1808 UNK_200_7 "Orientation uncertainty: about 3.1 * UNK_248_7 / speed (m/s) on moving objects; 63 for stopped objects, 127 sentinel. Keep all seven bits.";
CM_ SG_ 1808 CONST_207_1 "Constant in the captured data.";
CM_ SG_ 1808 UNK_208_6 "Coarse heading over ground, left positive, about pi/64 rad per code: matches floor(max(atan2(vy, vx), 0) * 64 / pi) on 98 % of settled moving samples; can update while both velocity codes hold.";
CM_ SG_ 1808 CONST_214_2 "Constant in the captured data.";
CM_ SG_ 1808 UNK_216_6 "Object width, about (code + 1) * 0.1 m: car ~1.8 m, large vehicle ~2.0 m, two-wheeler ~0.7 m, pedestrian ~0.5 m.";
CM_ SG_ 1808 CONST_222_2 "Constant in the captured data.";
CM_ SG_ 1808 UNK_224_7 "Range standard deviation (sigma dRel), about 0.23 m per count (0.24 below 40 m; beyond 40 m a 4-8 m error floor dominates): grows with range, shrinks with track age.";
CM_ SG_ 1808 CONST_231_1 "Constant in the captured data.";
CM_ SG_ 1808 UNK_232_8 "Lateral standard deviation (sigma yRel), about 0.10 m per count: grows with |yRel|, shrinks with age. Eight bits: far young tracks reach 128-255 (255 = saturated).";
CM_ SG_ 1808 UNK_240_7 "Longitudinal velocity standard deviation (sigma vx), about 0.043-0.045 m/s per count against the ACC target: grows with range, higher during velocity excursions below 40 m. 127 accompanies saturated velocity.";
CM_ SG_ 1808 CONST_247_1 "Constant in the captured data.";
CM_ SG_ 1808 UNK_248_7 "Lateral velocity standard deviation (sigma vy), linear in the code: about 0.085 + 0.03 m/s per count against stationary objects, about 0.09 per count on moving leads.";
CM_ SG_ 1808 CONST_255_1 "Constant in the captured data.";
CM_ SG_ 1808 UNK_256_8 "Longitudinal-acceleration uncertainty (sigma ax candidate): grows with the spread between ALONG_LIKE_84 and the track's own speed slope (about 0.06-0.07 m/s^2 per code pooled); within a range band it grades that spread only within about 20 m.";
CM_ SG_ 1808 UNK_264_8 "Lateral-acceleration uncertainty (sigma ay candidate), covariance-like: moves with UNK_248_7 in every range band and shrinks with track age (about 11 at age 5-10, 2 from age 60).";
CM_ SG_ 1808 UNK_272_5 "Coarse length code: about round(length / 0.555 m) for vehicles (within one code on 91 %); not a length for pedestrians / two-wheelers.";
CM_ SG_ 1808 UNK_277_11 "Raw; bit 277 rarely set on newborn tracks.";
CM_ BO_ 1809 "Reassembled 0x80 object slot 17 (record bytes 629-664), sent only when occupied. Little-endian bit field: bit 0 = LSB of slot byte 0.";
CM_ SG_ 1809 STATE_CODE "Track state: 0 deleted (the track's final age-0 record), 1 measured, 2 coasting (predicted without a new measurement). While 2, SCORE_CODE drops by 20 (or 1) per cycle.";
CM_ SG_ 1809 SLOT_INDEX_CODE "Physical slot index 0-19; 63 when the slot is unallocated.";
CM_ SG_ 1809 UNK_8_6 "Bits 8-12: startup code, min(30, floor(31 * (2/3)^max(age - 4, 0))) while the motion code is 5 (initializing). Bit 13: separate raw flag.";
CM_ SG_ 1809 ONCOMING_FLAG "Oncoming-like internal motion state. Can persist after slowing and reset before the native allocation ends.";
CM_ SG_ 1809 UNK_15_1 "Placeholder flag: set exactly on the age-1 first output whose range, lateral and size codes are placeholders.";
CM_ SG_ 1809 SCORE_CODE "Existence probability, percent (10-100): can decline in either state; drops by exactly 20 (or 1) per cycle in state 2 and may stay lowered after a return to state 1. Bits 20-22 are its bits 4-6 (score // 16). The slot is freed near 20.";
CM_ SG_ 1809 AGE "Track age in radar cycles (60 ms): 1 at birth, saturates at 126; 0 = slot retiring. A restart is a new track. Converged from about 60.";
CM_ SG_ 1809 CONST_31_1 "Constant in the captured data.";
CM_ SG_ 1809 DREL "Distance forward of the radar, m: (code - 160) / 16. Add 1.52 m (openpilot's RADAR_TO_CAMERA) for a camera-referenced distance; radard compares radar dRel with the vision distance minus 1.52 m.";
CM_ SG_ 1809 YREL_LEFT "Lateral offset, m, left positive: (code - 2048) * 0.015. |code - 2048| >= 2000 is a sentinel.";
CM_ SG_ 1809 UNK_56_7 "Object length, about 0.1 m per code: car ~4.9 m, large vehicle ~5.7 m, two-wheeler ~1.7 m, pedestrian ~0.4 m.";
CM_ SG_ 1809 UNK_63_1 "Raw, unnamed.";
CM_ SG_ 1809 VLONG_OVER_GROUND "Longitudinal velocity over ground, m/s: (code - 510.5) * 0.15. vRel = this - ego speed. Code 1023 is a saturated reading.";
CM_ SG_ 1809 VLAT_OVER_GROUND_PROV "Lateral velocity over ground, m/s, left positive: (code - 510.5) * about 0.142-0.155 (0.15 used).";
CM_ SG_ 1809 ALONG_LIKE_84 "Longitudinal acceleration over ground, filtered: (code - 510.3) * about 0.04-0.09 m/s^2 with ego stopped (estimate depends on drives and estimator); follows the track's own speed by about 0.3 s; moves by about 0.4 of ego's acceleration.";
CM_ SG_ 1809 CONST_94_2 "Constant in the captured data.";
CM_ SG_ 1809 UNK_96 "Lateral acceleration over ground, filtered: (code - 511) * 0.05 m/s^2; follows the kinematic value by about 0.5 s.";
CM_ SG_ 1809 UNK_106_1 "Raw, unnamed.";
CM_ SG_ 1809 UNK_107_1 "Predicted record (the radar's own prediction), like Tesla's Meas = 0: set on 45 % of a track's last five records, 2.6 % elsewhere.";
CM_ SG_ 1809 CONST_108_1 "Constant in the captured data.";
CM_ SG_ 1809 MOVE_STATE "Low two bits of the motion code. Full code = MOVE_STATE | (UNK_111_1 << 2): 0 moving forward, 1 slow or standing, 2 oncoming, 3 moving right, 4 moving left, 5 initializing, 7 stopped after moving.";
CM_ SG_ 1809 UNK_111_1 "Bit 2 of the motion code (see MOVE_STATE).";
CM_ SG_ 1809 UNK_112_3 "Camera-association state: 0 radar only, 1 (rarely 2-4) while the camera has the vehicle. By day non-zero on nearly all in-lane vehicles inside 40 m and almost never beyond 50 m; at night also at long range.";
CM_ SG_ 1809 UNK_115_5 "Class confidence in 5 % steps: mostly 0 while not yet classified (83 % of those rows), 4-20 otherwise (20 = 100 %); moves by one step per cycle on 95-96 % of its changes. A large vehicle is re-classified as a car when it falls to 5.";
CM_ SG_ 1809 UNK_120_3 "Raw; non-zero on 0.2 % of rows (mature cars).";
CM_ SG_ 1809 CONST_123_5 "Constant in the captured data.";
CM_ SG_ 1809 UNK_128_2 "Lane-assignment state, low bits (full = UNK_128_2 | UNK_130_1 << 2): 3 ego lane, 2 right lane, 4 left lane; 1, 5, 7 = no lane weights.";
CM_ SG_ 1809 UNK_130_1 "Lane-assignment state, bit 2 (see UNK_128_2).";
CM_ SG_ 1809 UNK_131_4 "Dominant lane weight: the largest of the three lane weights or one less (99.6 % of rows with a nonzero weight).";
CM_ SG_ 1809 CONST_135_1 "Constant in the captured data.";
CM_ SG_ 1809 UNK_136_4 "Camera-association confidence: 15 without association; restarts at 3-9 when UNK_112_3 becomes non-zero and climbs to 14.";
CM_ SG_ 1809 UNK_140_3 "Object class, second encoding of UNK_163_3: 0, 5, 7, 1, 3, 4 = class 1, 2, 3, 4, 5, 6.";
CM_ SG_ 1809 CONST_143_5 "Constant in the captured data.";
CM_ SG_ 1809 UNK_148_8 "Lane weights in 1/15 steps: low nibble (148|4) right lane, high nibble (152|4) left lane. With UNK_156_4 (ego lane) they sum to 15 or 16 whenever any is nonzero.";
CM_ SG_ 1809 UNK_156_4 "Ego-lane weight in 1/15 steps (see UNK_148_8).";
CM_ SG_ 1809 CONST_160_3 "Constant in the captured data.";
CM_ SG_ 1809 UNK_163_3 "Object class: 1 not yet classified, 2 car, 3 large vehicle, 4 pedestrian, 5 provisional (cyclist / person associations), 6 two-wheeler.";
CM_ SG_ 1809 UNK_166_2 "Raw, unnamed.";
CM_ SG_ 1809 UNK_168_10 "All ones or all zeros (768 / 832 rare): five sticky per-track latches by age mod 5; a phase latches on a cycle without a near-scan measurement, so most tracks born far out have it set from birth.";
CM_ SG_ 1809 CONST_178_3 "Constant in the captured data.";
CM_ SG_ 1809 UNK_181_1 "Daylight latch: one of five sticky per-track latches by age mod 5 (a phase latches after an existence dip); set on a quarter of mature vehicle rows by day, 2 of 59,988 night rows.";
CM_ SG_ 1809 UNK_182_1 "Raw, unnamed.";
CM_ SG_ 1809 UNK_183_7 "Bit 183: velocity re-initialisation latch (five sticky per-track latches by age mod 5); bits 184-189 are the low bits of a secondary score byte 184|8 (percent: 100 on 98 % of rows; lower mostly on young tracks, far lateral objects and stationary large vehicles / pedestrians).";
CM_ SG_ 1809 UNK_190_10 "Bits 190-191 = top of the secondary score byte 184|8; bits 192-199 are zero.";
CM_ SG_ 1809 UNK_200_7 "Orientation uncertainty: about 3.1 * UNK_248_7 / speed (m/s) on moving objects; 63 for stopped objects, 127 sentinel. Keep all seven bits.";
CM_ SG_ 1809 CONST_207_1 "Constant in the captured data.";
CM_ SG_ 1809 UNK_208_6 "Coarse heading over ground, left positive, about pi/64 rad per code: matches floor(max(atan2(vy, vx), 0) * 64 / pi) on 98 % of settled moving samples; can update while both velocity codes hold.";
CM_ SG_ 1809 CONST_214_2 "Constant in the captured data.";
CM_ SG_ 1809 UNK_216_6 "Object width, about (code + 1) * 0.1 m: car ~1.8 m, large vehicle ~2.0 m, two-wheeler ~0.7 m, pedestrian ~0.5 m.";
CM_ SG_ 1809 CONST_222_2 "Constant in the captured data.";
CM_ SG_ 1809 UNK_224_7 "Range standard deviation (sigma dRel), about 0.23 m per count (0.24 below 40 m; beyond 40 m a 4-8 m error floor dominates): grows with range, shrinks with track age.";
CM_ SG_ 1809 CONST_231_1 "Constant in the captured data.";
CM_ SG_ 1809 UNK_232_8 "Lateral standard deviation (sigma yRel), about 0.10 m per count: grows with |yRel|, shrinks with age. Eight bits: far young tracks reach 128-255 (255 = saturated).";
CM_ SG_ 1809 UNK_240_7 "Longitudinal velocity standard deviation (sigma vx), about 0.043-0.045 m/s per count against the ACC target: grows with range, higher during velocity excursions below 40 m. 127 accompanies saturated velocity.";
CM_ SG_ 1809 CONST_247_1 "Constant in the captured data.";
CM_ SG_ 1809 UNK_248_7 "Lateral velocity standard deviation (sigma vy), linear in the code: about 0.085 + 0.03 m/s per count against stationary objects, about 0.09 per count on moving leads.";
CM_ SG_ 1809 CONST_255_1 "Constant in the captured data.";
CM_ SG_ 1809 UNK_256_8 "Longitudinal-acceleration uncertainty (sigma ax candidate): grows with the spread between ALONG_LIKE_84 and the track's own speed slope (about 0.06-0.07 m/s^2 per code pooled); within a range band it grades that spread only within about 20 m.";
CM_ SG_ 1809 UNK_264_8 "Lateral-acceleration uncertainty (sigma ay candidate), covariance-like: moves with UNK_248_7 in every range band and shrinks with track age (about 11 at age 5-10, 2 from age 60).";
CM_ SG_ 1809 UNK_272_5 "Coarse length code: about round(length / 0.555 m) for vehicles (within one code on 91 %); not a length for pedestrians / two-wheelers.";
CM_ SG_ 1809 UNK_277_11 "Raw; bit 277 rarely set on newborn tracks.";
CM_ BO_ 1810 "Reassembled 0x80 object slot 18 (record bytes 665-700), sent only when occupied. Little-endian bit field: bit 0 = LSB of slot byte 0.";
CM_ SG_ 1810 STATE_CODE "Track state: 0 deleted (the track's final age-0 record), 1 measured, 2 coasting (predicted without a new measurement). While 2, SCORE_CODE drops by 20 (or 1) per cycle.";
CM_ SG_ 1810 SLOT_INDEX_CODE "Physical slot index 0-19; 63 when the slot is unallocated.";
CM_ SG_ 1810 UNK_8_6 "Bits 8-12: startup code, min(30, floor(31 * (2/3)^max(age - 4, 0))) while the motion code is 5 (initializing). Bit 13: separate raw flag.";
CM_ SG_ 1810 ONCOMING_FLAG "Oncoming-like internal motion state. Can persist after slowing and reset before the native allocation ends.";
CM_ SG_ 1810 UNK_15_1 "Placeholder flag: set exactly on the age-1 first output whose range, lateral and size codes are placeholders.";
CM_ SG_ 1810 SCORE_CODE "Existence probability, percent (10-100): can decline in either state; drops by exactly 20 (or 1) per cycle in state 2 and may stay lowered after a return to state 1. Bits 20-22 are its bits 4-6 (score // 16). The slot is freed near 20.";
CM_ SG_ 1810 AGE "Track age in radar cycles (60 ms): 1 at birth, saturates at 126; 0 = slot retiring. A restart is a new track. Converged from about 60.";
CM_ SG_ 1810 CONST_31_1 "Constant in the captured data.";
CM_ SG_ 1810 DREL "Distance forward of the radar, m: (code - 160) / 16. Add 1.52 m (openpilot's RADAR_TO_CAMERA) for a camera-referenced distance; radard compares radar dRel with the vision distance minus 1.52 m.";
CM_ SG_ 1810 YREL_LEFT "Lateral offset, m, left positive: (code - 2048) * 0.015. |code - 2048| >= 2000 is a sentinel.";
CM_ SG_ 1810 UNK_56_7 "Object length, about 0.1 m per code: car ~4.9 m, large vehicle ~5.7 m, two-wheeler ~1.7 m, pedestrian ~0.4 m.";
CM_ SG_ 1810 UNK_63_1 "Raw, unnamed.";
CM_ SG_ 1810 VLONG_OVER_GROUND "Longitudinal velocity over ground, m/s: (code - 510.5) * 0.15. vRel = this - ego speed. Code 1023 is a saturated reading.";
CM_ SG_ 1810 VLAT_OVER_GROUND_PROV "Lateral velocity over ground, m/s, left positive: (code - 510.5) * about 0.142-0.155 (0.15 used).";
CM_ SG_ 1810 ALONG_LIKE_84 "Longitudinal acceleration over ground, filtered: (code - 510.3) * about 0.04-0.09 m/s^2 with ego stopped (estimate depends on drives and estimator); follows the track's own speed by about 0.3 s; moves by about 0.4 of ego's acceleration.";
CM_ SG_ 1810 CONST_94_2 "Constant in the captured data.";
CM_ SG_ 1810 UNK_96 "Lateral acceleration over ground, filtered: (code - 511) * 0.05 m/s^2; follows the kinematic value by about 0.5 s.";
CM_ SG_ 1810 UNK_106_1 "Raw, unnamed.";
CM_ SG_ 1810 UNK_107_1 "Predicted record (the radar's own prediction), like Tesla's Meas = 0: set on 45 % of a track's last five records, 2.6 % elsewhere.";
CM_ SG_ 1810 CONST_108_1 "Constant in the captured data.";
CM_ SG_ 1810 MOVE_STATE "Low two bits of the motion code. Full code = MOVE_STATE | (UNK_111_1 << 2): 0 moving forward, 1 slow or standing, 2 oncoming, 3 moving right, 4 moving left, 5 initializing, 7 stopped after moving.";
CM_ SG_ 1810 UNK_111_1 "Bit 2 of the motion code (see MOVE_STATE).";
CM_ SG_ 1810 UNK_112_3 "Camera-association state: 0 radar only, 1 (rarely 2-4) while the camera has the vehicle. By day non-zero on nearly all in-lane vehicles inside 40 m and almost never beyond 50 m; at night also at long range.";
CM_ SG_ 1810 UNK_115_5 "Class confidence in 5 % steps: mostly 0 while not yet classified (83 % of those rows), 4-20 otherwise (20 = 100 %); moves by one step per cycle on 95-96 % of its changes. A large vehicle is re-classified as a car when it falls to 5.";
CM_ SG_ 1810 UNK_120_3 "Raw; non-zero on 0.2 % of rows (mature cars).";
CM_ SG_ 1810 CONST_123_5 "Constant in the captured data.";
CM_ SG_ 1810 UNK_128_2 "Lane-assignment state, low bits (full = UNK_128_2 | UNK_130_1 << 2): 3 ego lane, 2 right lane, 4 left lane; 1, 5, 7 = no lane weights.";
CM_ SG_ 1810 UNK_130_1 "Lane-assignment state, bit 2 (see UNK_128_2).";
CM_ SG_ 1810 UNK_131_4 "Dominant lane weight: the largest of the three lane weights or one less (99.6 % of rows with a nonzero weight).";
CM_ SG_ 1810 CONST_135_1 "Constant in the captured data.";
CM_ SG_ 1810 UNK_136_4 "Camera-association confidence: 15 without association; restarts at 3-9 when UNK_112_3 becomes non-zero and climbs to 14.";
CM_ SG_ 1810 UNK_140_3 "Object class, second encoding of UNK_163_3: 0, 5, 7, 1, 3, 4 = class 1, 2, 3, 4, 5, 6.";
CM_ SG_ 1810 CONST_143_5 "Constant in the captured data.";
CM_ SG_ 1810 UNK_148_8 "Lane weights in 1/15 steps: low nibble (148|4) right lane, high nibble (152|4) left lane. With UNK_156_4 (ego lane) they sum to 15 or 16 whenever any is nonzero.";
CM_ SG_ 1810 UNK_156_4 "Ego-lane weight in 1/15 steps (see UNK_148_8).";
CM_ SG_ 1810 CONST_160_3 "Constant in the captured data.";
CM_ SG_ 1810 UNK_163_3 "Object class: 1 not yet classified, 2 car, 3 large vehicle, 4 pedestrian, 5 provisional (cyclist / person associations), 6 two-wheeler.";
CM_ SG_ 1810 UNK_166_2 "Raw, unnamed.";
CM_ SG_ 1810 UNK_168_10 "All ones or all zeros (768 / 832 rare): five sticky per-track latches by age mod 5; a phase latches on a cycle without a near-scan measurement, so most tracks born far out have it set from birth.";
CM_ SG_ 1810 CONST_178_3 "Constant in the captured data.";
CM_ SG_ 1810 UNK_181_1 "Daylight latch: one of five sticky per-track latches by age mod 5 (a phase latches after an existence dip); set on a quarter of mature vehicle rows by day, 2 of 59,988 night rows.";
CM_ SG_ 1810 UNK_182_1 "Raw, unnamed.";
CM_ SG_ 1810 UNK_183_7 "Bit 183: velocity re-initialisation latch (five sticky per-track latches by age mod 5); bits 184-189 are the low bits of a secondary score byte 184|8 (percent: 100 on 98 % of rows; lower mostly on young tracks, far lateral objects and stationary large vehicles / pedestrians).";
CM_ SG_ 1810 UNK_190_10 "Bits 190-191 = top of the secondary score byte 184|8; bits 192-199 are zero.";
CM_ SG_ 1810 UNK_200_7 "Orientation uncertainty: about 3.1 * UNK_248_7 / speed (m/s) on moving objects; 63 for stopped objects, 127 sentinel. Keep all seven bits.";
CM_ SG_ 1810 CONST_207_1 "Constant in the captured data.";
CM_ SG_ 1810 UNK_208_6 "Coarse heading over ground, left positive, about pi/64 rad per code: matches floor(max(atan2(vy, vx), 0) * 64 / pi) on 98 % of settled moving samples; can update while both velocity codes hold.";
CM_ SG_ 1810 CONST_214_2 "Constant in the captured data.";
CM_ SG_ 1810 UNK_216_6 "Object width, about (code + 1) * 0.1 m: car ~1.8 m, large vehicle ~2.0 m, two-wheeler ~0.7 m, pedestrian ~0.5 m.";
CM_ SG_ 1810 CONST_222_2 "Constant in the captured data.";
CM_ SG_ 1810 UNK_224_7 "Range standard deviation (sigma dRel), about 0.23 m per count (0.24 below 40 m; beyond 40 m a 4-8 m error floor dominates): grows with range, shrinks with track age.";
CM_ SG_ 1810 CONST_231_1 "Constant in the captured data.";
CM_ SG_ 1810 UNK_232_8 "Lateral standard deviation (sigma yRel), about 0.10 m per count: grows with |yRel|, shrinks with age. Eight bits: far young tracks reach 128-255 (255 = saturated).";
CM_ SG_ 1810 UNK_240_7 "Longitudinal velocity standard deviation (sigma vx), about 0.043-0.045 m/s per count against the ACC target: grows with range, higher during velocity excursions below 40 m. 127 accompanies saturated velocity.";
CM_ SG_ 1810 CONST_247_1 "Constant in the captured data.";
CM_ SG_ 1810 UNK_248_7 "Lateral velocity standard deviation (sigma vy), linear in the code: about 0.085 + 0.03 m/s per count against stationary objects, about 0.09 per count on moving leads.";
CM_ SG_ 1810 CONST_255_1 "Constant in the captured data.";
CM_ SG_ 1810 UNK_256_8 "Longitudinal-acceleration uncertainty (sigma ax candidate): grows with the spread between ALONG_LIKE_84 and the track's own speed slope (about 0.06-0.07 m/s^2 per code pooled); within a range band it grades that spread only within about 20 m.";
CM_ SG_ 1810 UNK_264_8 "Lateral-acceleration uncertainty (sigma ay candidate), covariance-like: moves with UNK_248_7 in every range band and shrinks with track age (about 11 at age 5-10, 2 from age 60).";
CM_ SG_ 1810 UNK_272_5 "Coarse length code: about round(length / 0.555 m) for vehicles (within one code on 91 %); not a length for pedestrians / two-wheelers.";
CM_ SG_ 1810 UNK_277_11 "Raw; bit 277 rarely set on newborn tracks.";
CM_ BO_ 1811 "Reassembled 0x80 object slot 19 (record bytes 701-736), sent only when occupied. Little-endian bit field: bit 0 = LSB of slot byte 0.";
CM_ SG_ 1811 STATE_CODE "Track state: 0 deleted (the track's final age-0 record), 1 measured, 2 coasting (predicted without a new measurement). While 2, SCORE_CODE drops by 20 (or 1) per cycle.";
CM_ SG_ 1811 SLOT_INDEX_CODE "Physical slot index 0-19; 63 when the slot is unallocated.";
CM_ SG_ 1811 UNK_8_6 "Bits 8-12: startup code, min(30, floor(31 * (2/3)^max(age - 4, 0))) while the motion code is 5 (initializing). Bit 13: separate raw flag.";
CM_ SG_ 1811 ONCOMING_FLAG "Oncoming-like internal motion state. Can persist after slowing and reset before the native allocation ends.";
CM_ SG_ 1811 UNK_15_1 "Placeholder flag: set exactly on the age-1 first output whose range, lateral and size codes are placeholders.";
CM_ SG_ 1811 SCORE_CODE "Existence probability, percent (10-100): can decline in either state; drops by exactly 20 (or 1) per cycle in state 2 and may stay lowered after a return to state 1. Bits 20-22 are its bits 4-6 (score // 16). The slot is freed near 20.";
CM_ SG_ 1811 AGE "Track age in radar cycles (60 ms): 1 at birth, saturates at 126; 0 = slot retiring. A restart is a new track. Converged from about 60.";
CM_ SG_ 1811 CONST_31_1 "Constant in the captured data.";
CM_ SG_ 1811 DREL "Distance forward of the radar, m: (code - 160) / 16. Add 1.52 m (openpilot's RADAR_TO_CAMERA) for a camera-referenced distance; radard compares radar dRel with the vision distance minus 1.52 m.";
CM_ SG_ 1811 YREL_LEFT "Lateral offset, m, left positive: (code - 2048) * 0.015. |code - 2048| >= 2000 is a sentinel.";
CM_ SG_ 1811 UNK_56_7 "Object length, about 0.1 m per code: car ~4.9 m, large vehicle ~5.7 m, two-wheeler ~1.7 m, pedestrian ~0.4 m.";
CM_ SG_ 1811 UNK_63_1 "Raw, unnamed.";
CM_ SG_ 1811 VLONG_OVER_GROUND "Longitudinal velocity over ground, m/s: (code - 510.5) * 0.15. vRel = this - ego speed. Code 1023 is a saturated reading.";
CM_ SG_ 1811 VLAT_OVER_GROUND_PROV "Lateral velocity over ground, m/s, left positive: (code - 510.5) * about 0.142-0.155 (0.15 used).";
CM_ SG_ 1811 ALONG_LIKE_84 "Longitudinal acceleration over ground, filtered: (code - 510.3) * about 0.04-0.09 m/s^2 with ego stopped (estimate depends on drives and estimator); follows the track's own speed by about 0.3 s; moves by about 0.4 of ego's acceleration.";
CM_ SG_ 1811 CONST_94_2 "Constant in the captured data.";
CM_ SG_ 1811 UNK_96 "Lateral acceleration over ground, filtered: (code - 511) * 0.05 m/s^2; follows the kinematic value by about 0.5 s.";
CM_ SG_ 1811 UNK_106_1 "Raw, unnamed.";
CM_ SG_ 1811 UNK_107_1 "Predicted record (the radar's own prediction), like Tesla's Meas = 0: set on 45 % of a track's last five records, 2.6 % elsewhere.";
CM_ SG_ 1811 CONST_108_1 "Constant in the captured data.";
CM_ SG_ 1811 MOVE_STATE "Low two bits of the motion code. Full code = MOVE_STATE | (UNK_111_1 << 2): 0 moving forward, 1 slow or standing, 2 oncoming, 3 moving right, 4 moving left, 5 initializing, 7 stopped after moving.";
CM_ SG_ 1811 UNK_111_1 "Bit 2 of the motion code (see MOVE_STATE).";
CM_ SG_ 1811 UNK_112_3 "Camera-association state: 0 radar only, 1 (rarely 2-4) while the camera has the vehicle. By day non-zero on nearly all in-lane vehicles inside 40 m and almost never beyond 50 m; at night also at long range.";
CM_ SG_ 1811 UNK_115_5 "Class confidence in 5 % steps: mostly 0 while not yet classified (83 % of those rows), 4-20 otherwise (20 = 100 %); moves by one step per cycle on 95-96 % of its changes. A large vehicle is re-classified as a car when it falls to 5.";
CM_ SG_ 1811 UNK_120_3 "Raw; non-zero on 0.2 % of rows (mature cars).";
CM_ SG_ 1811 CONST_123_5 "Constant in the captured data.";
CM_ SG_ 1811 UNK_128_2 "Lane-assignment state, low bits (full = UNK_128_2 | UNK_130_1 << 2): 3 ego lane, 2 right lane, 4 left lane; 1, 5, 7 = no lane weights.";
CM_ SG_ 1811 UNK_130_1 "Lane-assignment state, bit 2 (see UNK_128_2).";
CM_ SG_ 1811 UNK_131_4 "Dominant lane weight: the largest of the three lane weights or one less (99.6 % of rows with a nonzero weight).";
CM_ SG_ 1811 CONST_135_1 "Constant in the captured data.";
CM_ SG_ 1811 UNK_136_4 "Camera-association confidence: 15 without association; restarts at 3-9 when UNK_112_3 becomes non-zero and climbs to 14.";
CM_ SG_ 1811 UNK_140_3 "Object class, second encoding of UNK_163_3: 0, 5, 7, 1, 3, 4 = class 1, 2, 3, 4, 5, 6.";
CM_ SG_ 1811 CONST_143_5 "Constant in the captured data.";
CM_ SG_ 1811 UNK_148_8 "Lane weights in 1/15 steps: low nibble (148|4) right lane, high nibble (152|4) left lane. With UNK_156_4 (ego lane) they sum to 15 or 16 whenever any is nonzero.";
CM_ SG_ 1811 UNK_156_4 "Ego-lane weight in 1/15 steps (see UNK_148_8).";
CM_ SG_ 1811 CONST_160_3 "Constant in the captured data.";
CM_ SG_ 1811 UNK_163_3 "Object class: 1 not yet classified, 2 car, 3 large vehicle, 4 pedestrian, 5 provisional (cyclist / person associations), 6 two-wheeler.";
CM_ SG_ 1811 UNK_166_2 "Raw, unnamed.";
CM_ SG_ 1811 UNK_168_10 "All ones or all zeros (768 / 832 rare): five sticky per-track latches by age mod 5; a phase latches on a cycle without a near-scan measurement, so most tracks born far out have it set from birth.";
CM_ SG_ 1811 CONST_178_3 "Constant in the captured data.";
CM_ SG_ 1811 UNK_181_1 "Daylight latch: one of five sticky per-track latches by age mod 5 (a phase latches after an existence dip); set on a quarter of mature vehicle rows by day, 2 of 59,988 night rows.";
CM_ SG_ 1811 UNK_182_1 "Raw, unnamed.";
CM_ SG_ 1811 UNK_183_7 "Bit 183: velocity re-initialisation latch (five sticky per-track latches by age mod 5); bits 184-189 are the low bits of a secondary score byte 184|8 (percent: 100 on 98 % of rows; lower mostly on young tracks, far lateral objects and stationary large vehicles / pedestrians).";
CM_ SG_ 1811 UNK_190_10 "Bits 190-191 = top of the secondary score byte 184|8; bits 192-199 are zero.";
CM_ SG_ 1811 UNK_200_7 "Orientation uncertainty: about 3.1 * UNK_248_7 / speed (m/s) on moving objects; 63 for stopped objects, 127 sentinel. Keep all seven bits.";
CM_ SG_ 1811 CONST_207_1 "Constant in the captured data.";
CM_ SG_ 1811 UNK_208_6 "Coarse heading over ground, left positive, about pi/64 rad per code: matches floor(max(atan2(vy, vx), 0) * 64 / pi) on 98 % of settled moving samples; can update while both velocity codes hold.";
CM_ SG_ 1811 CONST_214_2 "Constant in the captured data.";
CM_ SG_ 1811 UNK_216_6 "Object width, about (code + 1) * 0.1 m: car ~1.8 m, large vehicle ~2.0 m, two-wheeler ~0.7 m, pedestrian ~0.5 m.";
CM_ SG_ 1811 CONST_222_2 "Constant in the captured data.";
CM_ SG_ 1811 UNK_224_7 "Range standard deviation (sigma dRel), about 0.23 m per count (0.24 below 40 m; beyond 40 m a 4-8 m error floor dominates): grows with range, shrinks with track age.";
CM_ SG_ 1811 CONST_231_1 "Constant in the captured data.";
CM_ SG_ 1811 UNK_232_8 "Lateral standard deviation (sigma yRel), about 0.10 m per count: grows with |yRel|, shrinks with age. Eight bits: far young tracks reach 128-255 (255 = saturated).";
CM_ SG_ 1811 UNK_240_7 "Longitudinal velocity standard deviation (sigma vx), about 0.043-0.045 m/s per count against the ACC target: grows with range, higher during velocity excursions below 40 m. 127 accompanies saturated velocity.";
CM_ SG_ 1811 CONST_247_1 "Constant in the captured data.";
CM_ SG_ 1811 UNK_248_7 "Lateral velocity standard deviation (sigma vy), linear in the code: about 0.085 + 0.03 m/s per count against stationary objects, about 0.09 per count on moving leads.";
CM_ SG_ 1811 CONST_255_1 "Constant in the captured data.";
CM_ SG_ 1811 UNK_256_8 "Longitudinal-acceleration uncertainty (sigma ax candidate): grows with the spread between ALONG_LIKE_84 and the track's own speed slope (about 0.06-0.07 m/s^2 per code pooled); within a range band it grades that spread only within about 20 m.";
CM_ SG_ 1811 UNK_264_8 "Lateral-acceleration uncertainty (sigma ay candidate), covariance-like: moves with UNK_248_7 in every range band and shrinks with track age (about 11 at age 5-10, 2 from age 60).";
CM_ SG_ 1811 UNK_272_5 "Coarse length code: about round(length / 0.555 m) for vehicles (within one code on 91 %); not a length for pedestrians / two-wheelers.";
CM_ SG_ 1811 UNK_277_11 "Raw; bit 277 rarely set on newborn tracks.";
CM_ BO_ 1824 "Derived values the ars510 interface computes for 0x80 slot 0, for plotting next to the raw fields.";
CM_ SG_ 1824 TRACK_ID_OP "trackId openpilot would see under the raw profile, BASE_CONFIG (held until age 60, re-link within 3.5 s); 0 when not published.";
CM_ SG_ 1824 TRACK_ID_RAW "trackId from the radar slot/age lifecycle alone (ALL_TRACKS_CONFIG).";
CM_ SG_ 1824 VREL "VLONG_OVER_GROUND - Toyota 0xB4 speed, m/s.";
CM_ SG_ 1824 V_EGO_0xB4 "Toyota 0xB4 SPEED used for VREL, m/s (reads ~1-1.5% below GPS / wheel speed).";
CM_ SG_ 1824 DREL_FUSED "Velocity-aided range (range_fusion_gain 0.1, part of the fused profile); cuts short-term range walks by about a third.";
CM_ SG_ 1824 VREL_KALMAN "vRel from the fused profile's Kalman speed filter (object list and ACC target weighted by their uncertainty), on every track from age 1 and at the nominal 0.15 m/s per code.";
CM_ BO_ 1825 "Derived values the ars510 interface computes for 0x80 slot 1, for plotting next to the raw fields.";
CM_ SG_ 1825 TRACK_ID_OP "trackId openpilot would see under the raw profile, BASE_CONFIG (held until age 60, re-link within 3.5 s); 0 when not published.";
CM_ SG_ 1825 TRACK_ID_RAW "trackId from the radar slot/age lifecycle alone (ALL_TRACKS_CONFIG).";
CM_ SG_ 1825 VREL "VLONG_OVER_GROUND - Toyota 0xB4 speed, m/s.";
CM_ SG_ 1825 V_EGO_0xB4 "Toyota 0xB4 SPEED used for VREL, m/s (reads ~1-1.5% below GPS / wheel speed).";
CM_ SG_ 1825 DREL_FUSED "Velocity-aided range (range_fusion_gain 0.1, part of the fused profile); cuts short-term range walks by about a third.";
CM_ SG_ 1825 VREL_KALMAN "vRel from the fused profile's Kalman speed filter (object list and ACC target weighted by their uncertainty), on every track from age 1 and at the nominal 0.15 m/s per code.";
CM_ BO_ 1826 "Derived values the ars510 interface computes for 0x80 slot 2, for plotting next to the raw fields.";
CM_ SG_ 1826 TRACK_ID_OP "trackId openpilot would see under the raw profile, BASE_CONFIG (held until age 60, re-link within 3.5 s); 0 when not published.";
CM_ SG_ 1826 TRACK_ID_RAW "trackId from the radar slot/age lifecycle alone (ALL_TRACKS_CONFIG).";
CM_ SG_ 1826 VREL "VLONG_OVER_GROUND - Toyota 0xB4 speed, m/s.";
CM_ SG_ 1826 V_EGO_0xB4 "Toyota 0xB4 SPEED used for VREL, m/s (reads ~1-1.5% below GPS / wheel speed).";
CM_ SG_ 1826 DREL_FUSED "Velocity-aided range (range_fusion_gain 0.1, part of the fused profile); cuts short-term range walks by about a third.";
CM_ SG_ 1826 VREL_KALMAN "vRel from the fused profile's Kalman speed filter (object list and ACC target weighted by their uncertainty), on every track from age 1 and at the nominal 0.15 m/s per code.";
CM_ BO_ 1827 "Derived values the ars510 interface computes for 0x80 slot 3, for plotting next to the raw fields.";
CM_ SG_ 1827 TRACK_ID_OP "trackId openpilot would see under the raw profile, BASE_CONFIG (held until age 60, re-link within 3.5 s); 0 when not published.";
CM_ SG_ 1827 TRACK_ID_RAW "trackId from the radar slot/age lifecycle alone (ALL_TRACKS_CONFIG).";
CM_ SG_ 1827 VREL "VLONG_OVER_GROUND - Toyota 0xB4 speed, m/s.";
CM_ SG_ 1827 V_EGO_0xB4 "Toyota 0xB4 SPEED used for VREL, m/s (reads ~1-1.5% below GPS / wheel speed).";
CM_ SG_ 1827 DREL_FUSED "Velocity-aided range (range_fusion_gain 0.1, part of the fused profile); cuts short-term range walks by about a third.";
CM_ SG_ 1827 VREL_KALMAN "vRel from the fused profile's Kalman speed filter (object list and ACC target weighted by their uncertainty), on every track from age 1 and at the nominal 0.15 m/s per code.";
CM_ BO_ 1828 "Derived values the ars510 interface computes for 0x80 slot 4, for plotting next to the raw fields.";
CM_ SG_ 1828 TRACK_ID_OP "trackId openpilot would see under the raw profile, BASE_CONFIG (held until age 60, re-link within 3.5 s); 0 when not published.";
CM_ SG_ 1828 TRACK_ID_RAW "trackId from the radar slot/age lifecycle alone (ALL_TRACKS_CONFIG).";
CM_ SG_ 1828 VREL "VLONG_OVER_GROUND - Toyota 0xB4 speed, m/s.";
CM_ SG_ 1828 V_EGO_0xB4 "Toyota 0xB4 SPEED used for VREL, m/s (reads ~1-1.5% below GPS / wheel speed).";
CM_ SG_ 1828 DREL_FUSED "Velocity-aided range (range_fusion_gain 0.1, part of the fused profile); cuts short-term range walks by about a third.";
CM_ SG_ 1828 VREL_KALMAN "vRel from the fused profile's Kalman speed filter (object list and ACC target weighted by their uncertainty), on every track from age 1 and at the nominal 0.15 m/s per code.";
CM_ BO_ 1829 "Derived values the ars510 interface computes for 0x80 slot 5, for plotting next to the raw fields.";
CM_ SG_ 1829 TRACK_ID_OP "trackId openpilot would see under the raw profile, BASE_CONFIG (held until age 60, re-link within 3.5 s); 0 when not published.";
CM_ SG_ 1829 TRACK_ID_RAW "trackId from the radar slot/age lifecycle alone (ALL_TRACKS_CONFIG).";
CM_ SG_ 1829 VREL "VLONG_OVER_GROUND - Toyota 0xB4 speed, m/s.";
CM_ SG_ 1829 V_EGO_0xB4 "Toyota 0xB4 SPEED used for VREL, m/s (reads ~1-1.5% below GPS / wheel speed).";
CM_ SG_ 1829 DREL_FUSED "Velocity-aided range (range_fusion_gain 0.1, part of the fused profile); cuts short-term range walks by about a third.";
CM_ SG_ 1829 VREL_KALMAN "vRel from the fused profile's Kalman speed filter (object list and ACC target weighted by their uncertainty), on every track from age 1 and at the nominal 0.15 m/s per code.";
CM_ BO_ 1830 "Derived values the ars510 interface computes for 0x80 slot 6, for plotting next to the raw fields.";
CM_ SG_ 1830 TRACK_ID_OP "trackId openpilot would see under the raw profile, BASE_CONFIG (held until age 60, re-link within 3.5 s); 0 when not published.";
CM_ SG_ 1830 TRACK_ID_RAW "trackId from the radar slot/age lifecycle alone (ALL_TRACKS_CONFIG).";
CM_ SG_ 1830 VREL "VLONG_OVER_GROUND - Toyota 0xB4 speed, m/s.";
CM_ SG_ 1830 V_EGO_0xB4 "Toyota 0xB4 SPEED used for VREL, m/s (reads ~1-1.5% below GPS / wheel speed).";
CM_ SG_ 1830 DREL_FUSED "Velocity-aided range (range_fusion_gain 0.1, part of the fused profile); cuts short-term range walks by about a third.";
CM_ SG_ 1830 VREL_KALMAN "vRel from the fused profile's Kalman speed filter (object list and ACC target weighted by their uncertainty), on every track from age 1 and at the nominal 0.15 m/s per code.";
CM_ BO_ 1831 "Derived values the ars510 interface computes for 0x80 slot 7, for plotting next to the raw fields.";
CM_ SG_ 1831 TRACK_ID_OP "trackId openpilot would see under the raw profile, BASE_CONFIG (held until age 60, re-link within 3.5 s); 0 when not published.";
CM_ SG_ 1831 TRACK_ID_RAW "trackId from the radar slot/age lifecycle alone (ALL_TRACKS_CONFIG).";
CM_ SG_ 1831 VREL "VLONG_OVER_GROUND - Toyota 0xB4 speed, m/s.";
CM_ SG_ 1831 V_EGO_0xB4 "Toyota 0xB4 SPEED used for VREL, m/s (reads ~1-1.5% below GPS / wheel speed).";
CM_ SG_ 1831 DREL_FUSED "Velocity-aided range (range_fusion_gain 0.1, part of the fused profile); cuts short-term range walks by about a third.";
CM_ SG_ 1831 VREL_KALMAN "vRel from the fused profile's Kalman speed filter (object list and ACC target weighted by their uncertainty), on every track from age 1 and at the nominal 0.15 m/s per code.";
CM_ BO_ 1832 "Derived values the ars510 interface computes for 0x80 slot 8, for plotting next to the raw fields.";
CM_ SG_ 1832 TRACK_ID_OP "trackId openpilot would see under the raw profile, BASE_CONFIG (held until age 60, re-link within 3.5 s); 0 when not published.";
CM_ SG_ 1832 TRACK_ID_RAW "trackId from the radar slot/age lifecycle alone (ALL_TRACKS_CONFIG).";
CM_ SG_ 1832 VREL "VLONG_OVER_GROUND - Toyota 0xB4 speed, m/s.";
CM_ SG_ 1832 V_EGO_0xB4 "Toyota 0xB4 SPEED used for VREL, m/s (reads ~1-1.5% below GPS / wheel speed).";
CM_ SG_ 1832 DREL_FUSED "Velocity-aided range (range_fusion_gain 0.1, part of the fused profile); cuts short-term range walks by about a third.";
CM_ SG_ 1832 VREL_KALMAN "vRel from the fused profile's Kalman speed filter (object list and ACC target weighted by their uncertainty), on every track from age 1 and at the nominal 0.15 m/s per code.";
CM_ BO_ 1833 "Derived values the ars510 interface computes for 0x80 slot 9, for plotting next to the raw fields.";
CM_ SG_ 1833 TRACK_ID_OP "trackId openpilot would see under the raw profile, BASE_CONFIG (held until age 60, re-link within 3.5 s); 0 when not published.";
CM_ SG_ 1833 TRACK_ID_RAW "trackId from the radar slot/age lifecycle alone (ALL_TRACKS_CONFIG).";
CM_ SG_ 1833 VREL "VLONG_OVER_GROUND - Toyota 0xB4 speed, m/s.";
CM_ SG_ 1833 V_EGO_0xB4 "Toyota 0xB4 SPEED used for VREL, m/s (reads ~1-1.5% below GPS / wheel speed).";
CM_ SG_ 1833 DREL_FUSED "Velocity-aided range (range_fusion_gain 0.1, part of the fused profile); cuts short-term range walks by about a third.";
CM_ SG_ 1833 VREL_KALMAN "vRel from the fused profile's Kalman speed filter (object list and ACC target weighted by their uncertainty), on every track from age 1 and at the nominal 0.15 m/s per code.";
CM_ BO_ 1834 "Derived values the ars510 interface computes for 0x80 slot 10, for plotting next to the raw fields.";
CM_ SG_ 1834 TRACK_ID_OP "trackId openpilot would see under the raw profile, BASE_CONFIG (held until age 60, re-link within 3.5 s); 0 when not published.";
CM_ SG_ 1834 TRACK_ID_RAW "trackId from the radar slot/age lifecycle alone (ALL_TRACKS_CONFIG).";
CM_ SG_ 1834 VREL "VLONG_OVER_GROUND - Toyota 0xB4 speed, m/s.";
CM_ SG_ 1834 V_EGO_0xB4 "Toyota 0xB4 SPEED used for VREL, m/s (reads ~1-1.5% below GPS / wheel speed).";
CM_ SG_ 1834 DREL_FUSED "Velocity-aided range (range_fusion_gain 0.1, part of the fused profile); cuts short-term range walks by about a third.";
CM_ SG_ 1834 VREL_KALMAN "vRel from the fused profile's Kalman speed filter (object list and ACC target weighted by their uncertainty), on every track from age 1 and at the nominal 0.15 m/s per code.";
CM_ BO_ 1835 "Derived values the ars510 interface computes for 0x80 slot 11, for plotting next to the raw fields.";
CM_ SG_ 1835 TRACK_ID_OP "trackId openpilot would see under the raw profile, BASE_CONFIG (held until age 60, re-link within 3.5 s); 0 when not published.";
CM_ SG_ 1835 TRACK_ID_RAW "trackId from the radar slot/age lifecycle alone (ALL_TRACKS_CONFIG).";
CM_ SG_ 1835 VREL "VLONG_OVER_GROUND - Toyota 0xB4 speed, m/s.";
CM_ SG_ 1835 V_EGO_0xB4 "Toyota 0xB4 SPEED used for VREL, m/s (reads ~1-1.5% below GPS / wheel speed).";
CM_ SG_ 1835 DREL_FUSED "Velocity-aided range (range_fusion_gain 0.1, part of the fused profile); cuts short-term range walks by about a third.";
CM_ SG_ 1835 VREL_KALMAN "vRel from the fused profile's Kalman speed filter (object list and ACC target weighted by their uncertainty), on every track from age 1 and at the nominal 0.15 m/s per code.";
CM_ BO_ 1836 "Derived values the ars510 interface computes for 0x80 slot 12, for plotting next to the raw fields.";
CM_ SG_ 1836 TRACK_ID_OP "trackId openpilot would see under the raw profile, BASE_CONFIG (held until age 60, re-link within 3.5 s); 0 when not published.";
CM_ SG_ 1836 TRACK_ID_RAW "trackId from the radar slot/age lifecycle alone (ALL_TRACKS_CONFIG).";
CM_ SG_ 1836 VREL "VLONG_OVER_GROUND - Toyota 0xB4 speed, m/s.";
CM_ SG_ 1836 V_EGO_0xB4 "Toyota 0xB4 SPEED used for VREL, m/s (reads ~1-1.5% below GPS / wheel speed).";
CM_ SG_ 1836 DREL_FUSED "Velocity-aided range (range_fusion_gain 0.1, part of the fused profile); cuts short-term range walks by about a third.";
CM_ SG_ 1836 VREL_KALMAN "vRel from the fused profile's Kalman speed filter (object list and ACC target weighted by their uncertainty), on every track from age 1 and at the nominal 0.15 m/s per code.";
CM_ BO_ 1837 "Derived values the ars510 interface computes for 0x80 slot 13, for plotting next to the raw fields.";
CM_ SG_ 1837 TRACK_ID_OP "trackId openpilot would see under the raw profile, BASE_CONFIG (held until age 60, re-link within 3.5 s); 0 when not published.";
CM_ SG_ 1837 TRACK_ID_RAW "trackId from the radar slot/age lifecycle alone (ALL_TRACKS_CONFIG).";
CM_ SG_ 1837 VREL "VLONG_OVER_GROUND - Toyota 0xB4 speed, m/s.";
CM_ SG_ 1837 V_EGO_0xB4 "Toyota 0xB4 SPEED used for VREL, m/s (reads ~1-1.5% below GPS / wheel speed).";
CM_ SG_ 1837 DREL_FUSED "Velocity-aided range (range_fusion_gain 0.1, part of the fused profile); cuts short-term range walks by about a third.";
CM_ SG_ 1837 VREL_KALMAN "vRel from the fused profile's Kalman speed filter (object list and ACC target weighted by their uncertainty), on every track from age 1 and at the nominal 0.15 m/s per code.";
CM_ BO_ 1838 "Derived values the ars510 interface computes for 0x80 slot 14, for plotting next to the raw fields.";
CM_ SG_ 1838 TRACK_ID_OP "trackId openpilot would see under the raw profile, BASE_CONFIG (held until age 60, re-link within 3.5 s); 0 when not published.";
CM_ SG_ 1838 TRACK_ID_RAW "trackId from the radar slot/age lifecycle alone (ALL_TRACKS_CONFIG).";
CM_ SG_ 1838 VREL "VLONG_OVER_GROUND - Toyota 0xB4 speed, m/s.";
CM_ SG_ 1838 V_EGO_0xB4 "Toyota 0xB4 SPEED used for VREL, m/s (reads ~1-1.5% below GPS / wheel speed).";
CM_ SG_ 1838 DREL_FUSED "Velocity-aided range (range_fusion_gain 0.1, part of the fused profile); cuts short-term range walks by about a third.";
CM_ SG_ 1838 VREL_KALMAN "vRel from the fused profile's Kalman speed filter (object list and ACC target weighted by their uncertainty), on every track from age 1 and at the nominal 0.15 m/s per code.";
CM_ BO_ 1839 "Derived values the ars510 interface computes for 0x80 slot 15, for plotting next to the raw fields.";
CM_ SG_ 1839 TRACK_ID_OP "trackId openpilot would see under the raw profile, BASE_CONFIG (held until age 60, re-link within 3.5 s); 0 when not published.";
CM_ SG_ 1839 TRACK_ID_RAW "trackId from the radar slot/age lifecycle alone (ALL_TRACKS_CONFIG).";
CM_ SG_ 1839 VREL "VLONG_OVER_GROUND - Toyota 0xB4 speed, m/s.";
CM_ SG_ 1839 V_EGO_0xB4 "Toyota 0xB4 SPEED used for VREL, m/s (reads ~1-1.5% below GPS / wheel speed).";
CM_ SG_ 1839 DREL_FUSED "Velocity-aided range (range_fusion_gain 0.1, part of the fused profile); cuts short-term range walks by about a third.";
CM_ SG_ 1839 VREL_KALMAN "vRel from the fused profile's Kalman speed filter (object list and ACC target weighted by their uncertainty), on every track from age 1 and at the nominal 0.15 m/s per code.";
CM_ BO_ 1840 "Derived values the ars510 interface computes for 0x80 slot 16, for plotting next to the raw fields.";
CM_ SG_ 1840 TRACK_ID_OP "trackId openpilot would see under the raw profile, BASE_CONFIG (held until age 60, re-link within 3.5 s); 0 when not published.";
CM_ SG_ 1840 TRACK_ID_RAW "trackId from the radar slot/age lifecycle alone (ALL_TRACKS_CONFIG).";
CM_ SG_ 1840 VREL "VLONG_OVER_GROUND - Toyota 0xB4 speed, m/s.";
CM_ SG_ 1840 V_EGO_0xB4 "Toyota 0xB4 SPEED used for VREL, m/s (reads ~1-1.5% below GPS / wheel speed).";
CM_ SG_ 1840 DREL_FUSED "Velocity-aided range (range_fusion_gain 0.1, part of the fused profile); cuts short-term range walks by about a third.";
CM_ SG_ 1840 VREL_KALMAN "vRel from the fused profile's Kalman speed filter (object list and ACC target weighted by their uncertainty), on every track from age 1 and at the nominal 0.15 m/s per code.";
CM_ BO_ 1841 "Derived values the ars510 interface computes for 0x80 slot 17, for plotting next to the raw fields.";
CM_ SG_ 1841 TRACK_ID_OP "trackId openpilot would see under the raw profile, BASE_CONFIG (held until age 60, re-link within 3.5 s); 0 when not published.";
CM_ SG_ 1841 TRACK_ID_RAW "trackId from the radar slot/age lifecycle alone (ALL_TRACKS_CONFIG).";
CM_ SG_ 1841 VREL "VLONG_OVER_GROUND - Toyota 0xB4 speed, m/s.";
CM_ SG_ 1841 V_EGO_0xB4 "Toyota 0xB4 SPEED used for VREL, m/s (reads ~1-1.5% below GPS / wheel speed).";
CM_ SG_ 1841 DREL_FUSED "Velocity-aided range (range_fusion_gain 0.1, part of the fused profile); cuts short-term range walks by about a third.";
CM_ SG_ 1841 VREL_KALMAN "vRel from the fused profile's Kalman speed filter (object list and ACC target weighted by their uncertainty), on every track from age 1 and at the nominal 0.15 m/s per code.";
CM_ BO_ 1842 "Derived values the ars510 interface computes for 0x80 slot 18, for plotting next to the raw fields.";
CM_ SG_ 1842 TRACK_ID_OP "trackId openpilot would see under the raw profile, BASE_CONFIG (held until age 60, re-link within 3.5 s); 0 when not published.";
CM_ SG_ 1842 TRACK_ID_RAW "trackId from the radar slot/age lifecycle alone (ALL_TRACKS_CONFIG).";
CM_ SG_ 1842 VREL "VLONG_OVER_GROUND - Toyota 0xB4 speed, m/s.";
CM_ SG_ 1842 V_EGO_0xB4 "Toyota 0xB4 SPEED used for VREL, m/s (reads ~1-1.5% below GPS / wheel speed).";
CM_ SG_ 1842 DREL_FUSED "Velocity-aided range (range_fusion_gain 0.1, part of the fused profile); cuts short-term range walks by about a third.";
CM_ SG_ 1842 VREL_KALMAN "vRel from the fused profile's Kalman speed filter (object list and ACC target weighted by their uncertainty), on every track from age 1 and at the nominal 0.15 m/s per code.";
CM_ BO_ 1843 "Derived values the ars510 interface computes for 0x80 slot 19, for plotting next to the raw fields.";
CM_ SG_ 1843 TRACK_ID_OP "trackId openpilot would see under the raw profile, BASE_CONFIG (held until age 60, re-link within 3.5 s); 0 when not published.";
CM_ SG_ 1843 TRACK_ID_RAW "trackId from the radar slot/age lifecycle alone (ALL_TRACKS_CONFIG).";
CM_ SG_ 1843 VREL "VLONG_OVER_GROUND - Toyota 0xB4 speed, m/s.";
CM_ SG_ 1843 V_EGO_0xB4 "Toyota 0xB4 SPEED used for VREL, m/s (reads ~1-1.5% below GPS / wheel speed).";
CM_ SG_ 1843 DREL_FUSED "Velocity-aided range (range_fusion_gain 0.1, part of the fused profile); cuts short-term range walks by about a third.";
CM_ SG_ 1843 VREL_KALMAN "vRel from the fused profile's Kalman speed filter (object list and ACC target weighted by their uncertainty), on every track from age 1 and at the nominal 0.15 m/s per code.";
CM_ BO_ 1856 "0x80 record bytes 0-16, before the 20 object slots. Byte 0 is 0xE4 (transport length low byte).";
CM_ SG_ 1856 CONST_HDR0_8 "Constant in the captured data.";
CM_ SG_ 1856 UNK_HDR8_5 "Part of the clock code in record bytes 1-4 (little-endian), which equals the 0x85 fine clock // 100.";
CM_ SG_ 1856 UNK_HDR13_4 "Part of the clock code in record bytes 1-4 (see UNK_HDR8_5).";
CM_ SG_ 1856 UNK_HDR17_15 "Part of the clock code in record bytes 1-4 (see UNK_HDR8_5).";
CM_ SG_ 1856 CONST_HDR32_1 "Constant in the captured data.";
CM_ SG_ 1856 UNK_HDR33_1 "Part of the clock code in record bytes 1-4 (see UNK_HDR8_5).";
CM_ SG_ 1856 CONST_HDR34_7 "Constant in the captured data.";
CM_ SG_ 1856 UNK_HDR41_15 "Record counter: record bytes 5-6 (little-endian) >> 1; equals the 0x85 counter of the same cycle.";
CM_ SG_ 1856 CONST_HDR56_12 "Constant in the captured data.";
CM_ SG_ 1856 UNK_HDR68_4 "Sequence counter: record byte 8 high nibble, +1 per record; fixed offset to the record counter within a drive segment.";
CM_ SG_ 1856 CONST_HDR72_32 "Constant in the captured data.";
CM_ SG_ 1856 UNK_HDR104_3 "Timing-offset candidate (104|11 region): its change tracks the record's arrival-time offset at about 1 ms per count.";
CM_ SG_ 1856 UNK_HDR107_4 "Timing-offset candidate (see UNK_HDR104_3).";
CM_ SG_ 1856 UNK_HDR111_4 "Raw; usually 3.";
CM_ SG_ 1856 OBJECT_COUNT "Number of allocated slots: those whose index field equals their position, which are the slots with age >= 1, at any of the 20 positions.";
CM_ SG_ 1856 CONST_HDR120_16 "Constant in the captured data.";
CM_ SG_ 1857 RECORD_CRC32 "zlib CRC32 over record bytes 1-736, little-endian; only CRC-valid records are exported.";
CM_ BO_ 1888 "0x85 record bytes 0-20 (prefix). Byte 0 is the length-low byte 0x90; bytes 1-4 fine clock, 5-6 counter.";
CM_ SG_ 1889 PARAMETERS_PRESENT "1 = the cell holds parameters (bytes 6-9 differ from the default 84 03 F4 01).";
CM_ SG_ 1889 CURVE_OFFSET_M "c0: (32|12 - 2000) * 0.01 m, left positive. Meaningful when PARAMETERS_PRESENT = 1.";
CM_ SG_ 1889 CURVE_HEADING_RAD "c1: nominal -1.8e-5 rad per code from zero 31200, left-positive tangent (unit bounded to about 1.6-2.2e-5). Meaningful when PARAMETERS_PRESENT = 1.";
CM_ SG_ 1889 CURVE_CURVATURE_PER_M "c2: nominal 2.5e-6 1/m per code from zero 16020, left positive (unit bounded to about 2.0-2.7e-6). Meaningful when PARAMETERS_PRESENT = 1.";
CM_ SG_ 1889 CURVE_RATE_PER_M2 "c3: curvature rate d(kappa)/ds, offset binary around code 500, nominal 4e-6 1/m^2 per code (sign and zero replicated). Meaningful when PARAMETERS_PRESENT = 1.";
CM_ SG_ 1889 CURVE_FLAG "Bit 79, separate from the curvature value; set on 79-80 % of populated cells 2/3 and 43-44 % of 8/9 (the same in cells 2 and 3 on 99 % of rows).";
CM_ BO_ 1889 "0x85 cell 0, record bytes 21-32. Each populated cell is one lane / road-boundary curve y(x) = c0 + c1 x + c2 x^2 / 2 + c3 x^3 / 6 (docs/04); cells 2/3 and 8/9 are two estimates of the ego-lane pair.";
CM_ SG_ 1890 PARAMETERS_PRESENT "1 = the cell holds parameters (bytes 6-9 differ from the default 84 03 F4 01).";
CM_ SG_ 1890 CURVE_OFFSET_M "c0: (32|12 - 2000) * 0.01 m, left positive. Meaningful when PARAMETERS_PRESENT = 1.";
CM_ SG_ 1890 CURVE_HEADING_RAD "c1: nominal -1.8e-5 rad per code from zero 31200, left-positive tangent (unit bounded to about 1.6-2.2e-5). Meaningful when PARAMETERS_PRESENT = 1.";
CM_ SG_ 1890 CURVE_CURVATURE_PER_M "c2: nominal 2.5e-6 1/m per code from zero 16020, left positive (unit bounded to about 2.0-2.7e-6). Meaningful when PARAMETERS_PRESENT = 1.";
CM_ SG_ 1890 CURVE_RATE_PER_M2 "c3: curvature rate d(kappa)/ds, offset binary around code 500, nominal 4e-6 1/m^2 per code (sign and zero replicated). Meaningful when PARAMETERS_PRESENT = 1.";
CM_ SG_ 1890 CURVE_FLAG "Bit 79, separate from the curvature value; set on 79-80 % of populated cells 2/3 and 43-44 % of 8/9 (the same in cells 2 and 3 on 99 % of rows).";
CM_ BO_ 1890 "0x85 cell 1, record bytes 33-44. Each populated cell is one lane / road-boundary curve y(x) = c0 + c1 x + c2 x^2 / 2 + c3 x^3 / 6 (docs/04); cells 2/3 and 8/9 are two estimates of the ego-lane pair.";
CM_ SG_ 1891 PARAMETERS_PRESENT "1 = the cell holds parameters (bytes 6-9 differ from the default 84 03 F4 01).";
CM_ SG_ 1891 CURVE_OFFSET_M "c0: (32|12 - 2000) * 0.01 m, left positive. Meaningful when PARAMETERS_PRESENT = 1.";
CM_ SG_ 1891 CURVE_HEADING_RAD "c1: nominal -1.8e-5 rad per code from zero 31200, left-positive tangent (unit bounded to about 1.6-2.2e-5). Meaningful when PARAMETERS_PRESENT = 1.";
CM_ SG_ 1891 CURVE_CURVATURE_PER_M "c2: nominal 2.5e-6 1/m per code from zero 16020, left positive (unit bounded to about 2.0-2.7e-6). Meaningful when PARAMETERS_PRESENT = 1.";
CM_ SG_ 1891 CURVE_RATE_PER_M2 "c3: curvature rate d(kappa)/ds, offset binary around code 500, nominal 4e-6 1/m^2 per code (sign and zero replicated). Meaningful when PARAMETERS_PRESENT = 1.";
CM_ SG_ 1891 CURVE_FLAG "Bit 79, separate from the curvature value; set on 79-80 % of populated cells 2/3 and 43-44 % of 8/9 (the same in cells 2 and 3 on 99 % of rows).";
CM_ BO_ 1891 "0x85 cell 2, record bytes 45-56. Each populated cell is one lane / road-boundary curve y(x) = c0 + c1 x + c2 x^2 / 2 + c3 x^3 / 6 (docs/04); cells 2/3 and 8/9 are two estimates of the ego-lane pair.";
CM_ SG_ 1892 PARAMETERS_PRESENT "1 = the cell holds parameters (bytes 6-9 differ from the default 84 03 F4 01).";
CM_ SG_ 1892 CURVE_OFFSET_M "c0: (32|12 - 2000) * 0.01 m, left positive. Meaningful when PARAMETERS_PRESENT = 1.";
CM_ SG_ 1892 CURVE_HEADING_RAD "c1: nominal -1.8e-5 rad per code from zero 31200, left-positive tangent (unit bounded to about 1.6-2.2e-5). Meaningful when PARAMETERS_PRESENT = 1.";
CM_ SG_ 1892 CURVE_CURVATURE_PER_M "c2: nominal 2.5e-6 1/m per code from zero 16020, left positive (unit bounded to about 2.0-2.7e-6). Meaningful when PARAMETERS_PRESENT = 1.";
CM_ SG_ 1892 CURVE_RATE_PER_M2 "c3: curvature rate d(kappa)/ds, offset binary around code 500, nominal 4e-6 1/m^2 per code (sign and zero replicated). Meaningful when PARAMETERS_PRESENT = 1.";
CM_ SG_ 1892 CURVE_FLAG "Bit 79, separate from the curvature value; set on 79-80 % of populated cells 2/3 and 43-44 % of 8/9 (the same in cells 2 and 3 on 99 % of rows).";
CM_ BO_ 1892 "0x85 cell 3, record bytes 57-68. Each populated cell is one lane / road-boundary curve y(x) = c0 + c1 x + c2 x^2 / 2 + c3 x^3 / 6 (docs/04); cells 2/3 and 8/9 are two estimates of the ego-lane pair.";
CM_ SG_ 1893 PARAMETERS_PRESENT "1 = the cell holds parameters (bytes 6-9 differ from the default 84 03 F4 01).";
CM_ SG_ 1893 CURVE_OFFSET_M "c0: (32|12 - 2000) * 0.01 m, left positive. Meaningful when PARAMETERS_PRESENT = 1.";
CM_ SG_ 1893 CURVE_HEADING_RAD "c1: nominal -1.8e-5 rad per code from zero 31200, left-positive tangent (unit bounded to about 1.6-2.2e-5). Meaningful when PARAMETERS_PRESENT = 1.";
CM_ SG_ 1893 CURVE_CURVATURE_PER_M "c2: nominal 2.5e-6 1/m per code from zero 16020, left positive (unit bounded to about 2.0-2.7e-6). Meaningful when PARAMETERS_PRESENT = 1.";
CM_ SG_ 1893 CURVE_RATE_PER_M2 "c3: curvature rate d(kappa)/ds, offset binary around code 500, nominal 4e-6 1/m^2 per code (sign and zero replicated). Meaningful when PARAMETERS_PRESENT = 1.";
CM_ SG_ 1893 CURVE_FLAG "Bit 79, separate from the curvature value; set on 79-80 % of populated cells 2/3 and 43-44 % of 8/9 (the same in cells 2 and 3 on 99 % of rows).";
CM_ BO_ 1893 "0x85 cell 4, record bytes 69-80. Each populated cell is one lane / road-boundary curve y(x) = c0 + c1 x + c2 x^2 / 2 + c3 x^3 / 6 (docs/04); cells 2/3 and 8/9 are two estimates of the ego-lane pair.";
CM_ SG_ 1894 PARAMETERS_PRESENT "1 = the cell holds parameters (bytes 6-9 differ from the default 84 03 F4 01).";
CM_ SG_ 1894 CURVE_OFFSET_M "c0: (32|12 - 2000) * 0.01 m, left positive. Meaningful when PARAMETERS_PRESENT = 1.";
CM_ SG_ 1894 CURVE_HEADING_RAD "c1: nominal -1.8e-5 rad per code from zero 31200, left-positive tangent (unit bounded to about 1.6-2.2e-5). Meaningful when PARAMETERS_PRESENT = 1.";
CM_ SG_ 1894 CURVE_CURVATURE_PER_M "c2: nominal 2.5e-6 1/m per code from zero 16020, left positive (unit bounded to about 2.0-2.7e-6). Meaningful when PARAMETERS_PRESENT = 1.";
CM_ SG_ 1894 CURVE_RATE_PER_M2 "c3: curvature rate d(kappa)/ds, offset binary around code 500, nominal 4e-6 1/m^2 per code (sign and zero replicated). Meaningful when PARAMETERS_PRESENT = 1.";
CM_ SG_ 1894 CURVE_FLAG "Bit 79, separate from the curvature value; set on 79-80 % of populated cells 2/3 and 43-44 % of 8/9 (the same in cells 2 and 3 on 99 % of rows).";
CM_ BO_ 1894 "0x85 cell 5, record bytes 81-92. Each populated cell is one lane / road-boundary curve y(x) = c0 + c1 x + c2 x^2 / 2 + c3 x^3 / 6 (docs/04); cells 2/3 and 8/9 are two estimates of the ego-lane pair.";
CM_ SG_ 1895 PARAMETERS_PRESENT "1 = the cell holds parameters (bytes 6-9 differ from the default 84 03 F4 01).";
CM_ SG_ 1895 CURVE_OFFSET_M "c0: (32|12 - 2000) * 0.01 m, left positive. Meaningful when PARAMETERS_PRESENT = 1.";
CM_ SG_ 1895 CURVE_HEADING_RAD "c1: nominal -1.8e-5 rad per code from zero 31200, left-positive tangent (unit bounded to about 1.6-2.2e-5). Meaningful when PARAMETERS_PRESENT = 1.";
CM_ SG_ 1895 CURVE_CURVATURE_PER_M "c2: nominal 2.5e-6 1/m per code from zero 16020, left positive (unit bounded to about 2.0-2.7e-6). Meaningful when PARAMETERS_PRESENT = 1.";
CM_ SG_ 1895 CURVE_RATE_PER_M2 "c3: curvature rate d(kappa)/ds, offset binary around code 500, nominal 4e-6 1/m^2 per code (sign and zero replicated). Meaningful when PARAMETERS_PRESENT = 1.";
CM_ SG_ 1895 CURVE_FLAG "Bit 79, separate from the curvature value; set on 79-80 % of populated cells 2/3 and 43-44 % of 8/9 (the same in cells 2 and 3 on 99 % of rows).";
CM_ BO_ 1895 "0x85 cell 6, record bytes 93-104. Each populated cell is one lane / road-boundary curve y(x) = c0 + c1 x + c2 x^2 / 2 + c3 x^3 / 6 (docs/04); cells 2/3 and 8/9 are two estimates of the ego-lane pair.";
CM_ SG_ 1896 PARAMETERS_PRESENT "1 = the cell holds parameters (bytes 6-9 differ from the default 84 03 F4 01).";
CM_ SG_ 1896 CURVE_OFFSET_M "c0: (32|12 - 2000) * 0.01 m, left positive. Meaningful when PARAMETERS_PRESENT = 1.";
CM_ SG_ 1896 CURVE_HEADING_RAD "c1: nominal -1.8e-5 rad per code from zero 31200, left-positive tangent (unit bounded to about 1.6-2.2e-5). Meaningful when PARAMETERS_PRESENT = 1.";
CM_ SG_ 1896 CURVE_CURVATURE_PER_M "c2: nominal 2.5e-6 1/m per code from zero 16020, left positive (unit bounded to about 2.0-2.7e-6). Meaningful when PARAMETERS_PRESENT = 1.";
CM_ SG_ 1896 CURVE_RATE_PER_M2 "c3: curvature rate d(kappa)/ds, offset binary around code 500, nominal 4e-6 1/m^2 per code (sign and zero replicated). Meaningful when PARAMETERS_PRESENT = 1.";
CM_ SG_ 1896 CURVE_FLAG "Bit 79, separate from the curvature value; set on 79-80 % of populated cells 2/3 and 43-44 % of 8/9 (the same in cells 2 and 3 on 99 % of rows).";
CM_ BO_ 1896 "0x85 cell 7, record bytes 105-116. Each populated cell is one lane / road-boundary curve y(x) = c0 + c1 x + c2 x^2 / 2 + c3 x^3 / 6 (docs/04); cells 2/3 and 8/9 are two estimates of the ego-lane pair.";
CM_ SG_ 1897 PARAMETERS_PRESENT "1 = the cell holds parameters (bytes 6-9 differ from the default 84 03 F4 01).";
CM_ SG_ 1897 CURVE_OFFSET_M "c0: (32|12 - 2000) * 0.01 m, left positive. Meaningful when PARAMETERS_PRESENT = 1.";
CM_ SG_ 1897 CURVE_HEADING_RAD "c1: nominal -1.8e-5 rad per code from zero 31200, left-positive tangent (unit bounded to about 1.6-2.2e-5). Meaningful when PARAMETERS_PRESENT = 1.";
CM_ SG_ 1897 CURVE_CURVATURE_PER_M "c2: nominal 2.5e-6 1/m per code from zero 16020, left positive (unit bounded to about 2.0-2.7e-6). Meaningful when PARAMETERS_PRESENT = 1.";
CM_ SG_ 1897 CURVE_RATE_PER_M2 "c3: curvature rate d(kappa)/ds, offset binary around code 500, nominal 4e-6 1/m^2 per code (sign and zero replicated). Meaningful when PARAMETERS_PRESENT = 1.";
CM_ SG_ 1897 CURVE_FLAG "Bit 79, separate from the curvature value; set on 79-80 % of populated cells 2/3 and 43-44 % of 8/9 (the same in cells 2 and 3 on 99 % of rows).";
CM_ BO_ 1897 "0x85 cell 8, record bytes 117-128. Each populated cell is one lane / road-boundary curve y(x) = c0 + c1 x + c2 x^2 / 2 + c3 x^3 / 6 (docs/04); cells 2/3 and 8/9 are two estimates of the ego-lane pair.";
CM_ SG_ 1898 PARAMETERS_PRESENT "1 = the cell holds parameters (bytes 6-9 differ from the default 84 03 F4 01).";
CM_ SG_ 1898 CURVE_OFFSET_M "c0: (32|12 - 2000) * 0.01 m, left positive. Meaningful when PARAMETERS_PRESENT = 1.";
CM_ SG_ 1898 CURVE_HEADING_RAD "c1: nominal -1.8e-5 rad per code from zero 31200, left-positive tangent (unit bounded to about 1.6-2.2e-5). Meaningful when PARAMETERS_PRESENT = 1.";
CM_ SG_ 1898 CURVE_CURVATURE_PER_M "c2: nominal 2.5e-6 1/m per code from zero 16020, left positive (unit bounded to about 2.0-2.7e-6). Meaningful when PARAMETERS_PRESENT = 1.";
CM_ SG_ 1898 CURVE_RATE_PER_M2 "c3: curvature rate d(kappa)/ds, offset binary around code 500, nominal 4e-6 1/m^2 per code (sign and zero replicated). Meaningful when PARAMETERS_PRESENT = 1.";
CM_ SG_ 1898 CURVE_FLAG "Bit 79, separate from the curvature value; set on 79-80 % of populated cells 2/3 and 43-44 % of 8/9 (the same in cells 2 and 3 on 99 % of rows).";
CM_ BO_ 1898 "0x85 cell 9, record bytes 129-140. Each populated cell is one lane / road-boundary curve y(x) = c0 + c1 x + c2 x^2 / 2 + c3 x^3 / 6 (docs/04); cells 2/3 and 8/9 are two estimates of the ego-lane pair.";
CM_ BO_ 1899 "CRC at record[141:145] over record[1:141], followed by trailer[145:147]. Only CRC-valid records are exported.";
VAL_ 1805 ONCOMING_FLAG 0 "clear" 1 "oncoming-like state" ;
VAL_ 1805 MOVE_STATE 0 "moving forward (or left, with bit 111)" 1 "slow / standing (or initializing)" 2 "oncoming" 3 "moving right (or stopped after moving)" ;
VAL_ 1806 ONCOMING_FLAG 0 "clear" 1 "oncoming-like state" ;
VAL_ 1806 MOVE_STATE 0 "moving forward (or left, with bit 111)" 1 "slow / standing (or initializing)" 2 "oncoming" 3 "moving right (or stopped after moving)" ;
VAL_ 1807 ONCOMING_FLAG 0 "clear" 1 "oncoming-like state" ;
VAL_ 1807 MOVE_STATE 0 "moving forward (or left, with bit 111)" 1 "slow / standing (or initializing)" 2 "oncoming" 3 "moving right (or stopped after moving)" ;
VAL_ 1808 ONCOMING_FLAG 0 "clear" 1 "oncoming-like state" ;
VAL_ 1808 MOVE_STATE 0 "moving forward (or left, with bit 111)" 1 "slow / standing (or initializing)" 2 "oncoming" 3 "moving right (or stopped after moving)" ;
VAL_ 1809 ONCOMING_FLAG 0 "clear" 1 "oncoming-like state" ;
VAL_ 1809 MOVE_STATE 0 "moving forward (or left, with bit 111)" 1 "slow / standing (or initializing)" 2 "oncoming" 3 "moving right (or stopped after moving)" ;
VAL_ 1810 ONCOMING_FLAG 0 "clear" 1 "oncoming-like state" ;
VAL_ 1810 MOVE_STATE 0 "moving forward (or left, with bit 111)" 1 "slow / standing (or initializing)" 2 "oncoming" 3 "moving right (or stopped after moving)" ;
VAL_ 1811 ONCOMING_FLAG 0 "clear" 1 "oncoming-like state" ;
VAL_ 1811 MOVE_STATE 0 "moving forward (or left, with bit 111)" 1 "slow / standing (or initializing)" 2 "oncoming" 3 "moving right (or stopped after moving)" ;
VAL_ 1824 PUBLISHED_OP 0 "held back or absent" 1 "published" ;
VAL_ 1824 SETTLED 0 "settling (age<60)" 1 "settled" ;
VAL_ 1825 PUBLISHED_OP 0 "held back or absent" 1 "published" ;
VAL_ 1825 SETTLED 0 "settling (age<60)" 1 "settled" ;
VAL_ 1826 PUBLISHED_OP 0 "held back or absent" 1 "published" ;
VAL_ 1826 SETTLED 0 "settling (age<60)" 1 "settled" ;
VAL_ 1827 PUBLISHED_OP 0 "held back or absent" 1 "published" ;
VAL_ 1827 SETTLED 0 "settling (age<60)" 1 "settled" ;
VAL_ 1828 PUBLISHED_OP 0 "held back or absent" 1 "published" ;
VAL_ 1828 SETTLED 0 "settling (age<60)" 1 "settled" ;
VAL_ 1829 PUBLISHED_OP 0 "held back or absent" 1 "published" ;
VAL_ 1829 SETTLED 0 "settling (age<60)" 1 "settled" ;
VAL_ 1830 PUBLISHED_OP 0 "held back or absent" 1 "published" ;
VAL_ 1830 SETTLED 0 "settling (age<60)" 1 "settled" ;
VAL_ 1831 PUBLISHED_OP 0 "held back or absent" 1 "published" ;
VAL_ 1831 SETTLED 0 "settling (age<60)" 1 "settled" ;
VAL_ 1832 PUBLISHED_OP 0 "held back or absent" 1 "published" ;
VAL_ 1832 SETTLED 0 "settling (age<60)" 1 "settled" ;
VAL_ 1833 PUBLISHED_OP 0 "held back or absent" 1 "published" ;
VAL_ 1833 SETTLED 0 "settling (age<60)" 1 "settled" ;
VAL_ 1834 PUBLISHED_OP 0 "held back or absent" 1 "published" ;
VAL_ 1834 SETTLED 0 "settling (age<60)" 1 "settled" ;
VAL_ 1835 PUBLISHED_OP 0 "held back or absent" 1 "published" ;
VAL_ 1835 SETTLED 0 "settling (age<60)" 1 "settled" ;
VAL_ 1836 PUBLISHED_OP 0 "held back or absent" 1 "published" ;
VAL_ 1836 SETTLED 0 "settling (age<60)" 1 "settled" ;
VAL_ 1837 PUBLISHED_OP 0 "held back or absent" 1 "published" ;
VAL_ 1837 SETTLED 0 "settling (age<60)" 1 "settled" ;
VAL_ 1838 PUBLISHED_OP 0 "held back or absent" 1 "published" ;
VAL_ 1838 SETTLED 0 "settling (age<60)" 1 "settled" ;
VAL_ 1839 PUBLISHED_OP 0 "held back or absent" 1 "published" ;
VAL_ 1839 SETTLED 0 "settling (age<60)" 1 "settled" ;
VAL_ 1840 PUBLISHED_OP 0 "held back or absent" 1 "published" ;
VAL_ 1840 SETTLED 0 "settling (age<60)" 1 "settled" ;
VAL_ 1841 PUBLISHED_OP 0 "held back or absent" 1 "published" ;
VAL_ 1841 SETTLED 0 "settling (age<60)" 1 "settled" ;
VAL_ 1842 PUBLISHED_OP 0 "held back or absent" 1 "published" ;
VAL_ 1842 SETTLED 0 "settling (age<60)" 1 "settled" ;
VAL_ 1843 PUBLISHED_OP 0 "held back or absent" 1 "published" ;
VAL_ 1843 SETTLED 0 "settling (age<60)" 1 "settled" ;
