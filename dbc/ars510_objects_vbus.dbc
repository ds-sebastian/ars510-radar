VERSION "ARS510 reassembled object / shell records on a virtual bus (generated by tools/build_cabana_route.py)"

NS_ :

BS_:

BU_: RADAR XXX

BO_ 1803 ARS510_OBJ_11: 48 RADAR
 SG_ STATE_CODE : 0|2@1+ (1,0) [0|3] "raw" XXX
 SG_ SLOT_INDEX_CODE : 2|6@1+ (1,0) [0|63] "raw" XXX
 SG_ UNK_8_6 : 8|6@1+ (1,0) [0|63] "raw" XXX
 SG_ ONCOMING_FLAG : 14|1@1+ (1,0) [0|1] "" XXX
 SG_ UNK_15_1 : 15|1@1+ (1,0) [0|1] "raw" XXX
 SG_ SCORE_CODE : 16|8@1+ (1,0) [0|255] "raw" XXX
 SG_ AGE : 24|7@1+ (1,0) [0|126] "cycles" XXX
 SG_ CONST_31_1 : 31|1@1+ (1,0) [0|1] "raw" XXX
 SG_ DREL : 32|12@1+ (0.0625,-10) [-10|245.9375] "m" XXX
 SG_ YREL_LEFT : 44|12@1+ (0.015625,-32) [-32|31.984375] "m" XXX
 SG_ UNK_56_7 : 56|7@1+ (1,0) [0|127] "raw" XXX
 SG_ UNK_63_1 : 63|1@1+ (1,0) [0|1] "raw" XXX
 SG_ VLONG_OVER_GROUND : 64|10@1+ (0.15,-76.575) [-76.575|76.875] "m/s" XXX
 SG_ VLAT_OVER_GROUND_PROV : 74|10@1+ (0.15,-76.575) [-76.575|76.875] "m/s" XXX
 SG_ ALONG_LIKE_84 : 84|10@1+ (1,-511) [-511|512] "code" XXX
 SG_ CONST_94_2 : 94|2@1+ (1,0) [0|3] "raw" XXX
 SG_ UNK_96 : 96|10@1+ (1,0) [0|1023] "raw" XXX
 SG_ UNK_106_1 : 106|1@1+ (1,0) [0|1] "raw" XXX
 SG_ UNK_107_1 : 107|1@1+ (1,0) [0|1] "raw" XXX
 SG_ CONST_108_1 : 108|1@1+ (1,0) [0|1] "raw" XXX
 SG_ MOVE_STATE : 109|2@1+ (1,0) [0|3] "" XXX
 SG_ UNK_111_4 : 111|4@1+ (1,0) [0|15] "raw" XXX
 SG_ UNK_115_8 : 115|8@1+ (1,0) [0|255] "raw" XXX
 SG_ CONST_123_5 : 123|5@1+ (1,0) [0|31] "raw" XXX
 SG_ UNK_128_2 : 128|2@1+ (1,0) [0|3] "raw" XXX
 SG_ UNK_130_1 : 130|1@1+ (1,0) [0|1] "raw" XXX
 SG_ UNK_131_4 : 131|4@1+ (1,0) [0|15] "raw" XXX
 SG_ CONST_135_1 : 135|1@1+ (1,0) [0|1] "raw" XXX
 SG_ UNK_136_6 : 136|6@1+ (1,0) [0|63] "raw" XXX
 SG_ UNK_142_1 : 142|1@1+ (1,0) [0|1] "raw" XXX
 SG_ CONST_143_5 : 143|5@1+ (1,0) [0|31] "raw" XXX
 SG_ UNK_148_8 : 148|8@1+ (1,0) [0|255] "raw" XXX
 SG_ UNK_156_4 : 156|4@1+ (1,0) [0|15] "raw" XXX
 SG_ CONST_160_3 : 160|3@1+ (1,0) [0|7] "raw" XXX
 SG_ UNK_163_2 : 163|2@1+ (1,0) [0|3] "raw" XXX
 SG_ UNK_165_3 : 165|3@1+ (1,0) [0|7] "raw" XXX
 SG_ UNK_168_10 : 168|10@1+ (1,0) [0|1023] "raw" XXX
 SG_ CONST_178_3 : 178|3@1+ (1,0) [0|7] "raw" XXX
 SG_ UNK_181_1 : 181|1@1+ (1,0) [0|1] "raw" XXX
 SG_ UNK_182_1 : 182|1@1+ (1,0) [0|1] "raw" XXX
 SG_ UNK_183_7 : 183|7@1+ (1,0) [0|127] "raw" XXX
 SG_ UNK_190_10 : 190|10@1+ (1,0) [0|1023] "raw" XXX
 SG_ UNK_200_7 : 200|7@1+ (1,0) [0|127] "raw" XXX
 SG_ CONST_207_1 : 207|1@1+ (1,0) [0|1] "raw" XXX
 SG_ UNK_208_6 : 208|6@1+ (1,0) [0|63] "raw" XXX
 SG_ CONST_214_2 : 214|2@1+ (1,0) [0|3] "raw" XXX
 SG_ UNK_216_6 : 216|6@1+ (1,0) [0|63] "raw" XXX
 SG_ CONST_222_2 : 222|2@1+ (1,0) [0|3] "raw" XXX
 SG_ UNK_224_7 : 224|7@1+ (1,0) [0|127] "raw" XXX
 SG_ CONST_231_1 : 231|1@1+ (1,0) [0|1] "raw" XXX
 SG_ UNK_232_7 : 232|7@1+ (1,0) [0|127] "raw" XXX
 SG_ UNK_239_1 : 239|1@1+ (1,0) [0|1] "raw" XXX
 SG_ UNK_240_7 : 240|7@1+ (1,0) [0|127] "raw" XXX
 SG_ CONST_247_1 : 247|1@1+ (1,0) [0|1] "raw" XXX
 SG_ UNK_248_7 : 248|7@1+ (1,0) [0|127] "raw" XXX
 SG_ CONST_255_1 : 255|1@1+ (1,0) [0|1] "raw" XXX
 SG_ UNK_256_6 : 256|6@1+ (1,0) [0|63] "raw" XXX
 SG_ UNK_262_2 : 262|2@1+ (1,0) [0|3] "raw" XXX
 SG_ UNK_264_5 : 264|5@1+ (1,0) [0|31] "raw" XXX
 SG_ UNK_269_3 : 269|3@1+ (1,0) [0|7] "raw" XXX
 SG_ UNK_272_5 : 272|5@1+ (1,0) [0|31] "raw" XXX
 SG_ CONST_277_11 : 277|11@1+ (1,0) [0|2047] "raw" XXX

BO_ 1804 ARS510_OBJ_12: 48 RADAR
 SG_ STATE_CODE : 0|2@1+ (1,0) [0|3] "raw" XXX
 SG_ SLOT_INDEX_CODE : 2|6@1+ (1,0) [0|63] "raw" XXX
 SG_ UNK_8_6 : 8|6@1+ (1,0) [0|63] "raw" XXX
 SG_ ONCOMING_FLAG : 14|1@1+ (1,0) [0|1] "" XXX
 SG_ UNK_15_1 : 15|1@1+ (1,0) [0|1] "raw" XXX
 SG_ SCORE_CODE : 16|8@1+ (1,0) [0|255] "raw" XXX
 SG_ AGE : 24|7@1+ (1,0) [0|126] "cycles" XXX
 SG_ CONST_31_1 : 31|1@1+ (1,0) [0|1] "raw" XXX
 SG_ DREL : 32|12@1+ (0.0625,-10) [-10|245.9375] "m" XXX
 SG_ YREL_LEFT : 44|12@1+ (0.015625,-32) [-32|31.984375] "m" XXX
 SG_ UNK_56_7 : 56|7@1+ (1,0) [0|127] "raw" XXX
 SG_ UNK_63_1 : 63|1@1+ (1,0) [0|1] "raw" XXX
 SG_ VLONG_OVER_GROUND : 64|10@1+ (0.15,-76.575) [-76.575|76.875] "m/s" XXX
 SG_ VLAT_OVER_GROUND_PROV : 74|10@1+ (0.15,-76.575) [-76.575|76.875] "m/s" XXX
 SG_ ALONG_LIKE_84 : 84|10@1+ (1,-511) [-511|512] "code" XXX
 SG_ CONST_94_2 : 94|2@1+ (1,0) [0|3] "raw" XXX
 SG_ UNK_96 : 96|10@1+ (1,0) [0|1023] "raw" XXX
 SG_ UNK_106_1 : 106|1@1+ (1,0) [0|1] "raw" XXX
 SG_ UNK_107_1 : 107|1@1+ (1,0) [0|1] "raw" XXX
 SG_ CONST_108_1 : 108|1@1+ (1,0) [0|1] "raw" XXX
 SG_ MOVE_STATE : 109|2@1+ (1,0) [0|3] "" XXX
 SG_ UNK_111_4 : 111|4@1+ (1,0) [0|15] "raw" XXX
 SG_ UNK_115_8 : 115|8@1+ (1,0) [0|255] "raw" XXX
 SG_ CONST_123_5 : 123|5@1+ (1,0) [0|31] "raw" XXX
 SG_ UNK_128_2 : 128|2@1+ (1,0) [0|3] "raw" XXX
 SG_ UNK_130_1 : 130|1@1+ (1,0) [0|1] "raw" XXX
 SG_ UNK_131_4 : 131|4@1+ (1,0) [0|15] "raw" XXX
 SG_ CONST_135_1 : 135|1@1+ (1,0) [0|1] "raw" XXX
 SG_ UNK_136_6 : 136|6@1+ (1,0) [0|63] "raw" XXX
 SG_ UNK_142_1 : 142|1@1+ (1,0) [0|1] "raw" XXX
 SG_ CONST_143_5 : 143|5@1+ (1,0) [0|31] "raw" XXX
 SG_ UNK_148_8 : 148|8@1+ (1,0) [0|255] "raw" XXX
 SG_ UNK_156_4 : 156|4@1+ (1,0) [0|15] "raw" XXX
 SG_ CONST_160_3 : 160|3@1+ (1,0) [0|7] "raw" XXX
 SG_ UNK_163_2 : 163|2@1+ (1,0) [0|3] "raw" XXX
 SG_ UNK_165_3 : 165|3@1+ (1,0) [0|7] "raw" XXX
 SG_ UNK_168_10 : 168|10@1+ (1,0) [0|1023] "raw" XXX
 SG_ CONST_178_3 : 178|3@1+ (1,0) [0|7] "raw" XXX
 SG_ UNK_181_1 : 181|1@1+ (1,0) [0|1] "raw" XXX
 SG_ UNK_182_1 : 182|1@1+ (1,0) [0|1] "raw" XXX
 SG_ UNK_183_7 : 183|7@1+ (1,0) [0|127] "raw" XXX
 SG_ UNK_190_10 : 190|10@1+ (1,0) [0|1023] "raw" XXX
 SG_ UNK_200_7 : 200|7@1+ (1,0) [0|127] "raw" XXX
 SG_ CONST_207_1 : 207|1@1+ (1,0) [0|1] "raw" XXX
 SG_ UNK_208_6 : 208|6@1+ (1,0) [0|63] "raw" XXX
 SG_ CONST_214_2 : 214|2@1+ (1,0) [0|3] "raw" XXX
 SG_ UNK_216_6 : 216|6@1+ (1,0) [0|63] "raw" XXX
 SG_ CONST_222_2 : 222|2@1+ (1,0) [0|3] "raw" XXX
 SG_ UNK_224_7 : 224|7@1+ (1,0) [0|127] "raw" XXX
 SG_ CONST_231_1 : 231|1@1+ (1,0) [0|1] "raw" XXX
 SG_ UNK_232_7 : 232|7@1+ (1,0) [0|127] "raw" XXX
 SG_ UNK_239_1 : 239|1@1+ (1,0) [0|1] "raw" XXX
 SG_ UNK_240_7 : 240|7@1+ (1,0) [0|127] "raw" XXX
 SG_ CONST_247_1 : 247|1@1+ (1,0) [0|1] "raw" XXX
 SG_ UNK_248_7 : 248|7@1+ (1,0) [0|127] "raw" XXX
 SG_ CONST_255_1 : 255|1@1+ (1,0) [0|1] "raw" XXX
 SG_ UNK_256_6 : 256|6@1+ (1,0) [0|63] "raw" XXX
 SG_ UNK_262_2 : 262|2@1+ (1,0) [0|3] "raw" XXX
 SG_ UNK_264_5 : 264|5@1+ (1,0) [0|31] "raw" XXX
 SG_ UNK_269_3 : 269|3@1+ (1,0) [0|7] "raw" XXX
 SG_ UNK_272_5 : 272|5@1+ (1,0) [0|31] "raw" XXX
 SG_ CONST_277_11 : 277|11@1+ (1,0) [0|2047] "raw" XXX

BO_ 1805 ARS510_OBJ_13: 48 RADAR
 SG_ STATE_CODE : 0|2@1+ (1,0) [0|3] "raw" XXX
 SG_ SLOT_INDEX_CODE : 2|6@1+ (1,0) [0|63] "raw" XXX
 SG_ UNK_8_6 : 8|6@1+ (1,0) [0|63] "raw" XXX
 SG_ ONCOMING_FLAG : 14|1@1+ (1,0) [0|1] "" XXX
 SG_ UNK_15_1 : 15|1@1+ (1,0) [0|1] "raw" XXX
 SG_ SCORE_CODE : 16|8@1+ (1,0) [0|255] "raw" XXX
 SG_ AGE : 24|7@1+ (1,0) [0|126] "cycles" XXX
 SG_ CONST_31_1 : 31|1@1+ (1,0) [0|1] "raw" XXX
 SG_ DREL : 32|12@1+ (0.0625,-10) [-10|245.9375] "m" XXX
 SG_ YREL_LEFT : 44|12@1+ (0.015625,-32) [-32|31.984375] "m" XXX
 SG_ UNK_56_7 : 56|7@1+ (1,0) [0|127] "raw" XXX
 SG_ UNK_63_1 : 63|1@1+ (1,0) [0|1] "raw" XXX
 SG_ VLONG_OVER_GROUND : 64|10@1+ (0.15,-76.575) [-76.575|76.875] "m/s" XXX
 SG_ VLAT_OVER_GROUND_PROV : 74|10@1+ (0.15,-76.575) [-76.575|76.875] "m/s" XXX
 SG_ ALONG_LIKE_84 : 84|10@1+ (1,-511) [-511|512] "code" XXX
 SG_ CONST_94_2 : 94|2@1+ (1,0) [0|3] "raw" XXX
 SG_ UNK_96 : 96|10@1+ (1,0) [0|1023] "raw" XXX
 SG_ UNK_106_1 : 106|1@1+ (1,0) [0|1] "raw" XXX
 SG_ UNK_107_1 : 107|1@1+ (1,0) [0|1] "raw" XXX
 SG_ CONST_108_1 : 108|1@1+ (1,0) [0|1] "raw" XXX
 SG_ MOVE_STATE : 109|2@1+ (1,0) [0|3] "" XXX
 SG_ UNK_111_4 : 111|4@1+ (1,0) [0|15] "raw" XXX
 SG_ UNK_115_8 : 115|8@1+ (1,0) [0|255] "raw" XXX
 SG_ CONST_123_5 : 123|5@1+ (1,0) [0|31] "raw" XXX
 SG_ UNK_128_2 : 128|2@1+ (1,0) [0|3] "raw" XXX
 SG_ UNK_130_1 : 130|1@1+ (1,0) [0|1] "raw" XXX
 SG_ UNK_131_4 : 131|4@1+ (1,0) [0|15] "raw" XXX
 SG_ CONST_135_1 : 135|1@1+ (1,0) [0|1] "raw" XXX
 SG_ UNK_136_6 : 136|6@1+ (1,0) [0|63] "raw" XXX
 SG_ UNK_142_1 : 142|1@1+ (1,0) [0|1] "raw" XXX
 SG_ CONST_143_5 : 143|5@1+ (1,0) [0|31] "raw" XXX
 SG_ UNK_148_8 : 148|8@1+ (1,0) [0|255] "raw" XXX
 SG_ UNK_156_4 : 156|4@1+ (1,0) [0|15] "raw" XXX
 SG_ CONST_160_3 : 160|3@1+ (1,0) [0|7] "raw" XXX
 SG_ UNK_163_2 : 163|2@1+ (1,0) [0|3] "raw" XXX
 SG_ UNK_165_3 : 165|3@1+ (1,0) [0|7] "raw" XXX
 SG_ UNK_168_10 : 168|10@1+ (1,0) [0|1023] "raw" XXX
 SG_ CONST_178_3 : 178|3@1+ (1,0) [0|7] "raw" XXX
 SG_ UNK_181_1 : 181|1@1+ (1,0) [0|1] "raw" XXX
 SG_ UNK_182_1 : 182|1@1+ (1,0) [0|1] "raw" XXX
 SG_ UNK_183_7 : 183|7@1+ (1,0) [0|127] "raw" XXX
 SG_ UNK_190_10 : 190|10@1+ (1,0) [0|1023] "raw" XXX
 SG_ UNK_200_7 : 200|7@1+ (1,0) [0|127] "raw" XXX
 SG_ CONST_207_1 : 207|1@1+ (1,0) [0|1] "raw" XXX
 SG_ UNK_208_6 : 208|6@1+ (1,0) [0|63] "raw" XXX
 SG_ CONST_214_2 : 214|2@1+ (1,0) [0|3] "raw" XXX
 SG_ UNK_216_6 : 216|6@1+ (1,0) [0|63] "raw" XXX
 SG_ CONST_222_2 : 222|2@1+ (1,0) [0|3] "raw" XXX
 SG_ UNK_224_7 : 224|7@1+ (1,0) [0|127] "raw" XXX
 SG_ CONST_231_1 : 231|1@1+ (1,0) [0|1] "raw" XXX
 SG_ UNK_232_7 : 232|7@1+ (1,0) [0|127] "raw" XXX
 SG_ UNK_239_1 : 239|1@1+ (1,0) [0|1] "raw" XXX
 SG_ UNK_240_7 : 240|7@1+ (1,0) [0|127] "raw" XXX
 SG_ CONST_247_1 : 247|1@1+ (1,0) [0|1] "raw" XXX
 SG_ UNK_248_7 : 248|7@1+ (1,0) [0|127] "raw" XXX
 SG_ CONST_255_1 : 255|1@1+ (1,0) [0|1] "raw" XXX
 SG_ UNK_256_6 : 256|6@1+ (1,0) [0|63] "raw" XXX
 SG_ UNK_262_2 : 262|2@1+ (1,0) [0|3] "raw" XXX
 SG_ UNK_264_5 : 264|5@1+ (1,0) [0|31] "raw" XXX
 SG_ UNK_269_3 : 269|3@1+ (1,0) [0|7] "raw" XXX
 SG_ UNK_272_5 : 272|5@1+ (1,0) [0|31] "raw" XXX
 SG_ CONST_277_11 : 277|11@1+ (1,0) [0|2047] "raw" XXX

BO_ 1806 ARS510_OBJ_14: 48 RADAR
 SG_ STATE_CODE : 0|2@1+ (1,0) [0|3] "raw" XXX
 SG_ SLOT_INDEX_CODE : 2|6@1+ (1,0) [0|63] "raw" XXX
 SG_ UNK_8_6 : 8|6@1+ (1,0) [0|63] "raw" XXX
 SG_ ONCOMING_FLAG : 14|1@1+ (1,0) [0|1] "" XXX
 SG_ UNK_15_1 : 15|1@1+ (1,0) [0|1] "raw" XXX
 SG_ SCORE_CODE : 16|8@1+ (1,0) [0|255] "raw" XXX
 SG_ AGE : 24|7@1+ (1,0) [0|126] "cycles" XXX
 SG_ CONST_31_1 : 31|1@1+ (1,0) [0|1] "raw" XXX
 SG_ DREL : 32|12@1+ (0.0625,-10) [-10|245.9375] "m" XXX
 SG_ YREL_LEFT : 44|12@1+ (0.015625,-32) [-32|31.984375] "m" XXX
 SG_ UNK_56_7 : 56|7@1+ (1,0) [0|127] "raw" XXX
 SG_ UNK_63_1 : 63|1@1+ (1,0) [0|1] "raw" XXX
 SG_ VLONG_OVER_GROUND : 64|10@1+ (0.15,-76.575) [-76.575|76.875] "m/s" XXX
 SG_ VLAT_OVER_GROUND_PROV : 74|10@1+ (0.15,-76.575) [-76.575|76.875] "m/s" XXX
 SG_ ALONG_LIKE_84 : 84|10@1+ (1,-511) [-511|512] "code" XXX
 SG_ CONST_94_2 : 94|2@1+ (1,0) [0|3] "raw" XXX
 SG_ UNK_96 : 96|10@1+ (1,0) [0|1023] "raw" XXX
 SG_ UNK_106_1 : 106|1@1+ (1,0) [0|1] "raw" XXX
 SG_ UNK_107_1 : 107|1@1+ (1,0) [0|1] "raw" XXX
 SG_ CONST_108_1 : 108|1@1+ (1,0) [0|1] "raw" XXX
 SG_ MOVE_STATE : 109|2@1+ (1,0) [0|3] "" XXX
 SG_ UNK_111_4 : 111|4@1+ (1,0) [0|15] "raw" XXX
 SG_ UNK_115_8 : 115|8@1+ (1,0) [0|255] "raw" XXX
 SG_ CONST_123_5 : 123|5@1+ (1,0) [0|31] "raw" XXX
 SG_ UNK_128_2 : 128|2@1+ (1,0) [0|3] "raw" XXX
 SG_ UNK_130_1 : 130|1@1+ (1,0) [0|1] "raw" XXX
 SG_ UNK_131_4 : 131|4@1+ (1,0) [0|15] "raw" XXX
 SG_ CONST_135_1 : 135|1@1+ (1,0) [0|1] "raw" XXX
 SG_ UNK_136_6 : 136|6@1+ (1,0) [0|63] "raw" XXX
 SG_ UNK_142_1 : 142|1@1+ (1,0) [0|1] "raw" XXX
 SG_ CONST_143_5 : 143|5@1+ (1,0) [0|31] "raw" XXX
 SG_ UNK_148_8 : 148|8@1+ (1,0) [0|255] "raw" XXX
 SG_ UNK_156_4 : 156|4@1+ (1,0) [0|15] "raw" XXX
 SG_ CONST_160_3 : 160|3@1+ (1,0) [0|7] "raw" XXX
 SG_ UNK_163_2 : 163|2@1+ (1,0) [0|3] "raw" XXX
 SG_ UNK_165_3 : 165|3@1+ (1,0) [0|7] "raw" XXX
 SG_ UNK_168_10 : 168|10@1+ (1,0) [0|1023] "raw" XXX
 SG_ CONST_178_3 : 178|3@1+ (1,0) [0|7] "raw" XXX
 SG_ UNK_181_1 : 181|1@1+ (1,0) [0|1] "raw" XXX
 SG_ UNK_182_1 : 182|1@1+ (1,0) [0|1] "raw" XXX
 SG_ UNK_183_7 : 183|7@1+ (1,0) [0|127] "raw" XXX
 SG_ UNK_190_10 : 190|10@1+ (1,0) [0|1023] "raw" XXX
 SG_ UNK_200_7 : 200|7@1+ (1,0) [0|127] "raw" XXX
 SG_ CONST_207_1 : 207|1@1+ (1,0) [0|1] "raw" XXX
 SG_ UNK_208_6 : 208|6@1+ (1,0) [0|63] "raw" XXX
 SG_ CONST_214_2 : 214|2@1+ (1,0) [0|3] "raw" XXX
 SG_ UNK_216_6 : 216|6@1+ (1,0) [0|63] "raw" XXX
 SG_ CONST_222_2 : 222|2@1+ (1,0) [0|3] "raw" XXX
 SG_ UNK_224_7 : 224|7@1+ (1,0) [0|127] "raw" XXX
 SG_ CONST_231_1 : 231|1@1+ (1,0) [0|1] "raw" XXX
 SG_ UNK_232_7 : 232|7@1+ (1,0) [0|127] "raw" XXX
 SG_ UNK_239_1 : 239|1@1+ (1,0) [0|1] "raw" XXX
 SG_ UNK_240_7 : 240|7@1+ (1,0) [0|127] "raw" XXX
 SG_ CONST_247_1 : 247|1@1+ (1,0) [0|1] "raw" XXX
 SG_ UNK_248_7 : 248|7@1+ (1,0) [0|127] "raw" XXX
 SG_ CONST_255_1 : 255|1@1+ (1,0) [0|1] "raw" XXX
 SG_ UNK_256_6 : 256|6@1+ (1,0) [0|63] "raw" XXX
 SG_ UNK_262_2 : 262|2@1+ (1,0) [0|3] "raw" XXX
 SG_ UNK_264_5 : 264|5@1+ (1,0) [0|31] "raw" XXX
 SG_ UNK_269_3 : 269|3@1+ (1,0) [0|7] "raw" XXX
 SG_ UNK_272_5 : 272|5@1+ (1,0) [0|31] "raw" XXX
 SG_ CONST_277_11 : 277|11@1+ (1,0) [0|2047] "raw" XXX

BO_ 1807 ARS510_OBJ_15: 48 RADAR
 SG_ STATE_CODE : 0|2@1+ (1,0) [0|3] "raw" XXX
 SG_ SLOT_INDEX_CODE : 2|6@1+ (1,0) [0|63] "raw" XXX
 SG_ UNK_8_6 : 8|6@1+ (1,0) [0|63] "raw" XXX
 SG_ ONCOMING_FLAG : 14|1@1+ (1,0) [0|1] "" XXX
 SG_ UNK_15_1 : 15|1@1+ (1,0) [0|1] "raw" XXX
 SG_ SCORE_CODE : 16|8@1+ (1,0) [0|255] "raw" XXX
 SG_ AGE : 24|7@1+ (1,0) [0|126] "cycles" XXX
 SG_ CONST_31_1 : 31|1@1+ (1,0) [0|1] "raw" XXX
 SG_ DREL : 32|12@1+ (0.0625,-10) [-10|245.9375] "m" XXX
 SG_ YREL_LEFT : 44|12@1+ (0.015625,-32) [-32|31.984375] "m" XXX
 SG_ UNK_56_7 : 56|7@1+ (1,0) [0|127] "raw" XXX
 SG_ UNK_63_1 : 63|1@1+ (1,0) [0|1] "raw" XXX
 SG_ VLONG_OVER_GROUND : 64|10@1+ (0.15,-76.575) [-76.575|76.875] "m/s" XXX
 SG_ VLAT_OVER_GROUND_PROV : 74|10@1+ (0.15,-76.575) [-76.575|76.875] "m/s" XXX
 SG_ ALONG_LIKE_84 : 84|10@1+ (1,-511) [-511|512] "code" XXX
 SG_ CONST_94_2 : 94|2@1+ (1,0) [0|3] "raw" XXX
 SG_ UNK_96 : 96|10@1+ (1,0) [0|1023] "raw" XXX
 SG_ UNK_106_1 : 106|1@1+ (1,0) [0|1] "raw" XXX
 SG_ UNK_107_1 : 107|1@1+ (1,0) [0|1] "raw" XXX
 SG_ CONST_108_1 : 108|1@1+ (1,0) [0|1] "raw" XXX
 SG_ MOVE_STATE : 109|2@1+ (1,0) [0|3] "" XXX
 SG_ UNK_111_4 : 111|4@1+ (1,0) [0|15] "raw" XXX
 SG_ UNK_115_8 : 115|8@1+ (1,0) [0|255] "raw" XXX
 SG_ CONST_123_5 : 123|5@1+ (1,0) [0|31] "raw" XXX
 SG_ UNK_128_2 : 128|2@1+ (1,0) [0|3] "raw" XXX
 SG_ UNK_130_1 : 130|1@1+ (1,0) [0|1] "raw" XXX
 SG_ UNK_131_4 : 131|4@1+ (1,0) [0|15] "raw" XXX
 SG_ CONST_135_1 : 135|1@1+ (1,0) [0|1] "raw" XXX
 SG_ UNK_136_6 : 136|6@1+ (1,0) [0|63] "raw" XXX
 SG_ UNK_142_1 : 142|1@1+ (1,0) [0|1] "raw" XXX
 SG_ CONST_143_5 : 143|5@1+ (1,0) [0|31] "raw" XXX
 SG_ UNK_148_8 : 148|8@1+ (1,0) [0|255] "raw" XXX
 SG_ UNK_156_4 : 156|4@1+ (1,0) [0|15] "raw" XXX
 SG_ CONST_160_3 : 160|3@1+ (1,0) [0|7] "raw" XXX
 SG_ UNK_163_2 : 163|2@1+ (1,0) [0|3] "raw" XXX
 SG_ UNK_165_3 : 165|3@1+ (1,0) [0|7] "raw" XXX
 SG_ UNK_168_10 : 168|10@1+ (1,0) [0|1023] "raw" XXX
 SG_ CONST_178_3 : 178|3@1+ (1,0) [0|7] "raw" XXX
 SG_ UNK_181_1 : 181|1@1+ (1,0) [0|1] "raw" XXX
 SG_ UNK_182_1 : 182|1@1+ (1,0) [0|1] "raw" XXX
 SG_ UNK_183_7 : 183|7@1+ (1,0) [0|127] "raw" XXX
 SG_ UNK_190_10 : 190|10@1+ (1,0) [0|1023] "raw" XXX
 SG_ UNK_200_7 : 200|7@1+ (1,0) [0|127] "raw" XXX
 SG_ CONST_207_1 : 207|1@1+ (1,0) [0|1] "raw" XXX
 SG_ UNK_208_6 : 208|6@1+ (1,0) [0|63] "raw" XXX
 SG_ CONST_214_2 : 214|2@1+ (1,0) [0|3] "raw" XXX
 SG_ UNK_216_6 : 216|6@1+ (1,0) [0|63] "raw" XXX
 SG_ CONST_222_2 : 222|2@1+ (1,0) [0|3] "raw" XXX
 SG_ UNK_224_7 : 224|7@1+ (1,0) [0|127] "raw" XXX
 SG_ CONST_231_1 : 231|1@1+ (1,0) [0|1] "raw" XXX
 SG_ UNK_232_7 : 232|7@1+ (1,0) [0|127] "raw" XXX
 SG_ UNK_239_1 : 239|1@1+ (1,0) [0|1] "raw" XXX
 SG_ UNK_240_7 : 240|7@1+ (1,0) [0|127] "raw" XXX
 SG_ CONST_247_1 : 247|1@1+ (1,0) [0|1] "raw" XXX
 SG_ UNK_248_7 : 248|7@1+ (1,0) [0|127] "raw" XXX
 SG_ CONST_255_1 : 255|1@1+ (1,0) [0|1] "raw" XXX
 SG_ UNK_256_6 : 256|6@1+ (1,0) [0|63] "raw" XXX
 SG_ UNK_262_2 : 262|2@1+ (1,0) [0|3] "raw" XXX
 SG_ UNK_264_5 : 264|5@1+ (1,0) [0|31] "raw" XXX
 SG_ UNK_269_3 : 269|3@1+ (1,0) [0|7] "raw" XXX
 SG_ UNK_272_5 : 272|5@1+ (1,0) [0|31] "raw" XXX
 SG_ CONST_277_11 : 277|11@1+ (1,0) [0|2047] "raw" XXX

BO_ 1808 ARS510_OBJ_16: 48 RADAR
 SG_ STATE_CODE : 0|2@1+ (1,0) [0|3] "raw" XXX
 SG_ SLOT_INDEX_CODE : 2|6@1+ (1,0) [0|63] "raw" XXX
 SG_ UNK_8_6 : 8|6@1+ (1,0) [0|63] "raw" XXX
 SG_ ONCOMING_FLAG : 14|1@1+ (1,0) [0|1] "" XXX
 SG_ UNK_15_1 : 15|1@1+ (1,0) [0|1] "raw" XXX
 SG_ SCORE_CODE : 16|8@1+ (1,0) [0|255] "raw" XXX
 SG_ AGE : 24|7@1+ (1,0) [0|126] "cycles" XXX
 SG_ CONST_31_1 : 31|1@1+ (1,0) [0|1] "raw" XXX
 SG_ DREL : 32|12@1+ (0.0625,-10) [-10|245.9375] "m" XXX
 SG_ YREL_LEFT : 44|12@1+ (0.015625,-32) [-32|31.984375] "m" XXX
 SG_ UNK_56_7 : 56|7@1+ (1,0) [0|127] "raw" XXX
 SG_ UNK_63_1 : 63|1@1+ (1,0) [0|1] "raw" XXX
 SG_ VLONG_OVER_GROUND : 64|10@1+ (0.15,-76.575) [-76.575|76.875] "m/s" XXX
 SG_ VLAT_OVER_GROUND_PROV : 74|10@1+ (0.15,-76.575) [-76.575|76.875] "m/s" XXX
 SG_ ALONG_LIKE_84 : 84|10@1+ (1,-511) [-511|512] "code" XXX
 SG_ CONST_94_2 : 94|2@1+ (1,0) [0|3] "raw" XXX
 SG_ UNK_96 : 96|10@1+ (1,0) [0|1023] "raw" XXX
 SG_ UNK_106_1 : 106|1@1+ (1,0) [0|1] "raw" XXX
 SG_ UNK_107_1 : 107|1@1+ (1,0) [0|1] "raw" XXX
 SG_ CONST_108_1 : 108|1@1+ (1,0) [0|1] "raw" XXX
 SG_ MOVE_STATE : 109|2@1+ (1,0) [0|3] "" XXX
 SG_ UNK_111_4 : 111|4@1+ (1,0) [0|15] "raw" XXX
 SG_ UNK_115_8 : 115|8@1+ (1,0) [0|255] "raw" XXX
 SG_ CONST_123_5 : 123|5@1+ (1,0) [0|31] "raw" XXX
 SG_ UNK_128_2 : 128|2@1+ (1,0) [0|3] "raw" XXX
 SG_ UNK_130_1 : 130|1@1+ (1,0) [0|1] "raw" XXX
 SG_ UNK_131_4 : 131|4@1+ (1,0) [0|15] "raw" XXX
 SG_ CONST_135_1 : 135|1@1+ (1,0) [0|1] "raw" XXX
 SG_ UNK_136_6 : 136|6@1+ (1,0) [0|63] "raw" XXX
 SG_ UNK_142_1 : 142|1@1+ (1,0) [0|1] "raw" XXX
 SG_ CONST_143_5 : 143|5@1+ (1,0) [0|31] "raw" XXX
 SG_ UNK_148_8 : 148|8@1+ (1,0) [0|255] "raw" XXX
 SG_ UNK_156_4 : 156|4@1+ (1,0) [0|15] "raw" XXX
 SG_ CONST_160_3 : 160|3@1+ (1,0) [0|7] "raw" XXX
 SG_ UNK_163_2 : 163|2@1+ (1,0) [0|3] "raw" XXX
 SG_ UNK_165_3 : 165|3@1+ (1,0) [0|7] "raw" XXX
 SG_ UNK_168_10 : 168|10@1+ (1,0) [0|1023] "raw" XXX
 SG_ CONST_178_3 : 178|3@1+ (1,0) [0|7] "raw" XXX
 SG_ UNK_181_1 : 181|1@1+ (1,0) [0|1] "raw" XXX
 SG_ UNK_182_1 : 182|1@1+ (1,0) [0|1] "raw" XXX
 SG_ UNK_183_7 : 183|7@1+ (1,0) [0|127] "raw" XXX
 SG_ UNK_190_10 : 190|10@1+ (1,0) [0|1023] "raw" XXX
 SG_ UNK_200_7 : 200|7@1+ (1,0) [0|127] "raw" XXX
 SG_ CONST_207_1 : 207|1@1+ (1,0) [0|1] "raw" XXX
 SG_ UNK_208_6 : 208|6@1+ (1,0) [0|63] "raw" XXX
 SG_ CONST_214_2 : 214|2@1+ (1,0) [0|3] "raw" XXX
 SG_ UNK_216_6 : 216|6@1+ (1,0) [0|63] "raw" XXX
 SG_ CONST_222_2 : 222|2@1+ (1,0) [0|3] "raw" XXX
 SG_ UNK_224_7 : 224|7@1+ (1,0) [0|127] "raw" XXX
 SG_ CONST_231_1 : 231|1@1+ (1,0) [0|1] "raw" XXX
 SG_ UNK_232_7 : 232|7@1+ (1,0) [0|127] "raw" XXX
 SG_ UNK_239_1 : 239|1@1+ (1,0) [0|1] "raw" XXX
 SG_ UNK_240_7 : 240|7@1+ (1,0) [0|127] "raw" XXX
 SG_ CONST_247_1 : 247|1@1+ (1,0) [0|1] "raw" XXX
 SG_ UNK_248_7 : 248|7@1+ (1,0) [0|127] "raw" XXX
 SG_ CONST_255_1 : 255|1@1+ (1,0) [0|1] "raw" XXX
 SG_ UNK_256_6 : 256|6@1+ (1,0) [0|63] "raw" XXX
 SG_ UNK_262_2 : 262|2@1+ (1,0) [0|3] "raw" XXX
 SG_ UNK_264_5 : 264|5@1+ (1,0) [0|31] "raw" XXX
 SG_ UNK_269_3 : 269|3@1+ (1,0) [0|7] "raw" XXX
 SG_ UNK_272_5 : 272|5@1+ (1,0) [0|31] "raw" XXX
 SG_ CONST_277_11 : 277|11@1+ (1,0) [0|2047] "raw" XXX

BO_ 1809 ARS510_OBJ_17: 48 RADAR
 SG_ STATE_CODE : 0|2@1+ (1,0) [0|3] "raw" XXX
 SG_ SLOT_INDEX_CODE : 2|6@1+ (1,0) [0|63] "raw" XXX
 SG_ UNK_8_6 : 8|6@1+ (1,0) [0|63] "raw" XXX
 SG_ ONCOMING_FLAG : 14|1@1+ (1,0) [0|1] "" XXX
 SG_ UNK_15_1 : 15|1@1+ (1,0) [0|1] "raw" XXX
 SG_ SCORE_CODE : 16|8@1+ (1,0) [0|255] "raw" XXX
 SG_ AGE : 24|7@1+ (1,0) [0|126] "cycles" XXX
 SG_ CONST_31_1 : 31|1@1+ (1,0) [0|1] "raw" XXX
 SG_ DREL : 32|12@1+ (0.0625,-10) [-10|245.9375] "m" XXX
 SG_ YREL_LEFT : 44|12@1+ (0.015625,-32) [-32|31.984375] "m" XXX
 SG_ UNK_56_7 : 56|7@1+ (1,0) [0|127] "raw" XXX
 SG_ UNK_63_1 : 63|1@1+ (1,0) [0|1] "raw" XXX
 SG_ VLONG_OVER_GROUND : 64|10@1+ (0.15,-76.575) [-76.575|76.875] "m/s" XXX
 SG_ VLAT_OVER_GROUND_PROV : 74|10@1+ (0.15,-76.575) [-76.575|76.875] "m/s" XXX
 SG_ ALONG_LIKE_84 : 84|10@1+ (1,-511) [-511|512] "code" XXX
 SG_ CONST_94_2 : 94|2@1+ (1,0) [0|3] "raw" XXX
 SG_ UNK_96 : 96|10@1+ (1,0) [0|1023] "raw" XXX
 SG_ UNK_106_1 : 106|1@1+ (1,0) [0|1] "raw" XXX
 SG_ UNK_107_1 : 107|1@1+ (1,0) [0|1] "raw" XXX
 SG_ CONST_108_1 : 108|1@1+ (1,0) [0|1] "raw" XXX
 SG_ MOVE_STATE : 109|2@1+ (1,0) [0|3] "" XXX
 SG_ UNK_111_4 : 111|4@1+ (1,0) [0|15] "raw" XXX
 SG_ UNK_115_8 : 115|8@1+ (1,0) [0|255] "raw" XXX
 SG_ CONST_123_5 : 123|5@1+ (1,0) [0|31] "raw" XXX
 SG_ UNK_128_2 : 128|2@1+ (1,0) [0|3] "raw" XXX
 SG_ UNK_130_1 : 130|1@1+ (1,0) [0|1] "raw" XXX
 SG_ UNK_131_4 : 131|4@1+ (1,0) [0|15] "raw" XXX
 SG_ CONST_135_1 : 135|1@1+ (1,0) [0|1] "raw" XXX
 SG_ UNK_136_6 : 136|6@1+ (1,0) [0|63] "raw" XXX
 SG_ UNK_142_1 : 142|1@1+ (1,0) [0|1] "raw" XXX
 SG_ CONST_143_5 : 143|5@1+ (1,0) [0|31] "raw" XXX
 SG_ UNK_148_8 : 148|8@1+ (1,0) [0|255] "raw" XXX
 SG_ UNK_156_4 : 156|4@1+ (1,0) [0|15] "raw" XXX
 SG_ CONST_160_3 : 160|3@1+ (1,0) [0|7] "raw" XXX
 SG_ UNK_163_2 : 163|2@1+ (1,0) [0|3] "raw" XXX
 SG_ UNK_165_3 : 165|3@1+ (1,0) [0|7] "raw" XXX
 SG_ UNK_168_10 : 168|10@1+ (1,0) [0|1023] "raw" XXX
 SG_ CONST_178_3 : 178|3@1+ (1,0) [0|7] "raw" XXX
 SG_ UNK_181_1 : 181|1@1+ (1,0) [0|1] "raw" XXX
 SG_ UNK_182_1 : 182|1@1+ (1,0) [0|1] "raw" XXX
 SG_ UNK_183_7 : 183|7@1+ (1,0) [0|127] "raw" XXX
 SG_ UNK_190_10 : 190|10@1+ (1,0) [0|1023] "raw" XXX
 SG_ UNK_200_7 : 200|7@1+ (1,0) [0|127] "raw" XXX
 SG_ CONST_207_1 : 207|1@1+ (1,0) [0|1] "raw" XXX
 SG_ UNK_208_6 : 208|6@1+ (1,0) [0|63] "raw" XXX
 SG_ CONST_214_2 : 214|2@1+ (1,0) [0|3] "raw" XXX
 SG_ UNK_216_6 : 216|6@1+ (1,0) [0|63] "raw" XXX
 SG_ CONST_222_2 : 222|2@1+ (1,0) [0|3] "raw" XXX
 SG_ UNK_224_7 : 224|7@1+ (1,0) [0|127] "raw" XXX
 SG_ CONST_231_1 : 231|1@1+ (1,0) [0|1] "raw" XXX
 SG_ UNK_232_7 : 232|7@1+ (1,0) [0|127] "raw" XXX
 SG_ UNK_239_1 : 239|1@1+ (1,0) [0|1] "raw" XXX
 SG_ UNK_240_7 : 240|7@1+ (1,0) [0|127] "raw" XXX
 SG_ CONST_247_1 : 247|1@1+ (1,0) [0|1] "raw" XXX
 SG_ UNK_248_7 : 248|7@1+ (1,0) [0|127] "raw" XXX
 SG_ CONST_255_1 : 255|1@1+ (1,0) [0|1] "raw" XXX
 SG_ UNK_256_6 : 256|6@1+ (1,0) [0|63] "raw" XXX
 SG_ UNK_262_2 : 262|2@1+ (1,0) [0|3] "raw" XXX
 SG_ UNK_264_5 : 264|5@1+ (1,0) [0|31] "raw" XXX
 SG_ UNK_269_3 : 269|3@1+ (1,0) [0|7] "raw" XXX
 SG_ UNK_272_5 : 272|5@1+ (1,0) [0|31] "raw" XXX
 SG_ CONST_277_11 : 277|11@1+ (1,0) [0|2047] "raw" XXX

BO_ 1810 ARS510_OBJ_18: 48 RADAR
 SG_ STATE_CODE : 0|2@1+ (1,0) [0|3] "raw" XXX
 SG_ SLOT_INDEX_CODE : 2|6@1+ (1,0) [0|63] "raw" XXX
 SG_ UNK_8_6 : 8|6@1+ (1,0) [0|63] "raw" XXX
 SG_ ONCOMING_FLAG : 14|1@1+ (1,0) [0|1] "" XXX
 SG_ UNK_15_1 : 15|1@1+ (1,0) [0|1] "raw" XXX
 SG_ SCORE_CODE : 16|8@1+ (1,0) [0|255] "raw" XXX
 SG_ AGE : 24|7@1+ (1,0) [0|126] "cycles" XXX
 SG_ CONST_31_1 : 31|1@1+ (1,0) [0|1] "raw" XXX
 SG_ DREL : 32|12@1+ (0.0625,-10) [-10|245.9375] "m" XXX
 SG_ YREL_LEFT : 44|12@1+ (0.015625,-32) [-32|31.984375] "m" XXX
 SG_ UNK_56_7 : 56|7@1+ (1,0) [0|127] "raw" XXX
 SG_ UNK_63_1 : 63|1@1+ (1,0) [0|1] "raw" XXX
 SG_ VLONG_OVER_GROUND : 64|10@1+ (0.15,-76.575) [-76.575|76.875] "m/s" XXX
 SG_ VLAT_OVER_GROUND_PROV : 74|10@1+ (0.15,-76.575) [-76.575|76.875] "m/s" XXX
 SG_ ALONG_LIKE_84 : 84|10@1+ (1,-511) [-511|512] "code" XXX
 SG_ CONST_94_2 : 94|2@1+ (1,0) [0|3] "raw" XXX
 SG_ UNK_96 : 96|10@1+ (1,0) [0|1023] "raw" XXX
 SG_ UNK_106_1 : 106|1@1+ (1,0) [0|1] "raw" XXX
 SG_ UNK_107_1 : 107|1@1+ (1,0) [0|1] "raw" XXX
 SG_ CONST_108_1 : 108|1@1+ (1,0) [0|1] "raw" XXX
 SG_ MOVE_STATE : 109|2@1+ (1,0) [0|3] "" XXX
 SG_ UNK_111_4 : 111|4@1+ (1,0) [0|15] "raw" XXX
 SG_ UNK_115_8 : 115|8@1+ (1,0) [0|255] "raw" XXX
 SG_ CONST_123_5 : 123|5@1+ (1,0) [0|31] "raw" XXX
 SG_ UNK_128_2 : 128|2@1+ (1,0) [0|3] "raw" XXX
 SG_ UNK_130_1 : 130|1@1+ (1,0) [0|1] "raw" XXX
 SG_ UNK_131_4 : 131|4@1+ (1,0) [0|15] "raw" XXX
 SG_ CONST_135_1 : 135|1@1+ (1,0) [0|1] "raw" XXX
 SG_ UNK_136_6 : 136|6@1+ (1,0) [0|63] "raw" XXX
 SG_ UNK_142_1 : 142|1@1+ (1,0) [0|1] "raw" XXX
 SG_ CONST_143_5 : 143|5@1+ (1,0) [0|31] "raw" XXX
 SG_ UNK_148_8 : 148|8@1+ (1,0) [0|255] "raw" XXX
 SG_ UNK_156_4 : 156|4@1+ (1,0) [0|15] "raw" XXX
 SG_ CONST_160_3 : 160|3@1+ (1,0) [0|7] "raw" XXX
 SG_ UNK_163_2 : 163|2@1+ (1,0) [0|3] "raw" XXX
 SG_ UNK_165_3 : 165|3@1+ (1,0) [0|7] "raw" XXX
 SG_ UNK_168_10 : 168|10@1+ (1,0) [0|1023] "raw" XXX
 SG_ CONST_178_3 : 178|3@1+ (1,0) [0|7] "raw" XXX
 SG_ UNK_181_1 : 181|1@1+ (1,0) [0|1] "raw" XXX
 SG_ UNK_182_1 : 182|1@1+ (1,0) [0|1] "raw" XXX
 SG_ UNK_183_7 : 183|7@1+ (1,0) [0|127] "raw" XXX
 SG_ UNK_190_10 : 190|10@1+ (1,0) [0|1023] "raw" XXX
 SG_ UNK_200_7 : 200|7@1+ (1,0) [0|127] "raw" XXX
 SG_ CONST_207_1 : 207|1@1+ (1,0) [0|1] "raw" XXX
 SG_ UNK_208_6 : 208|6@1+ (1,0) [0|63] "raw" XXX
 SG_ CONST_214_2 : 214|2@1+ (1,0) [0|3] "raw" XXX
 SG_ UNK_216_6 : 216|6@1+ (1,0) [0|63] "raw" XXX
 SG_ CONST_222_2 : 222|2@1+ (1,0) [0|3] "raw" XXX
 SG_ UNK_224_7 : 224|7@1+ (1,0) [0|127] "raw" XXX
 SG_ CONST_231_1 : 231|1@1+ (1,0) [0|1] "raw" XXX
 SG_ UNK_232_7 : 232|7@1+ (1,0) [0|127] "raw" XXX
 SG_ UNK_239_1 : 239|1@1+ (1,0) [0|1] "raw" XXX
 SG_ UNK_240_7 : 240|7@1+ (1,0) [0|127] "raw" XXX
 SG_ CONST_247_1 : 247|1@1+ (1,0) [0|1] "raw" XXX
 SG_ UNK_248_7 : 248|7@1+ (1,0) [0|127] "raw" XXX
 SG_ CONST_255_1 : 255|1@1+ (1,0) [0|1] "raw" XXX
 SG_ UNK_256_6 : 256|6@1+ (1,0) [0|63] "raw" XXX
 SG_ UNK_262_2 : 262|2@1+ (1,0) [0|3] "raw" XXX
 SG_ UNK_264_5 : 264|5@1+ (1,0) [0|31] "raw" XXX
 SG_ UNK_269_3 : 269|3@1+ (1,0) [0|7] "raw" XXX
 SG_ UNK_272_5 : 272|5@1+ (1,0) [0|31] "raw" XXX
 SG_ CONST_277_11 : 277|11@1+ (1,0) [0|2047] "raw" XXX

BO_ 1811 ARS510_OBJ_19: 48 RADAR
 SG_ STATE_CODE : 0|2@1+ (1,0) [0|3] "raw" XXX
 SG_ SLOT_INDEX_CODE : 2|6@1+ (1,0) [0|63] "raw" XXX
 SG_ UNK_8_6 : 8|6@1+ (1,0) [0|63] "raw" XXX
 SG_ ONCOMING_FLAG : 14|1@1+ (1,0) [0|1] "" XXX
 SG_ UNK_15_1 : 15|1@1+ (1,0) [0|1] "raw" XXX
 SG_ SCORE_CODE : 16|8@1+ (1,0) [0|255] "raw" XXX
 SG_ AGE : 24|7@1+ (1,0) [0|126] "cycles" XXX
 SG_ CONST_31_1 : 31|1@1+ (1,0) [0|1] "raw" XXX
 SG_ DREL : 32|12@1+ (0.0625,-10) [-10|245.9375] "m" XXX
 SG_ YREL_LEFT : 44|12@1+ (0.015625,-32) [-32|31.984375] "m" XXX
 SG_ UNK_56_7 : 56|7@1+ (1,0) [0|127] "raw" XXX
 SG_ UNK_63_1 : 63|1@1+ (1,0) [0|1] "raw" XXX
 SG_ VLONG_OVER_GROUND : 64|10@1+ (0.15,-76.575) [-76.575|76.875] "m/s" XXX
 SG_ VLAT_OVER_GROUND_PROV : 74|10@1+ (0.15,-76.575) [-76.575|76.875] "m/s" XXX
 SG_ ALONG_LIKE_84 : 84|10@1+ (1,-511) [-511|512] "code" XXX
 SG_ CONST_94_2 : 94|2@1+ (1,0) [0|3] "raw" XXX
 SG_ UNK_96 : 96|10@1+ (1,0) [0|1023] "raw" XXX
 SG_ UNK_106_1 : 106|1@1+ (1,0) [0|1] "raw" XXX
 SG_ UNK_107_1 : 107|1@1+ (1,0) [0|1] "raw" XXX
 SG_ CONST_108_1 : 108|1@1+ (1,0) [0|1] "raw" XXX
 SG_ MOVE_STATE : 109|2@1+ (1,0) [0|3] "" XXX
 SG_ UNK_111_4 : 111|4@1+ (1,0) [0|15] "raw" XXX
 SG_ UNK_115_8 : 115|8@1+ (1,0) [0|255] "raw" XXX
 SG_ CONST_123_5 : 123|5@1+ (1,0) [0|31] "raw" XXX
 SG_ UNK_128_2 : 128|2@1+ (1,0) [0|3] "raw" XXX
 SG_ UNK_130_1 : 130|1@1+ (1,0) [0|1] "raw" XXX
 SG_ UNK_131_4 : 131|4@1+ (1,0) [0|15] "raw" XXX
 SG_ CONST_135_1 : 135|1@1+ (1,0) [0|1] "raw" XXX
 SG_ UNK_136_6 : 136|6@1+ (1,0) [0|63] "raw" XXX
 SG_ UNK_142_1 : 142|1@1+ (1,0) [0|1] "raw" XXX
 SG_ CONST_143_5 : 143|5@1+ (1,0) [0|31] "raw" XXX
 SG_ UNK_148_8 : 148|8@1+ (1,0) [0|255] "raw" XXX
 SG_ UNK_156_4 : 156|4@1+ (1,0) [0|15] "raw" XXX
 SG_ CONST_160_3 : 160|3@1+ (1,0) [0|7] "raw" XXX
 SG_ UNK_163_2 : 163|2@1+ (1,0) [0|3] "raw" XXX
 SG_ UNK_165_3 : 165|3@1+ (1,0) [0|7] "raw" XXX
 SG_ UNK_168_10 : 168|10@1+ (1,0) [0|1023] "raw" XXX
 SG_ CONST_178_3 : 178|3@1+ (1,0) [0|7] "raw" XXX
 SG_ UNK_181_1 : 181|1@1+ (1,0) [0|1] "raw" XXX
 SG_ UNK_182_1 : 182|1@1+ (1,0) [0|1] "raw" XXX
 SG_ UNK_183_7 : 183|7@1+ (1,0) [0|127] "raw" XXX
 SG_ UNK_190_10 : 190|10@1+ (1,0) [0|1023] "raw" XXX
 SG_ UNK_200_7 : 200|7@1+ (1,0) [0|127] "raw" XXX
 SG_ CONST_207_1 : 207|1@1+ (1,0) [0|1] "raw" XXX
 SG_ UNK_208_6 : 208|6@1+ (1,0) [0|63] "raw" XXX
 SG_ CONST_214_2 : 214|2@1+ (1,0) [0|3] "raw" XXX
 SG_ UNK_216_6 : 216|6@1+ (1,0) [0|63] "raw" XXX
 SG_ CONST_222_2 : 222|2@1+ (1,0) [0|3] "raw" XXX
 SG_ UNK_224_7 : 224|7@1+ (1,0) [0|127] "raw" XXX
 SG_ CONST_231_1 : 231|1@1+ (1,0) [0|1] "raw" XXX
 SG_ UNK_232_7 : 232|7@1+ (1,0) [0|127] "raw" XXX
 SG_ UNK_239_1 : 239|1@1+ (1,0) [0|1] "raw" XXX
 SG_ UNK_240_7 : 240|7@1+ (1,0) [0|127] "raw" XXX
 SG_ CONST_247_1 : 247|1@1+ (1,0) [0|1] "raw" XXX
 SG_ UNK_248_7 : 248|7@1+ (1,0) [0|127] "raw" XXX
 SG_ CONST_255_1 : 255|1@1+ (1,0) [0|1] "raw" XXX
 SG_ UNK_256_6 : 256|6@1+ (1,0) [0|63] "raw" XXX
 SG_ UNK_262_2 : 262|2@1+ (1,0) [0|3] "raw" XXX
 SG_ UNK_264_5 : 264|5@1+ (1,0) [0|31] "raw" XXX
 SG_ UNK_269_3 : 269|3@1+ (1,0) [0|7] "raw" XXX
 SG_ UNK_272_5 : 272|5@1+ (1,0) [0|31] "raw" XXX
 SG_ CONST_277_11 : 277|11@1+ (1,0) [0|2047] "raw" XXX

BO_ 1824 ARS510_OBJ_00_DERIVED: 16 XXX
 SG_ TRACK_ID_OP : 0|16@1+ (1,0) [0|65535] "" XXX
 SG_ TRACK_ID_RAW : 16|16@1+ (1,0) [0|65535] "" XXX
 SG_ PUBLISHED_OP : 32|1@1+ (1,0) [0|1] "" XXX
 SG_ SETTLED : 33|1@1+ (1,0) [0|1] "" XXX
 SG_ VREL_VALID : 34|1@1+ (1,0) [0|1] "" XXX
 SG_ DREL_FUSED_VALID : 35|1@1+ (1,0) [0|1] "" XXX
 SG_ VREL_SMOOTHED_VALID : 36|1@1+ (1,0) [0|1] "" XXX
 SG_ VREL : 40|16@1- (0.01,0) [-327.68|327.67] "m/s" XXX
 SG_ V_EGO_0xB4 : 56|16@1+ (0.01,0) [0|655.35] "m/s" XXX
 SG_ DREL_FUSED : 72|16@1+ (0.01,0) [0|655.35] "m" XXX
 SG_ VREL_SMOOTHED : 88|16@1- (0.01,0) [-327.68|327.67] "m/s" XXX

BO_ 1825 ARS510_OBJ_01_DERIVED: 16 XXX
 SG_ TRACK_ID_OP : 0|16@1+ (1,0) [0|65535] "" XXX
 SG_ TRACK_ID_RAW : 16|16@1+ (1,0) [0|65535] "" XXX
 SG_ PUBLISHED_OP : 32|1@1+ (1,0) [0|1] "" XXX
 SG_ SETTLED : 33|1@1+ (1,0) [0|1] "" XXX
 SG_ VREL_VALID : 34|1@1+ (1,0) [0|1] "" XXX
 SG_ DREL_FUSED_VALID : 35|1@1+ (1,0) [0|1] "" XXX
 SG_ VREL_SMOOTHED_VALID : 36|1@1+ (1,0) [0|1] "" XXX
 SG_ VREL : 40|16@1- (0.01,0) [-327.68|327.67] "m/s" XXX
 SG_ V_EGO_0xB4 : 56|16@1+ (0.01,0) [0|655.35] "m/s" XXX
 SG_ DREL_FUSED : 72|16@1+ (0.01,0) [0|655.35] "m" XXX
 SG_ VREL_SMOOTHED : 88|16@1- (0.01,0) [-327.68|327.67] "m/s" XXX

BO_ 1826 ARS510_OBJ_02_DERIVED: 16 XXX
 SG_ TRACK_ID_OP : 0|16@1+ (1,0) [0|65535] "" XXX
 SG_ TRACK_ID_RAW : 16|16@1+ (1,0) [0|65535] "" XXX
 SG_ PUBLISHED_OP : 32|1@1+ (1,0) [0|1] "" XXX
 SG_ SETTLED : 33|1@1+ (1,0) [0|1] "" XXX
 SG_ VREL_VALID : 34|1@1+ (1,0) [0|1] "" XXX
 SG_ DREL_FUSED_VALID : 35|1@1+ (1,0) [0|1] "" XXX
 SG_ VREL_SMOOTHED_VALID : 36|1@1+ (1,0) [0|1] "" XXX
 SG_ VREL : 40|16@1- (0.01,0) [-327.68|327.67] "m/s" XXX
 SG_ V_EGO_0xB4 : 56|16@1+ (0.01,0) [0|655.35] "m/s" XXX
 SG_ DREL_FUSED : 72|16@1+ (0.01,0) [0|655.35] "m" XXX
 SG_ VREL_SMOOTHED : 88|16@1- (0.01,0) [-327.68|327.67] "m/s" XXX

BO_ 1827 ARS510_OBJ_03_DERIVED: 16 XXX
 SG_ TRACK_ID_OP : 0|16@1+ (1,0) [0|65535] "" XXX
 SG_ TRACK_ID_RAW : 16|16@1+ (1,0) [0|65535] "" XXX
 SG_ PUBLISHED_OP : 32|1@1+ (1,0) [0|1] "" XXX
 SG_ SETTLED : 33|1@1+ (1,0) [0|1] "" XXX
 SG_ VREL_VALID : 34|1@1+ (1,0) [0|1] "" XXX
 SG_ DREL_FUSED_VALID : 35|1@1+ (1,0) [0|1] "" XXX
 SG_ VREL_SMOOTHED_VALID : 36|1@1+ (1,0) [0|1] "" XXX
 SG_ VREL : 40|16@1- (0.01,0) [-327.68|327.67] "m/s" XXX
 SG_ V_EGO_0xB4 : 56|16@1+ (0.01,0) [0|655.35] "m/s" XXX
 SG_ DREL_FUSED : 72|16@1+ (0.01,0) [0|655.35] "m" XXX
 SG_ VREL_SMOOTHED : 88|16@1- (0.01,0) [-327.68|327.67] "m/s" XXX

BO_ 1828 ARS510_OBJ_04_DERIVED: 16 XXX
 SG_ TRACK_ID_OP : 0|16@1+ (1,0) [0|65535] "" XXX
 SG_ TRACK_ID_RAW : 16|16@1+ (1,0) [0|65535] "" XXX
 SG_ PUBLISHED_OP : 32|1@1+ (1,0) [0|1] "" XXX
 SG_ SETTLED : 33|1@1+ (1,0) [0|1] "" XXX
 SG_ VREL_VALID : 34|1@1+ (1,0) [0|1] "" XXX
 SG_ DREL_FUSED_VALID : 35|1@1+ (1,0) [0|1] "" XXX
 SG_ VREL_SMOOTHED_VALID : 36|1@1+ (1,0) [0|1] "" XXX
 SG_ VREL : 40|16@1- (0.01,0) [-327.68|327.67] "m/s" XXX
 SG_ V_EGO_0xB4 : 56|16@1+ (0.01,0) [0|655.35] "m/s" XXX
 SG_ DREL_FUSED : 72|16@1+ (0.01,0) [0|655.35] "m" XXX
 SG_ VREL_SMOOTHED : 88|16@1- (0.01,0) [-327.68|327.67] "m/s" XXX

BO_ 1829 ARS510_OBJ_05_DERIVED: 16 XXX
 SG_ TRACK_ID_OP : 0|16@1+ (1,0) [0|65535] "" XXX
 SG_ TRACK_ID_RAW : 16|16@1+ (1,0) [0|65535] "" XXX
 SG_ PUBLISHED_OP : 32|1@1+ (1,0) [0|1] "" XXX
 SG_ SETTLED : 33|1@1+ (1,0) [0|1] "" XXX
 SG_ VREL_VALID : 34|1@1+ (1,0) [0|1] "" XXX
 SG_ DREL_FUSED_VALID : 35|1@1+ (1,0) [0|1] "" XXX
 SG_ VREL_SMOOTHED_VALID : 36|1@1+ (1,0) [0|1] "" XXX
 SG_ VREL : 40|16@1- (0.01,0) [-327.68|327.67] "m/s" XXX
 SG_ V_EGO_0xB4 : 56|16@1+ (0.01,0) [0|655.35] "m/s" XXX
 SG_ DREL_FUSED : 72|16@1+ (0.01,0) [0|655.35] "m" XXX
 SG_ VREL_SMOOTHED : 88|16@1- (0.01,0) [-327.68|327.67] "m/s" XXX

BO_ 1830 ARS510_OBJ_06_DERIVED: 16 XXX
 SG_ TRACK_ID_OP : 0|16@1+ (1,0) [0|65535] "" XXX
 SG_ TRACK_ID_RAW : 16|16@1+ (1,0) [0|65535] "" XXX
 SG_ PUBLISHED_OP : 32|1@1+ (1,0) [0|1] "" XXX
 SG_ SETTLED : 33|1@1+ (1,0) [0|1] "" XXX
 SG_ VREL_VALID : 34|1@1+ (1,0) [0|1] "" XXX
 SG_ DREL_FUSED_VALID : 35|1@1+ (1,0) [0|1] "" XXX
 SG_ VREL_SMOOTHED_VALID : 36|1@1+ (1,0) [0|1] "" XXX
 SG_ VREL : 40|16@1- (0.01,0) [-327.68|327.67] "m/s" XXX
 SG_ V_EGO_0xB4 : 56|16@1+ (0.01,0) [0|655.35] "m/s" XXX
 SG_ DREL_FUSED : 72|16@1+ (0.01,0) [0|655.35] "m" XXX
 SG_ VREL_SMOOTHED : 88|16@1- (0.01,0) [-327.68|327.67] "m/s" XXX

BO_ 1831 ARS510_OBJ_07_DERIVED: 16 XXX
 SG_ TRACK_ID_OP : 0|16@1+ (1,0) [0|65535] "" XXX
 SG_ TRACK_ID_RAW : 16|16@1+ (1,0) [0|65535] "" XXX
 SG_ PUBLISHED_OP : 32|1@1+ (1,0) [0|1] "" XXX
 SG_ SETTLED : 33|1@1+ (1,0) [0|1] "" XXX
 SG_ VREL_VALID : 34|1@1+ (1,0) [0|1] "" XXX
 SG_ DREL_FUSED_VALID : 35|1@1+ (1,0) [0|1] "" XXX
 SG_ VREL_SMOOTHED_VALID : 36|1@1+ (1,0) [0|1] "" XXX
 SG_ VREL : 40|16@1- (0.01,0) [-327.68|327.67] "m/s" XXX
 SG_ V_EGO_0xB4 : 56|16@1+ (0.01,0) [0|655.35] "m/s" XXX
 SG_ DREL_FUSED : 72|16@1+ (0.01,0) [0|655.35] "m" XXX
 SG_ VREL_SMOOTHED : 88|16@1- (0.01,0) [-327.68|327.67] "m/s" XXX

BO_ 1832 ARS510_OBJ_08_DERIVED: 16 XXX
 SG_ TRACK_ID_OP : 0|16@1+ (1,0) [0|65535] "" XXX
 SG_ TRACK_ID_RAW : 16|16@1+ (1,0) [0|65535] "" XXX
 SG_ PUBLISHED_OP : 32|1@1+ (1,0) [0|1] "" XXX
 SG_ SETTLED : 33|1@1+ (1,0) [0|1] "" XXX
 SG_ VREL_VALID : 34|1@1+ (1,0) [0|1] "" XXX
 SG_ DREL_FUSED_VALID : 35|1@1+ (1,0) [0|1] "" XXX
 SG_ VREL_SMOOTHED_VALID : 36|1@1+ (1,0) [0|1] "" XXX
 SG_ VREL : 40|16@1- (0.01,0) [-327.68|327.67] "m/s" XXX
 SG_ V_EGO_0xB4 : 56|16@1+ (0.01,0) [0|655.35] "m/s" XXX
 SG_ DREL_FUSED : 72|16@1+ (0.01,0) [0|655.35] "m" XXX
 SG_ VREL_SMOOTHED : 88|16@1- (0.01,0) [-327.68|327.67] "m/s" XXX

BO_ 1833 ARS510_OBJ_09_DERIVED: 16 XXX
 SG_ TRACK_ID_OP : 0|16@1+ (1,0) [0|65535] "" XXX
 SG_ TRACK_ID_RAW : 16|16@1+ (1,0) [0|65535] "" XXX
 SG_ PUBLISHED_OP : 32|1@1+ (1,0) [0|1] "" XXX
 SG_ SETTLED : 33|1@1+ (1,0) [0|1] "" XXX
 SG_ VREL_VALID : 34|1@1+ (1,0) [0|1] "" XXX
 SG_ DREL_FUSED_VALID : 35|1@1+ (1,0) [0|1] "" XXX
 SG_ VREL_SMOOTHED_VALID : 36|1@1+ (1,0) [0|1] "" XXX
 SG_ VREL : 40|16@1- (0.01,0) [-327.68|327.67] "m/s" XXX
 SG_ V_EGO_0xB4 : 56|16@1+ (0.01,0) [0|655.35] "m/s" XXX
 SG_ DREL_FUSED : 72|16@1+ (0.01,0) [0|655.35] "m" XXX
 SG_ VREL_SMOOTHED : 88|16@1- (0.01,0) [-327.68|327.67] "m/s" XXX

BO_ 1834 ARS510_OBJ_10_DERIVED: 16 XXX
 SG_ TRACK_ID_OP : 0|16@1+ (1,0) [0|65535] "" XXX
 SG_ TRACK_ID_RAW : 16|16@1+ (1,0) [0|65535] "" XXX
 SG_ PUBLISHED_OP : 32|1@1+ (1,0) [0|1] "" XXX
 SG_ SETTLED : 33|1@1+ (1,0) [0|1] "" XXX
 SG_ VREL_VALID : 34|1@1+ (1,0) [0|1] "" XXX
 SG_ DREL_FUSED_VALID : 35|1@1+ (1,0) [0|1] "" XXX
 SG_ VREL_SMOOTHED_VALID : 36|1@1+ (1,0) [0|1] "" XXX
 SG_ VREL : 40|16@1- (0.01,0) [-327.68|327.67] "m/s" XXX
 SG_ V_EGO_0xB4 : 56|16@1+ (0.01,0) [0|655.35] "m/s" XXX
 SG_ DREL_FUSED : 72|16@1+ (0.01,0) [0|655.35] "m" XXX
 SG_ VREL_SMOOTHED : 88|16@1- (0.01,0) [-327.68|327.67] "m/s" XXX

BO_ 1835 ARS510_OBJ_11_DERIVED: 16 XXX
 SG_ TRACK_ID_OP : 0|16@1+ (1,0) [0|65535] "" XXX
 SG_ TRACK_ID_RAW : 16|16@1+ (1,0) [0|65535] "" XXX
 SG_ PUBLISHED_OP : 32|1@1+ (1,0) [0|1] "" XXX
 SG_ SETTLED : 33|1@1+ (1,0) [0|1] "" XXX
 SG_ VREL_VALID : 34|1@1+ (1,0) [0|1] "" XXX
 SG_ DREL_FUSED_VALID : 35|1@1+ (1,0) [0|1] "" XXX
 SG_ VREL_SMOOTHED_VALID : 36|1@1+ (1,0) [0|1] "" XXX
 SG_ VREL : 40|16@1- (0.01,0) [-327.68|327.67] "m/s" XXX
 SG_ V_EGO_0xB4 : 56|16@1+ (0.01,0) [0|655.35] "m/s" XXX
 SG_ DREL_FUSED : 72|16@1+ (0.01,0) [0|655.35] "m" XXX
 SG_ VREL_SMOOTHED : 88|16@1- (0.01,0) [-327.68|327.67] "m/s" XXX

BO_ 1836 ARS510_OBJ_12_DERIVED: 16 XXX
 SG_ TRACK_ID_OP : 0|16@1+ (1,0) [0|65535] "" XXX
 SG_ TRACK_ID_RAW : 16|16@1+ (1,0) [0|65535] "" XXX
 SG_ PUBLISHED_OP : 32|1@1+ (1,0) [0|1] "" XXX
 SG_ SETTLED : 33|1@1+ (1,0) [0|1] "" XXX
 SG_ VREL_VALID : 34|1@1+ (1,0) [0|1] "" XXX
 SG_ DREL_FUSED_VALID : 35|1@1+ (1,0) [0|1] "" XXX
 SG_ VREL_SMOOTHED_VALID : 36|1@1+ (1,0) [0|1] "" XXX
 SG_ VREL : 40|16@1- (0.01,0) [-327.68|327.67] "m/s" XXX
 SG_ V_EGO_0xB4 : 56|16@1+ (0.01,0) [0|655.35] "m/s" XXX
 SG_ DREL_FUSED : 72|16@1+ (0.01,0) [0|655.35] "m" XXX
 SG_ VREL_SMOOTHED : 88|16@1- (0.01,0) [-327.68|327.67] "m/s" XXX

BO_ 1837 ARS510_OBJ_13_DERIVED: 16 XXX
 SG_ TRACK_ID_OP : 0|16@1+ (1,0) [0|65535] "" XXX
 SG_ TRACK_ID_RAW : 16|16@1+ (1,0) [0|65535] "" XXX
 SG_ PUBLISHED_OP : 32|1@1+ (1,0) [0|1] "" XXX
 SG_ SETTLED : 33|1@1+ (1,0) [0|1] "" XXX
 SG_ VREL_VALID : 34|1@1+ (1,0) [0|1] "" XXX
 SG_ DREL_FUSED_VALID : 35|1@1+ (1,0) [0|1] "" XXX
 SG_ VREL_SMOOTHED_VALID : 36|1@1+ (1,0) [0|1] "" XXX
 SG_ VREL : 40|16@1- (0.01,0) [-327.68|327.67] "m/s" XXX
 SG_ V_EGO_0xB4 : 56|16@1+ (0.01,0) [0|655.35] "m/s" XXX
 SG_ DREL_FUSED : 72|16@1+ (0.01,0) [0|655.35] "m" XXX
 SG_ VREL_SMOOTHED : 88|16@1- (0.01,0) [-327.68|327.67] "m/s" XXX

BO_ 1838 ARS510_OBJ_14_DERIVED: 16 XXX
 SG_ TRACK_ID_OP : 0|16@1+ (1,0) [0|65535] "" XXX
 SG_ TRACK_ID_RAW : 16|16@1+ (1,0) [0|65535] "" XXX
 SG_ PUBLISHED_OP : 32|1@1+ (1,0) [0|1] "" XXX
 SG_ SETTLED : 33|1@1+ (1,0) [0|1] "" XXX
 SG_ VREL_VALID : 34|1@1+ (1,0) [0|1] "" XXX
 SG_ DREL_FUSED_VALID : 35|1@1+ (1,0) [0|1] "" XXX
 SG_ VREL_SMOOTHED_VALID : 36|1@1+ (1,0) [0|1] "" XXX
 SG_ VREL : 40|16@1- (0.01,0) [-327.68|327.67] "m/s" XXX
 SG_ V_EGO_0xB4 : 56|16@1+ (0.01,0) [0|655.35] "m/s" XXX
 SG_ DREL_FUSED : 72|16@1+ (0.01,0) [0|655.35] "m" XXX
 SG_ VREL_SMOOTHED : 88|16@1- (0.01,0) [-327.68|327.67] "m/s" XXX

BO_ 1839 ARS510_OBJ_15_DERIVED: 16 XXX
 SG_ TRACK_ID_OP : 0|16@1+ (1,0) [0|65535] "" XXX
 SG_ TRACK_ID_RAW : 16|16@1+ (1,0) [0|65535] "" XXX
 SG_ PUBLISHED_OP : 32|1@1+ (1,0) [0|1] "" XXX
 SG_ SETTLED : 33|1@1+ (1,0) [0|1] "" XXX
 SG_ VREL_VALID : 34|1@1+ (1,0) [0|1] "" XXX
 SG_ DREL_FUSED_VALID : 35|1@1+ (1,0) [0|1] "" XXX
 SG_ VREL_SMOOTHED_VALID : 36|1@1+ (1,0) [0|1] "" XXX
 SG_ VREL : 40|16@1- (0.01,0) [-327.68|327.67] "m/s" XXX
 SG_ V_EGO_0xB4 : 56|16@1+ (0.01,0) [0|655.35] "m/s" XXX
 SG_ DREL_FUSED : 72|16@1+ (0.01,0) [0|655.35] "m" XXX
 SG_ VREL_SMOOTHED : 88|16@1- (0.01,0) [-327.68|327.67] "m/s" XXX

BO_ 1840 ARS510_OBJ_16_DERIVED: 16 XXX
 SG_ TRACK_ID_OP : 0|16@1+ (1,0) [0|65535] "" XXX
 SG_ TRACK_ID_RAW : 16|16@1+ (1,0) [0|65535] "" XXX
 SG_ PUBLISHED_OP : 32|1@1+ (1,0) [0|1] "" XXX
 SG_ SETTLED : 33|1@1+ (1,0) [0|1] "" XXX
 SG_ VREL_VALID : 34|1@1+ (1,0) [0|1] "" XXX
 SG_ DREL_FUSED_VALID : 35|1@1+ (1,0) [0|1] "" XXX
 SG_ VREL_SMOOTHED_VALID : 36|1@1+ (1,0) [0|1] "" XXX
 SG_ VREL : 40|16@1- (0.01,0) [-327.68|327.67] "m/s" XXX
 SG_ V_EGO_0xB4 : 56|16@1+ (0.01,0) [0|655.35] "m/s" XXX
 SG_ DREL_FUSED : 72|16@1+ (0.01,0) [0|655.35] "m" XXX
 SG_ VREL_SMOOTHED : 88|16@1- (0.01,0) [-327.68|327.67] "m/s" XXX

BO_ 1841 ARS510_OBJ_17_DERIVED: 16 XXX
 SG_ TRACK_ID_OP : 0|16@1+ (1,0) [0|65535] "" XXX
 SG_ TRACK_ID_RAW : 16|16@1+ (1,0) [0|65535] "" XXX
 SG_ PUBLISHED_OP : 32|1@1+ (1,0) [0|1] "" XXX
 SG_ SETTLED : 33|1@1+ (1,0) [0|1] "" XXX
 SG_ VREL_VALID : 34|1@1+ (1,0) [0|1] "" XXX
 SG_ DREL_FUSED_VALID : 35|1@1+ (1,0) [0|1] "" XXX
 SG_ VREL_SMOOTHED_VALID : 36|1@1+ (1,0) [0|1] "" XXX
 SG_ VREL : 40|16@1- (0.01,0) [-327.68|327.67] "m/s" XXX
 SG_ V_EGO_0xB4 : 56|16@1+ (0.01,0) [0|655.35] "m/s" XXX
 SG_ DREL_FUSED : 72|16@1+ (0.01,0) [0|655.35] "m" XXX
 SG_ VREL_SMOOTHED : 88|16@1- (0.01,0) [-327.68|327.67] "m/s" XXX

BO_ 1842 ARS510_OBJ_18_DERIVED: 16 XXX
 SG_ TRACK_ID_OP : 0|16@1+ (1,0) [0|65535] "" XXX
 SG_ TRACK_ID_RAW : 16|16@1+ (1,0) [0|65535] "" XXX
 SG_ PUBLISHED_OP : 32|1@1+ (1,0) [0|1] "" XXX
 SG_ SETTLED : 33|1@1+ (1,0) [0|1] "" XXX
 SG_ VREL_VALID : 34|1@1+ (1,0) [0|1] "" XXX
 SG_ DREL_FUSED_VALID : 35|1@1+ (1,0) [0|1] "" XXX
 SG_ VREL_SMOOTHED_VALID : 36|1@1+ (1,0) [0|1] "" XXX
 SG_ VREL : 40|16@1- (0.01,0) [-327.68|327.67] "m/s" XXX
 SG_ V_EGO_0xB4 : 56|16@1+ (0.01,0) [0|655.35] "m/s" XXX
 SG_ DREL_FUSED : 72|16@1+ (0.01,0) [0|655.35] "m" XXX
 SG_ VREL_SMOOTHED : 88|16@1- (0.01,0) [-327.68|327.67] "m/s" XXX

BO_ 1843 ARS510_OBJ_19_DERIVED: 16 XXX
 SG_ TRACK_ID_OP : 0|16@1+ (1,0) [0|65535] "" XXX
 SG_ TRACK_ID_RAW : 16|16@1+ (1,0) [0|65535] "" XXX
 SG_ PUBLISHED_OP : 32|1@1+ (1,0) [0|1] "" XXX
 SG_ SETTLED : 33|1@1+ (1,0) [0|1] "" XXX
 SG_ VREL_VALID : 34|1@1+ (1,0) [0|1] "" XXX
 SG_ DREL_FUSED_VALID : 35|1@1+ (1,0) [0|1] "" XXX
 SG_ VREL_SMOOTHED_VALID : 36|1@1+ (1,0) [0|1] "" XXX
 SG_ VREL : 40|16@1- (0.01,0) [-327.68|327.67] "m/s" XXX
 SG_ V_EGO_0xB4 : 56|16@1+ (0.01,0) [0|655.35] "m/s" XXX
 SG_ DREL_FUSED : 72|16@1+ (0.01,0) [0|655.35] "m" XXX
 SG_ VREL_SMOOTHED : 88|16@1- (0.01,0) [-327.68|327.67] "m/s" XXX

BO_ 1856 ARS510_REC_HEADER: 20 RADAR
 SG_ CONST_HDR0_8 : 0|8@1+ (1,0) [0|255] "raw" XXX
 SG_ UNK_HDR8_5 : 8|5@1+ (1,0) [0|31] "raw" XXX
 SG_ UNK_HDR13_4 : 13|4@1+ (1,0) [0|15] "raw" XXX
 SG_ UNK_HDR17_15 : 17|15@1+ (1,0) [0|32767] "raw" XXX
 SG_ CONST_HDR32_1 : 32|1@1+ (1,0) [0|1] "raw" XXX
 SG_ UNK_HDR33_1 : 33|1@1+ (1,0) [0|1] "raw" XXX
 SG_ CONST_HDR34_7 : 34|7@1+ (1,0) [0|127] "raw" XXX
 SG_ UNK_HDR41_15 : 41|15@1+ (1,0) [0|32767] "raw" XXX
 SG_ CONST_HDR56_12 : 56|12@1+ (1,0) [0|4095] "raw" XXX
 SG_ UNK_HDR68_4 : 68|4@1+ (1,0) [0|15] "raw" XXX
 SG_ CONST_HDR72_32 : 72|32@1+ (1,0) [0|4294967295] "raw" XXX
 SG_ UNK_HDR104_3 : 104|3@1+ (1,0) [0|7] "raw" XXX
 SG_ UNK_HDR107_4 : 107|4@1+ (1,0) [0|15] "raw" XXX
 SG_ CONST_HDR111_4 : 111|4@1+ (1,0) [0|15] "raw" XXX
 SG_ OBJECT_COUNT : 115|5@1+ (1,0) [0|20] "objects" XXX
 SG_ CONST_HDR120_16 : 120|16@1+ (1,0) [0|65535] "raw" XXX

BO_ 1857 ARS510_REC_TRAILER: 8 RADAR
 SG_ RECORD_CRC32 : 0|32@1+ (1,0) [0|4294967295] "" XXX
 SG_ RECORD_B741 : 32|8@1+ (1,0) [0|255] "raw" XXX

BO_ 1888 ARS510_SHELL85_HDR: 24 RADAR
 SG_ PREFIX_BYTE_00 : 0|8@1+ (1,0) [0|255] "raw" XXX
 SG_ PREFIX_BYTE_01 : 8|8@1+ (1,0) [0|255] "raw" XXX
 SG_ PREFIX_BYTE_02 : 16|8@1+ (1,0) [0|255] "raw" XXX
 SG_ PREFIX_BYTE_03 : 24|8@1+ (1,0) [0|255] "raw" XXX
 SG_ PREFIX_BYTE_04 : 32|8@1+ (1,0) [0|255] "raw" XXX
 SG_ PREFIX_BYTE_05 : 40|8@1+ (1,0) [0|255] "raw" XXX
 SG_ PREFIX_BYTE_06 : 48|8@1+ (1,0) [0|255] "raw" XXX
 SG_ PREFIX_BYTE_07 : 56|8@1+ (1,0) [0|255] "raw" XXX
 SG_ PREFIX_BYTE_08 : 64|8@1+ (1,0) [0|255] "raw" XXX
 SG_ PREFIX_BYTE_09 : 72|8@1+ (1,0) [0|255] "raw" XXX
 SG_ PREFIX_BYTE_10 : 80|8@1+ (1,0) [0|255] "raw" XXX
 SG_ PREFIX_BYTE_11 : 88|8@1+ (1,0) [0|255] "raw" XXX
 SG_ PREFIX_BYTE_12 : 96|8@1+ (1,0) [0|255] "raw" XXX
 SG_ PREFIX_BYTE_13 : 104|8@1+ (1,0) [0|255] "raw" XXX
 SG_ PREFIX_BYTE_14 : 112|8@1+ (1,0) [0|255] "raw" XXX
 SG_ PREFIX_BYTE_15 : 120|8@1+ (1,0) [0|255] "raw" XXX
 SG_ PREFIX_BYTE_16 : 128|8@1+ (1,0) [0|255] "raw" XXX
 SG_ PREFIX_BYTE_17 : 136|8@1+ (1,0) [0|255] "raw" XXX
 SG_ PREFIX_BYTE_18 : 144|8@1+ (1,0) [0|255] "raw" XXX
 SG_ PREFIX_BYTE_19 : 152|8@1+ (1,0) [0|255] "raw" XXX
 SG_ PREFIX_BYTE_20 : 160|8@1+ (1,0) [0|255] "raw" XXX

BO_ 1889 ARS510_SHELL85_CELL_00: 12 RADAR
 SG_ RAW_BYTE_00 : 0|8@1+ (1,0) [0|255] "raw" XXX
 SG_ RAW_BYTE_01 : 8|8@1+ (1,0) [0|255] "raw" XXX
 SG_ RAW_BYTE_02 : 16|8@1+ (1,0) [0|255] "raw" XXX
 SG_ RAW_BYTE_03 : 24|8@1+ (1,0) [0|255] "raw" XXX
 SG_ RAW_BYTE_04 : 32|8@1+ (1,0) [0|255] "raw" XXX
 SG_ RAW_BYTE_05 : 40|8@1+ (1,0) [0|255] "raw" XXX
 SG_ RAW_BYTE_06 : 48|8@1+ (1,0) [0|255] "raw" XXX
 SG_ RAW_BYTE_07 : 56|8@1+ (1,0) [0|255] "raw" XXX
 SG_ RAW_BYTE_08 : 64|8@1+ (1,0) [0|255] "raw" XXX
 SG_ RAW_BYTE_09 : 72|8@1+ (1,0) [0|255] "raw" XXX
 SG_ RAW_BYTE_10 : 80|8@1+ (1,0) [0|255] "raw" XXX
 SG_ RAW_BYTE_11 : 88|8@1+ (1,0) [0|255] "raw" XXX
 SG_ PARAMETERS_PRESENT : 30|1@1+ (1,0) [0|1] "" XXX

BO_ 1890 ARS510_SHELL85_CELL_01: 12 RADAR
 SG_ RAW_BYTE_00 : 0|8@1+ (1,0) [0|255] "raw" XXX
 SG_ RAW_BYTE_01 : 8|8@1+ (1,0) [0|255] "raw" XXX
 SG_ RAW_BYTE_02 : 16|8@1+ (1,0) [0|255] "raw" XXX
 SG_ RAW_BYTE_03 : 24|8@1+ (1,0) [0|255] "raw" XXX
 SG_ RAW_BYTE_04 : 32|8@1+ (1,0) [0|255] "raw" XXX
 SG_ RAW_BYTE_05 : 40|8@1+ (1,0) [0|255] "raw" XXX
 SG_ RAW_BYTE_06 : 48|8@1+ (1,0) [0|255] "raw" XXX
 SG_ RAW_BYTE_07 : 56|8@1+ (1,0) [0|255] "raw" XXX
 SG_ RAW_BYTE_08 : 64|8@1+ (1,0) [0|255] "raw" XXX
 SG_ RAW_BYTE_09 : 72|8@1+ (1,0) [0|255] "raw" XXX
 SG_ RAW_BYTE_10 : 80|8@1+ (1,0) [0|255] "raw" XXX
 SG_ RAW_BYTE_11 : 88|8@1+ (1,0) [0|255] "raw" XXX
 SG_ PARAMETERS_PRESENT : 30|1@1+ (1,0) [0|1] "" XXX

BO_ 1891 ARS510_SHELL85_CELL_02: 12 RADAR
 SG_ RAW_BYTE_00 : 0|8@1+ (1,0) [0|255] "raw" XXX
 SG_ RAW_BYTE_01 : 8|8@1+ (1,0) [0|255] "raw" XXX
 SG_ RAW_BYTE_02 : 16|8@1+ (1,0) [0|255] "raw" XXX
 SG_ RAW_BYTE_03 : 24|8@1+ (1,0) [0|255] "raw" XXX
 SG_ RAW_BYTE_04 : 32|8@1+ (1,0) [0|255] "raw" XXX
 SG_ RAW_BYTE_05 : 40|8@1+ (1,0) [0|255] "raw" XXX
 SG_ RAW_BYTE_06 : 48|8@1+ (1,0) [0|255] "raw" XXX
 SG_ RAW_BYTE_07 : 56|8@1+ (1,0) [0|255] "raw" XXX
 SG_ RAW_BYTE_08 : 64|8@1+ (1,0) [0|255] "raw" XXX
 SG_ RAW_BYTE_09 : 72|8@1+ (1,0) [0|255] "raw" XXX
 SG_ RAW_BYTE_10 : 80|8@1+ (1,0) [0|255] "raw" XXX
 SG_ RAW_BYTE_11 : 88|8@1+ (1,0) [0|255] "raw" XXX
 SG_ PARAMETERS_PRESENT : 30|1@1+ (1,0) [0|1] "" XXX

BO_ 1892 ARS510_SHELL85_CELL_03: 12 RADAR
 SG_ RAW_BYTE_00 : 0|8@1+ (1,0) [0|255] "raw" XXX
 SG_ RAW_BYTE_01 : 8|8@1+ (1,0) [0|255] "raw" XXX
 SG_ RAW_BYTE_02 : 16|8@1+ (1,0) [0|255] "raw" XXX
 SG_ RAW_BYTE_03 : 24|8@1+ (1,0) [0|255] "raw" XXX
 SG_ RAW_BYTE_04 : 32|8@1+ (1,0) [0|255] "raw" XXX
 SG_ RAW_BYTE_05 : 40|8@1+ (1,0) [0|255] "raw" XXX
 SG_ RAW_BYTE_06 : 48|8@1+ (1,0) [0|255] "raw" XXX
 SG_ RAW_BYTE_07 : 56|8@1+ (1,0) [0|255] "raw" XXX
 SG_ RAW_BYTE_08 : 64|8@1+ (1,0) [0|255] "raw" XXX
 SG_ RAW_BYTE_09 : 72|8@1+ (1,0) [0|255] "raw" XXX
 SG_ RAW_BYTE_10 : 80|8@1+ (1,0) [0|255] "raw" XXX
 SG_ RAW_BYTE_11 : 88|8@1+ (1,0) [0|255] "raw" XXX
 SG_ PARAMETERS_PRESENT : 30|1@1+ (1,0) [0|1] "" XXX

BO_ 1893 ARS510_SHELL85_CELL_04: 12 RADAR
 SG_ RAW_BYTE_00 : 0|8@1+ (1,0) [0|255] "raw" XXX
 SG_ RAW_BYTE_01 : 8|8@1+ (1,0) [0|255] "raw" XXX
 SG_ RAW_BYTE_02 : 16|8@1+ (1,0) [0|255] "raw" XXX
 SG_ RAW_BYTE_03 : 24|8@1+ (1,0) [0|255] "raw" XXX
 SG_ RAW_BYTE_04 : 32|8@1+ (1,0) [0|255] "raw" XXX
 SG_ RAW_BYTE_05 : 40|8@1+ (1,0) [0|255] "raw" XXX
 SG_ RAW_BYTE_06 : 48|8@1+ (1,0) [0|255] "raw" XXX
 SG_ RAW_BYTE_07 : 56|8@1+ (1,0) [0|255] "raw" XXX
 SG_ RAW_BYTE_08 : 64|8@1+ (1,0) [0|255] "raw" XXX
 SG_ RAW_BYTE_09 : 72|8@1+ (1,0) [0|255] "raw" XXX
 SG_ RAW_BYTE_10 : 80|8@1+ (1,0) [0|255] "raw" XXX
 SG_ RAW_BYTE_11 : 88|8@1+ (1,0) [0|255] "raw" XXX
 SG_ PARAMETERS_PRESENT : 30|1@1+ (1,0) [0|1] "" XXX

BO_ 1894 ARS510_SHELL85_CELL_05: 12 RADAR
 SG_ RAW_BYTE_00 : 0|8@1+ (1,0) [0|255] "raw" XXX
 SG_ RAW_BYTE_01 : 8|8@1+ (1,0) [0|255] "raw" XXX
 SG_ RAW_BYTE_02 : 16|8@1+ (1,0) [0|255] "raw" XXX
 SG_ RAW_BYTE_03 : 24|8@1+ (1,0) [0|255] "raw" XXX
 SG_ RAW_BYTE_04 : 32|8@1+ (1,0) [0|255] "raw" XXX
 SG_ RAW_BYTE_05 : 40|8@1+ (1,0) [0|255] "raw" XXX
 SG_ RAW_BYTE_06 : 48|8@1+ (1,0) [0|255] "raw" XXX
 SG_ RAW_BYTE_07 : 56|8@1+ (1,0) [0|255] "raw" XXX
 SG_ RAW_BYTE_08 : 64|8@1+ (1,0) [0|255] "raw" XXX
 SG_ RAW_BYTE_09 : 72|8@1+ (1,0) [0|255] "raw" XXX
 SG_ RAW_BYTE_10 : 80|8@1+ (1,0) [0|255] "raw" XXX
 SG_ RAW_BYTE_11 : 88|8@1+ (1,0) [0|255] "raw" XXX
 SG_ PARAMETERS_PRESENT : 30|1@1+ (1,0) [0|1] "" XXX

BO_ 1895 ARS510_SHELL85_CELL_06: 12 RADAR
 SG_ RAW_BYTE_00 : 0|8@1+ (1,0) [0|255] "raw" XXX
 SG_ RAW_BYTE_01 : 8|8@1+ (1,0) [0|255] "raw" XXX
 SG_ RAW_BYTE_02 : 16|8@1+ (1,0) [0|255] "raw" XXX
 SG_ RAW_BYTE_03 : 24|8@1+ (1,0) [0|255] "raw" XXX
 SG_ RAW_BYTE_04 : 32|8@1+ (1,0) [0|255] "raw" XXX
 SG_ RAW_BYTE_05 : 40|8@1+ (1,0) [0|255] "raw" XXX
 SG_ RAW_BYTE_06 : 48|8@1+ (1,0) [0|255] "raw" XXX
 SG_ RAW_BYTE_07 : 56|8@1+ (1,0) [0|255] "raw" XXX
 SG_ RAW_BYTE_08 : 64|8@1+ (1,0) [0|255] "raw" XXX
 SG_ RAW_BYTE_09 : 72|8@1+ (1,0) [0|255] "raw" XXX
 SG_ RAW_BYTE_10 : 80|8@1+ (1,0) [0|255] "raw" XXX
 SG_ RAW_BYTE_11 : 88|8@1+ (1,0) [0|255] "raw" XXX
 SG_ PARAMETERS_PRESENT : 30|1@1+ (1,0) [0|1] "" XXX

BO_ 1896 ARS510_SHELL85_CELL_07: 12 RADAR
 SG_ RAW_BYTE_00 : 0|8@1+ (1,0) [0|255] "raw" XXX
 SG_ RAW_BYTE_01 : 8|8@1+ (1,0) [0|255] "raw" XXX
 SG_ RAW_BYTE_02 : 16|8@1+ (1,0) [0|255] "raw" XXX
 SG_ RAW_BYTE_03 : 24|8@1+ (1,0) [0|255] "raw" XXX
 SG_ RAW_BYTE_04 : 32|8@1+ (1,0) [0|255] "raw" XXX
 SG_ RAW_BYTE_05 : 40|8@1+ (1,0) [0|255] "raw" XXX
 SG_ RAW_BYTE_06 : 48|8@1+ (1,0) [0|255] "raw" XXX
 SG_ RAW_BYTE_07 : 56|8@1+ (1,0) [0|255] "raw" XXX
 SG_ RAW_BYTE_08 : 64|8@1+ (1,0) [0|255] "raw" XXX
 SG_ RAW_BYTE_09 : 72|8@1+ (1,0) [0|255] "raw" XXX
 SG_ RAW_BYTE_10 : 80|8@1+ (1,0) [0|255] "raw" XXX
 SG_ RAW_BYTE_11 : 88|8@1+ (1,0) [0|255] "raw" XXX
 SG_ PARAMETERS_PRESENT : 30|1@1+ (1,0) [0|1] "" XXX

BO_ 1897 ARS510_SHELL85_CELL_08: 12 RADAR
 SG_ RAW_BYTE_00 : 0|8@1+ (1,0) [0|255] "raw" XXX
 SG_ RAW_BYTE_01 : 8|8@1+ (1,0) [0|255] "raw" XXX
 SG_ RAW_BYTE_02 : 16|8@1+ (1,0) [0|255] "raw" XXX
 SG_ RAW_BYTE_03 : 24|8@1+ (1,0) [0|255] "raw" XXX
 SG_ RAW_BYTE_04 : 32|8@1+ (1,0) [0|255] "raw" XXX
 SG_ RAW_BYTE_05 : 40|8@1+ (1,0) [0|255] "raw" XXX
 SG_ RAW_BYTE_06 : 48|8@1+ (1,0) [0|255] "raw" XXX
 SG_ RAW_BYTE_07 : 56|8@1+ (1,0) [0|255] "raw" XXX
 SG_ RAW_BYTE_08 : 64|8@1+ (1,0) [0|255] "raw" XXX
 SG_ RAW_BYTE_09 : 72|8@1+ (1,0) [0|255] "raw" XXX
 SG_ RAW_BYTE_10 : 80|8@1+ (1,0) [0|255] "raw" XXX
 SG_ RAW_BYTE_11 : 88|8@1+ (1,0) [0|255] "raw" XXX
 SG_ PARAMETERS_PRESENT : 30|1@1+ (1,0) [0|1] "" XXX

BO_ 1898 ARS510_SHELL85_CELL_09: 12 RADAR
 SG_ RAW_BYTE_00 : 0|8@1+ (1,0) [0|255] "raw" XXX
 SG_ RAW_BYTE_01 : 8|8@1+ (1,0) [0|255] "raw" XXX
 SG_ RAW_BYTE_02 : 16|8@1+ (1,0) [0|255] "raw" XXX
 SG_ RAW_BYTE_03 : 24|8@1+ (1,0) [0|255] "raw" XXX
 SG_ RAW_BYTE_04 : 32|8@1+ (1,0) [0|255] "raw" XXX
 SG_ RAW_BYTE_05 : 40|8@1+ (1,0) [0|255] "raw" XXX
 SG_ RAW_BYTE_06 : 48|8@1+ (1,0) [0|255] "raw" XXX
 SG_ RAW_BYTE_07 : 56|8@1+ (1,0) [0|255] "raw" XXX
 SG_ RAW_BYTE_08 : 64|8@1+ (1,0) [0|255] "raw" XXX
 SG_ RAW_BYTE_09 : 72|8@1+ (1,0) [0|255] "raw" XXX
 SG_ RAW_BYTE_10 : 80|8@1+ (1,0) [0|255] "raw" XXX
 SG_ RAW_BYTE_11 : 88|8@1+ (1,0) [0|255] "raw" XXX
 SG_ PARAMETERS_PRESENT : 30|1@1+ (1,0) [0|1] "" XXX

BO_ 1899 ARS510_SHELL85_CRC: 8 RADAR
 SG_ RECORD_CRC32 : 0|32@1+ (1,0) [0|4294967295] "raw" XXX
 SG_ TRAILER_BYTES : 32|16@1+ (1,0) [0|65535] "raw" XXX

CM_ BO_ 1803 "Reassembled 0x80 object slot 11 (record bytes 413-448), sent only when occupied. Little-endian bit field: bit 0 = LSB of slot byte 0.";
CM_ SG_ 1803 STATE_CODE "Raw lifecycle state. Measured/predicted semantics not proved; not an accuracy gate.";
CM_ SG_ 1803 SLOT_INDEX_CODE "Physical slot index or 63 in unallocated-form headers; verified against slot positions. Not class or reference point.";
CM_ SG_ 1803 UNK_8_6 "Candidate from the carry-chain split, unverified: LSB flips 0.103 per cycle, 32 distinct values 30..62. Strongest correlation: age r=+0.55.Legacy combined raw view: low five bits follow an exact startup decay while full movement code109|3 remains5 from birth; bit13 can change separately. Extract low5=value&31 and bit13=value>>5. Mature meaning, units and probability interpretation unresolved; not a validity or excursion gate. See docs/14.";
CM_ SG_ 1803 ONCOMING_FLAG "1 = oncoming now or earlier in the track life (persists after an oncoming object slows). Pre-registered test on unseen segments: over-ground speed < 0 on 100% of flagged rows, 88.5% of objects approaching faster than 2 m/s flagged (docs/14).";
CM_ SG_ 1803 UNK_15_1 "Expanded-corpus correction: Mostly set on newborn zero-range rows, with exceptions; not a validity gate. See docs/14.";
CM_ SG_ 1803 SCORE_CODE "Bounded score-like byte, not calibrated confidence or percent. Value 100 does not guarantee accurate geometry or velocity.";
CM_ SG_ 1803 AGE "Track age in radar cycles (~60 ms): 1 at birth, saturates at 126; 0 = slot being retired (geometry is the previous occupant's). A restart is a new track. Tracks younger than ~60 carry unconverged range and velocity.";
CM_ SG_ 1803 CONST_31_1 "Constant 0 (0x0) in the original small-corpus survey; not proof of reserved/padding bits or universal constancy.";
CM_ SG_ 1803 DREL "Longitudinal distance forward of the radar, m. 1/16 m, zero code 160 (exactly -10 m). Camera ground contact at 5-25 m: slope 0.99-1.00 on three drives, zero within 0.2 m (0.7 m on a hilly drive). Settled tracks walk by metres record to record at 40 m+; young tracks can be far off.";
CM_ SG_ 1803 YREL_LEFT "Lateral offset, LEFT positive (openpilot yRel), m. 1/64 m, offset binary around 2048. Cartesian (constant across range), not an angle. Correct side 97.9-99.3% on held-out drives; scale bounded to about +/-10%. |code-2048| >= 2000 is a sentinel.";
CM_ SG_ 1803 UNK_56_7 "Candidate from the carry-chain split, unverified: LSB flips 0.355 per cycle, 84 distinct values 4..96. Strongest correlation: age r=+0.30. Size / class candidate: per-track median follows camera vehicle height (partial rho 0.48-0.61 at fixed range) and truck/bus class (docs/14).";
CM_ SG_ 1803 UNK_63_1 "Expanded-corpus correction: Rare changing bit; only two rows in the expanded corpus. See docs/14.";
CM_ SG_ 1803 VLONG_OVER_GROUND "Longitudinal velocity OVER GROUND, m/s. 0.15 m/s/code, zero 510.5. vRel = this - ego speed. Radar-only scale check (own range slope vs GPS ego) gives 0.150/0.149/0.153 on three drives. Beats zero and range differencing against a camera reference, but has unflagged ~1 s excursions at range. Unsettled for age < ~60.";
CM_ SG_ 1803 VLAT_OVER_GROUND_PROV "Lateral velocity over ground, LEFT positive (sign confirmed). Scale NOT pinned: the factor shown (0.15) is a placeholder. Radar-only estimates from its own lateral position change range 0.097-0.147 m/s per code across data sets, and the pre-registered test was unverified. See docs/14.";
CM_ SG_ 1803 ALONG_LIKE_84 "Acceleration-like, zero code 511 at standstill. Follows the VLONG change with a ~0.5 s lag, so it cannot flag or lead a velocity excursion. Radar-only scale about 0.04 m/s^2 per code on most data but drive-dependent (0.03-0.11); centred codes (docs/14).";
CM_ SG_ 1803 CONST_94_2 "Constant 0 (0x0) in the original small-corpus survey; not proof of reserved/padding bits or universal constancy.";
CM_ SG_ 1803 UNK_96 "Lateral ground-acceleration-like candidate: (raw-511)*0.05 m/s^2, calibration provisional. Rotation-corrected kinematics and a discovery-selected +0.5 s lag transfer to further drives (r about 0.90). Raw code retained; no accuracy gate or runtime use. See docs/14 for route exceptions and reference limitations.";
CM_ SG_ 1803 UNK_106_1 "Candidate from the carry-chain split, unverified: LSB flips 0.003 per cycle, 2 distinct values 0..1. Strongest correlation: v_over_ground r=-0.14.";
CM_ SG_ 1803 UNK_107_1 "Candidate from the carry-chain split, unverified: LSB flips 0.013 per cycle, 2 distinct values 0..1. Strongest correlation: v_over_ground r=-0.24. Coasting-flag candidate: about 0.02 in settled life, 0.5-0.66 just before deletion (docs/14).";
CM_ SG_ 1803 CONST_108_1 "Constant 0 (0x0) in the original small-corpus survey; not proof of reserved/padding bits or universal constancy.";
CM_ SG_ 1803 MOVE_STATE "Legacy low-two-bit motion projection. Full code = MOVE_STATE | ((UNK_111_4 & 1) << 2). Full 3 is rightward-like, 4 leftward-like, 5 initialization/unsettled-like, 7 stopped-like; meanings provisional. Old labels conflate these states. See docs/14.";
CM_ SG_ 1803 UNK_111_4 "Candidate from the carry-chain split, unverified: LSB flips 0.008 per cycle, 10 distinct values 0..9. Strongest correlation: dRel r=-0.53.";
CM_ SG_ 1803 UNK_115_8 "Candidate from the carry-chain split, unverified: LSB flips 0.052 per cycle, 26 distinct values 0..178. Strongest correlation: age r=+0.27.";
CM_ SG_ 1803 CONST_123_5 "Constant 31 (0x1F) in the original small-corpus survey; not proof of reserved/padding bits or universal constancy.";
CM_ SG_ 1803 UNK_128_2 "Candidate from the carry-chain split, unverified: LSB flips 0.013 per cycle, 4 distinct values 0..3. Strongest correlation: dRel r=+0.11.";
CM_ SG_ 1803 UNK_130_1 "Candidate from the carry-chain split, unverified: LSB flips 0.019 per cycle, 2 distinct values 0..1. Strongest correlation: abs_yRel r=+0.34.";
CM_ SG_ 1803 UNK_131_4 "Candidate from the carry-chain split, unverified: LSB flips 0.102 per cycle, 9 distinct values 7..15. Strongest correlation: abs_yRel r=+0.09.";
CM_ SG_ 1803 CONST_135_1 "Constant 0 (0x0) in the original small-corpus survey; not proof of reserved/padding bits or universal constancy.";
CM_ SG_ 1803 UNK_136_6 "Candidate from the carry-chain split, unverified: LSB flips 0.093 per cycle, 39 distinct values 3..63. Strongest correlation: age r=+0.20.";
CM_ SG_ 1803 UNK_142_1 "Candidate from the carry-chain split, unverified: LSB flips 0.007 per cycle, 2 distinct values 0..1. Strongest correlation: age r=+0.47.";
CM_ SG_ 1803 CONST_143_5 "Constant 30 (0x1E) in the original small-corpus survey; not proof of reserved/padding bits or universal constancy.";
CM_ SG_ 1803 UNK_148_8 "Candidate from the carry-chain split, unverified: LSB flips 0.009 per cycle, 27 distinct values 0..240. Strongest correlation: dRel r=-0.12.Legacy combined view of two candidate weight nibbles148|4 and152|4: first=value&15, second=value>>4. Together with156|4, nonzero triplets nearly always sum to15 or16, with two observed sum14 exceptions. Physical outcomes and probability calibration remain unresolved (docs/14).";
CM_ SG_ 1803 UNK_156_4 "Candidate from the carry-chain split, unverified: LSB flips 0.016 per cycle, 16 distinct values 0..15. Strongest correlation: abs_yRel r=-0.42.Third component of the candidate weight triplet148/152/156|4. All-zero meaning and physical outcomes unknown; not an excursion or validity gate (docs/14).";
CM_ SG_ 1803 CONST_160_3 "Constant 0 (0x0) in the original small-corpus survey; not proof of reserved/padding bits or universal constancy.";
CM_ SG_ 1803 UNK_163_2 "Candidate from the carry-chain split, unverified: LSB flips 0.006 per cycle, 3 distinct values 1..3. Strongest correlation: age r=+0.30.";
CM_ SG_ 1803 UNK_165_3 "Expanded-corpus correction: Changes within some tracks; observed codes 0 and 1. See docs/14.";
CM_ SG_ 1803 UNK_168_10 "Candidate from the carry-chain split, unverified: LSB flips 0.066 per cycle, 3 distinct values 0..1023. Strongest correlation: abs_yRel r=+0.14.";
CM_ SG_ 1803 CONST_178_3 "Constant 0 (0x0) in the original small-corpus survey; not proof of reserved/padding bits or universal constancy.";
CM_ SG_ 1803 UNK_181_1 "Candidate from the carry-chain split, unverified: LSB flips 0.071 per cycle, 2 distinct values 0..1. Strongest correlation: v_over_ground r=+0.34.";
CM_ SG_ 1803 UNK_182_1 "Expanded-corpus correction: Rare changing bit; observed in one short track episode. See docs/14.";
CM_ SG_ 1803 UNK_183_7 "Candidate from the carry-chain split, unverified: LSB flips 0.009 per cycle, 24 distinct values 26..73. Strongest correlation: age r=+0.20.";
CM_ SG_ 1803 UNK_190_10 "Expanded-corpus correction: Observed codes 0 and 1. Usually follows positive age, with three exceptions; not a validity gate. See docs/14.";
CM_ SG_ 1803 UNK_200_7 "Candidate from the carry-chain split, unverified: LSB flips 0.023 per cycle, 16 distinct values 0..127. Strongest correlation: v_over_ground r=-0.45.";
CM_ SG_ 1803 CONST_207_1 "Constant 0 (0x0) in the original small-corpus survey; not proof of reserved/padding bits or universal constancy.";
CM_ SG_ 1803 UNK_208_6 "Candidate from the carry-chain split, unverified: LSB flips 0.017 per cycle, 20 distinct values 0..63. Strongest correlation: v_over_ground r=-0.38.Coarse nonnegative velocity-heading-like candidate, about pi/64 rad/code. Negative headings almost always map to zero. Raw code retained; not a complete signed orientation, independent Doppler or control gate. See docs/14.";
CM_ SG_ 1803 CONST_214_2 "Constant 0 (0x0) in the original small-corpus survey; not proof of reserved/padding bits or universal constancy.";
CM_ SG_ 1803 UNK_216_6 "Candidate from the carry-chain split, unverified: LSB flips 0.150 per cycle, 34 distinct values 3..49. Strongest correlation: age r=+0.23. Size / class candidate: camera vehicle height partial rho 0.44-0.63, truck/bus 0.35-0.42; width on A/C. Compare ARS4-B Length / dZ (6 bits) (docs/14).";
CM_ SG_ 1803 CONST_222_2 "Constant 0 (0x0) in the original small-corpus survey; not proof of reserved/padding bits or universal constancy.";
CM_ SG_ 1803 UNK_224_7 "Candidate from the carry-chain split, unverified: LSB flips 0.344 per cycle, 127 distinct values 1..127. Strongest correlation: dRel r=+0.80. Uncertainty candidate: scales with range (r~0.8), falls with age at fixed range (rho -0.29 to -0.36), larger when range steps are noisier, rises before deletion. Weak near-range error indicator; does not single out excursions.";
CM_ SG_ 1803 CONST_231_1 "Constant 0 (0x0) in the original small-corpus survey; not proof of reserved/padding bits or universal constancy.";
CM_ SG_ 1803 UNK_232_7 "Candidate from the carry-chain split, unverified: LSB flips 0.096 per cycle, 72 distinct values 0..127. Strongest correlation: abs_yRel r=+0.60. Lateral-uncertainty candidate: scales with |yRel| (r~0.6), falls with age at fixed range (rho -0.50 to -0.59).";
CM_ SG_ 1803 UNK_239_1 "Expanded-corpus correction: Changes within tracks; often active near birth. The former PER_TRACK label was too strong. See docs/14.";
CM_ SG_ 1803 UNK_240_7 "Candidate from the carry-chain split, unverified: LSB flips 0.364 per cycle, 127 distinct values 1..127. Strongest correlation: dRel r=+0.80. Velocity-uncertainty candidate (like ARS408 VrelLong_rms): scales with range, falls with age, rises before deletion. Flags velocity glitches: stratified AUC 0.65 / 0.85 (discovery / confirmation) against clean labels where native vRel disagrees with both the radar ACC target (0x235) and vision (docs/15). Decoded as vel_unc_code.";
CM_ SG_ 1803 CONST_247_1 "Constant 0 (0x0) in the original small-corpus survey; not proof of reserved/padding bits or universal constancy.";
CM_ SG_ 1803 UNK_248_7 "Candidate from the carry-chain split, unverified: LSB flips 0.116 per cycle, 97 distinct values 0..127. Strongest correlation: abs_yRel r=+0.56. Uncertainty candidate: scales with |yRel| (r~0.56), falls with age at fixed range (rho -0.70 to -0.75).";
CM_ SG_ 1803 CONST_255_1 "Constant 0 (0x0) in the original small-corpus survey; not proof of reserved/padding bits or universal constancy.";
CM_ SG_ 1803 UNK_256_6 "Expanded-corpus correction: Expanded raw window: repeated 31-to-32 and reverse carries in discovery, confirmation and further drives. Full field width, units and meaning unresolved. See docs/14.";
CM_ SG_ 1803 UNK_262_2 "Expanded-corpus correction: Remaining upper bits are not universally constant. May belong to the preceding quantity; boundary unresolved. See docs/14.";
CM_ SG_ 1803 UNK_264_5 "Expanded-corpus correction: Expanded raw window: repeated 15-to-16 and reverse carries. Full field width and scan/uncertainty semantics unresolved; old four-bit analyses used only its low bits. See docs/14.";
CM_ SG_ 1803 UNK_269_3 "Expanded-corpus correction: Rare nonzero upper bits; may belong to the preceding quantity. Boundary unresolved. See docs/14.";
CM_ SG_ 1803 UNK_272_5 "Candidate from the carry-chain split, unverified: LSB flips 0.095 per cycle, 17 distinct values 2..18. Strongest correlation: age r=+0.30. Size / class candidate: camera vehicle height partial rho 0.41-0.71, width 0.36-0.69, truck/bus 0.24-0.39 (docs/14).";
CM_ SG_ 1803 CONST_277_11 "Constant 0 (0x0) in the original small-corpus survey; not proof of reserved/padding bits or universal constancy.";
CM_ BO_ 1804 "Reassembled 0x80 object slot 12 (record bytes 449-484), sent only when occupied. Little-endian bit field: bit 0 = LSB of slot byte 0.";
CM_ SG_ 1804 STATE_CODE "Raw lifecycle state. Measured/predicted semantics not proved; not an accuracy gate.";
CM_ SG_ 1804 SLOT_INDEX_CODE "Physical slot index or 63 in unallocated-form headers; verified against slot positions. Not class or reference point.";
CM_ SG_ 1804 UNK_8_6 "Candidate from the carry-chain split, unverified: LSB flips 0.103 per cycle, 32 distinct values 30..62. Strongest correlation: age r=+0.55.Legacy combined raw view: low five bits follow an exact startup decay while full movement code109|3 remains5 from birth; bit13 can change separately. Extract low5=value&31 and bit13=value>>5. Mature meaning, units and probability interpretation unresolved; not a validity or excursion gate. See docs/14.";
CM_ SG_ 1804 ONCOMING_FLAG "1 = oncoming now or earlier in the track life (persists after an oncoming object slows). Pre-registered test on unseen segments: over-ground speed < 0 on 100% of flagged rows, 88.5% of objects approaching faster than 2 m/s flagged (docs/14).";
CM_ SG_ 1804 UNK_15_1 "Expanded-corpus correction: Mostly set on newborn zero-range rows, with exceptions; not a validity gate. See docs/14.";
CM_ SG_ 1804 SCORE_CODE "Bounded score-like byte, not calibrated confidence or percent. Value 100 does not guarantee accurate geometry or velocity.";
CM_ SG_ 1804 AGE "Track age in radar cycles (~60 ms): 1 at birth, saturates at 126; 0 = slot being retired (geometry is the previous occupant's). A restart is a new track. Tracks younger than ~60 carry unconverged range and velocity.";
CM_ SG_ 1804 CONST_31_1 "Constant 0 (0x0) in the original small-corpus survey; not proof of reserved/padding bits or universal constancy.";
CM_ SG_ 1804 DREL "Longitudinal distance forward of the radar, m. 1/16 m, zero code 160 (exactly -10 m). Camera ground contact at 5-25 m: slope 0.99-1.00 on three drives, zero within 0.2 m (0.7 m on a hilly drive). Settled tracks walk by metres record to record at 40 m+; young tracks can be far off.";
CM_ SG_ 1804 YREL_LEFT "Lateral offset, LEFT positive (openpilot yRel), m. 1/64 m, offset binary around 2048. Cartesian (constant across range), not an angle. Correct side 97.9-99.3% on held-out drives; scale bounded to about +/-10%. |code-2048| >= 2000 is a sentinel.";
CM_ SG_ 1804 UNK_56_7 "Candidate from the carry-chain split, unverified: LSB flips 0.355 per cycle, 84 distinct values 4..96. Strongest correlation: age r=+0.30. Size / class candidate: per-track median follows camera vehicle height (partial rho 0.48-0.61 at fixed range) and truck/bus class (docs/14).";
CM_ SG_ 1804 UNK_63_1 "Expanded-corpus correction: Rare changing bit; only two rows in the expanded corpus. See docs/14.";
CM_ SG_ 1804 VLONG_OVER_GROUND "Longitudinal velocity OVER GROUND, m/s. 0.15 m/s/code, zero 510.5. vRel = this - ego speed. Radar-only scale check (own range slope vs GPS ego) gives 0.150/0.149/0.153 on three drives. Beats zero and range differencing against a camera reference, but has unflagged ~1 s excursions at range. Unsettled for age < ~60.";
CM_ SG_ 1804 VLAT_OVER_GROUND_PROV "Lateral velocity over ground, LEFT positive (sign confirmed). Scale NOT pinned: the factor shown (0.15) is a placeholder. Radar-only estimates from its own lateral position change range 0.097-0.147 m/s per code across data sets, and the pre-registered test was unverified. See docs/14.";
CM_ SG_ 1804 ALONG_LIKE_84 "Acceleration-like, zero code 511 at standstill. Follows the VLONG change with a ~0.5 s lag, so it cannot flag or lead a velocity excursion. Radar-only scale about 0.04 m/s^2 per code on most data but drive-dependent (0.03-0.11); centred codes (docs/14).";
CM_ SG_ 1804 CONST_94_2 "Constant 0 (0x0) in the original small-corpus survey; not proof of reserved/padding bits or universal constancy.";
CM_ SG_ 1804 UNK_96 "Lateral ground-acceleration-like candidate: (raw-511)*0.05 m/s^2, calibration provisional. Rotation-corrected kinematics and a discovery-selected +0.5 s lag transfer to further drives (r about 0.90). Raw code retained; no accuracy gate or runtime use. See docs/14 for route exceptions and reference limitations.";
CM_ SG_ 1804 UNK_106_1 "Candidate from the carry-chain split, unverified: LSB flips 0.003 per cycle, 2 distinct values 0..1. Strongest correlation: v_over_ground r=-0.14.";
CM_ SG_ 1804 UNK_107_1 "Candidate from the carry-chain split, unverified: LSB flips 0.013 per cycle, 2 distinct values 0..1. Strongest correlation: v_over_ground r=-0.24. Coasting-flag candidate: about 0.02 in settled life, 0.5-0.66 just before deletion (docs/14).";
CM_ SG_ 1804 CONST_108_1 "Constant 0 (0x0) in the original small-corpus survey; not proof of reserved/padding bits or universal constancy.";
CM_ SG_ 1804 MOVE_STATE "Legacy low-two-bit motion projection. Full code = MOVE_STATE | ((UNK_111_4 & 1) << 2). Full 3 is rightward-like, 4 leftward-like, 5 initialization/unsettled-like, 7 stopped-like; meanings provisional. Old labels conflate these states. See docs/14.";
CM_ SG_ 1804 UNK_111_4 "Candidate from the carry-chain split, unverified: LSB flips 0.008 per cycle, 10 distinct values 0..9. Strongest correlation: dRel r=-0.53.";
CM_ SG_ 1804 UNK_115_8 "Candidate from the carry-chain split, unverified: LSB flips 0.052 per cycle, 26 distinct values 0..178. Strongest correlation: age r=+0.27.";
CM_ SG_ 1804 CONST_123_5 "Constant 31 (0x1F) in the original small-corpus survey; not proof of reserved/padding bits or universal constancy.";
CM_ SG_ 1804 UNK_128_2 "Candidate from the carry-chain split, unverified: LSB flips 0.013 per cycle, 4 distinct values 0..3. Strongest correlation: dRel r=+0.11.";
CM_ SG_ 1804 UNK_130_1 "Candidate from the carry-chain split, unverified: LSB flips 0.019 per cycle, 2 distinct values 0..1. Strongest correlation: abs_yRel r=+0.34.";
CM_ SG_ 1804 UNK_131_4 "Candidate from the carry-chain split, unverified: LSB flips 0.102 per cycle, 9 distinct values 7..15. Strongest correlation: abs_yRel r=+0.09.";
CM_ SG_ 1804 CONST_135_1 "Constant 0 (0x0) in the original small-corpus survey; not proof of reserved/padding bits or universal constancy.";
CM_ SG_ 1804 UNK_136_6 "Candidate from the carry-chain split, unverified: LSB flips 0.093 per cycle, 39 distinct values 3..63. Strongest correlation: age r=+0.20.";
CM_ SG_ 1804 UNK_142_1 "Candidate from the carry-chain split, unverified: LSB flips 0.007 per cycle, 2 distinct values 0..1. Strongest correlation: age r=+0.47.";
CM_ SG_ 1804 CONST_143_5 "Constant 30 (0x1E) in the original small-corpus survey; not proof of reserved/padding bits or universal constancy.";
CM_ SG_ 1804 UNK_148_8 "Candidate from the carry-chain split, unverified: LSB flips 0.009 per cycle, 27 distinct values 0..240. Strongest correlation: dRel r=-0.12.Legacy combined view of two candidate weight nibbles148|4 and152|4: first=value&15, second=value>>4. Together with156|4, nonzero triplets nearly always sum to15 or16, with two observed sum14 exceptions. Physical outcomes and probability calibration remain unresolved (docs/14).";
CM_ SG_ 1804 UNK_156_4 "Candidate from the carry-chain split, unverified: LSB flips 0.016 per cycle, 16 distinct values 0..15. Strongest correlation: abs_yRel r=-0.42.Third component of the candidate weight triplet148/152/156|4. All-zero meaning and physical outcomes unknown; not an excursion or validity gate (docs/14).";
CM_ SG_ 1804 CONST_160_3 "Constant 0 (0x0) in the original small-corpus survey; not proof of reserved/padding bits or universal constancy.";
CM_ SG_ 1804 UNK_163_2 "Candidate from the carry-chain split, unverified: LSB flips 0.006 per cycle, 3 distinct values 1..3. Strongest correlation: age r=+0.30.";
CM_ SG_ 1804 UNK_165_3 "Expanded-corpus correction: Changes within some tracks; observed codes 0 and 1. See docs/14.";
CM_ SG_ 1804 UNK_168_10 "Candidate from the carry-chain split, unverified: LSB flips 0.066 per cycle, 3 distinct values 0..1023. Strongest correlation: abs_yRel r=+0.14.";
CM_ SG_ 1804 CONST_178_3 "Constant 0 (0x0) in the original small-corpus survey; not proof of reserved/padding bits or universal constancy.";
CM_ SG_ 1804 UNK_181_1 "Candidate from the carry-chain split, unverified: LSB flips 0.071 per cycle, 2 distinct values 0..1. Strongest correlation: v_over_ground r=+0.34.";
CM_ SG_ 1804 UNK_182_1 "Expanded-corpus correction: Rare changing bit; observed in one short track episode. See docs/14.";
CM_ SG_ 1804 UNK_183_7 "Candidate from the carry-chain split, unverified: LSB flips 0.009 per cycle, 24 distinct values 26..73. Strongest correlation: age r=+0.20.";
CM_ SG_ 1804 UNK_190_10 "Expanded-corpus correction: Observed codes 0 and 1. Usually follows positive age, with three exceptions; not a validity gate. See docs/14.";
CM_ SG_ 1804 UNK_200_7 "Candidate from the carry-chain split, unverified: LSB flips 0.023 per cycle, 16 distinct values 0..127. Strongest correlation: v_over_ground r=-0.45.";
CM_ SG_ 1804 CONST_207_1 "Constant 0 (0x0) in the original small-corpus survey; not proof of reserved/padding bits or universal constancy.";
CM_ SG_ 1804 UNK_208_6 "Candidate from the carry-chain split, unverified: LSB flips 0.017 per cycle, 20 distinct values 0..63. Strongest correlation: v_over_ground r=-0.38.Coarse nonnegative velocity-heading-like candidate, about pi/64 rad/code. Negative headings almost always map to zero. Raw code retained; not a complete signed orientation, independent Doppler or control gate. See docs/14.";
CM_ SG_ 1804 CONST_214_2 "Constant 0 (0x0) in the original small-corpus survey; not proof of reserved/padding bits or universal constancy.";
CM_ SG_ 1804 UNK_216_6 "Candidate from the carry-chain split, unverified: LSB flips 0.150 per cycle, 34 distinct values 3..49. Strongest correlation: age r=+0.23. Size / class candidate: camera vehicle height partial rho 0.44-0.63, truck/bus 0.35-0.42; width on A/C. Compare ARS4-B Length / dZ (6 bits) (docs/14).";
CM_ SG_ 1804 CONST_222_2 "Constant 0 (0x0) in the original small-corpus survey; not proof of reserved/padding bits or universal constancy.";
CM_ SG_ 1804 UNK_224_7 "Candidate from the carry-chain split, unverified: LSB flips 0.344 per cycle, 127 distinct values 1..127. Strongest correlation: dRel r=+0.80. Uncertainty candidate: scales with range (r~0.8), falls with age at fixed range (rho -0.29 to -0.36), larger when range steps are noisier, rises before deletion. Weak near-range error indicator; does not single out excursions.";
CM_ SG_ 1804 CONST_231_1 "Constant 0 (0x0) in the original small-corpus survey; not proof of reserved/padding bits or universal constancy.";
CM_ SG_ 1804 UNK_232_7 "Candidate from the carry-chain split, unverified: LSB flips 0.096 per cycle, 72 distinct values 0..127. Strongest correlation: abs_yRel r=+0.60. Lateral-uncertainty candidate: scales with |yRel| (r~0.6), falls with age at fixed range (rho -0.50 to -0.59).";
CM_ SG_ 1804 UNK_239_1 "Expanded-corpus correction: Changes within tracks; often active near birth. The former PER_TRACK label was too strong. See docs/14.";
CM_ SG_ 1804 UNK_240_7 "Candidate from the carry-chain split, unverified: LSB flips 0.364 per cycle, 127 distinct values 1..127. Strongest correlation: dRel r=+0.80. Velocity-uncertainty candidate (like ARS408 VrelLong_rms): scales with range, falls with age, rises before deletion. Flags velocity glitches: stratified AUC 0.65 / 0.85 (discovery / confirmation) against clean labels where native vRel disagrees with both the radar ACC target (0x235) and vision (docs/15). Decoded as vel_unc_code.";
CM_ SG_ 1804 CONST_247_1 "Constant 0 (0x0) in the original small-corpus survey; not proof of reserved/padding bits or universal constancy.";
CM_ SG_ 1804 UNK_248_7 "Candidate from the carry-chain split, unverified: LSB flips 0.116 per cycle, 97 distinct values 0..127. Strongest correlation: abs_yRel r=+0.56. Uncertainty candidate: scales with |yRel| (r~0.56), falls with age at fixed range (rho -0.70 to -0.75).";
CM_ SG_ 1804 CONST_255_1 "Constant 0 (0x0) in the original small-corpus survey; not proof of reserved/padding bits or universal constancy.";
CM_ SG_ 1804 UNK_256_6 "Expanded-corpus correction: Expanded raw window: repeated 31-to-32 and reverse carries in discovery, confirmation and further drives. Full field width, units and meaning unresolved. See docs/14.";
CM_ SG_ 1804 UNK_262_2 "Expanded-corpus correction: Remaining upper bits are not universally constant. May belong to the preceding quantity; boundary unresolved. See docs/14.";
CM_ SG_ 1804 UNK_264_5 "Expanded-corpus correction: Expanded raw window: repeated 15-to-16 and reverse carries. Full field width and scan/uncertainty semantics unresolved; old four-bit analyses used only its low bits. See docs/14.";
CM_ SG_ 1804 UNK_269_3 "Expanded-corpus correction: Rare nonzero upper bits; may belong to the preceding quantity. Boundary unresolved. See docs/14.";
CM_ SG_ 1804 UNK_272_5 "Candidate from the carry-chain split, unverified: LSB flips 0.095 per cycle, 17 distinct values 2..18. Strongest correlation: age r=+0.30. Size / class candidate: camera vehicle height partial rho 0.41-0.71, width 0.36-0.69, truck/bus 0.24-0.39 (docs/14).";
CM_ SG_ 1804 CONST_277_11 "Constant 0 (0x0) in the original small-corpus survey; not proof of reserved/padding bits or universal constancy.";
CM_ BO_ 1805 "Reassembled 0x80 object slot 13 (record bytes 485-520), sent only when occupied. Little-endian bit field: bit 0 = LSB of slot byte 0.";
CM_ SG_ 1805 STATE_CODE "Raw lifecycle state. Measured/predicted semantics not proved; not an accuracy gate.";
CM_ SG_ 1805 SLOT_INDEX_CODE "Physical slot index or 63 in unallocated-form headers; verified against slot positions. Not class or reference point.";
CM_ SG_ 1805 UNK_8_6 "Candidate from the carry-chain split, unverified: LSB flips 0.103 per cycle, 32 distinct values 30..62. Strongest correlation: age r=+0.55.Legacy combined raw view: low five bits follow an exact startup decay while full movement code109|3 remains5 from birth; bit13 can change separately. Extract low5=value&31 and bit13=value>>5. Mature meaning, units and probability interpretation unresolved; not a validity or excursion gate. See docs/14.";
CM_ SG_ 1805 ONCOMING_FLAG "1 = oncoming now or earlier in the track life (persists after an oncoming object slows). Pre-registered test on unseen segments: over-ground speed < 0 on 100% of flagged rows, 88.5% of objects approaching faster than 2 m/s flagged (docs/14).";
CM_ SG_ 1805 UNK_15_1 "Expanded-corpus correction: Mostly set on newborn zero-range rows, with exceptions; not a validity gate. See docs/14.";
CM_ SG_ 1805 SCORE_CODE "Bounded score-like byte, not calibrated confidence or percent. Value 100 does not guarantee accurate geometry or velocity.";
CM_ SG_ 1805 AGE "Track age in radar cycles (~60 ms): 1 at birth, saturates at 126; 0 = slot being retired (geometry is the previous occupant's). A restart is a new track. Tracks younger than ~60 carry unconverged range and velocity.";
CM_ SG_ 1805 CONST_31_1 "Constant 0 (0x0) in the original small-corpus survey; not proof of reserved/padding bits or universal constancy.";
CM_ SG_ 1805 DREL "Longitudinal distance forward of the radar, m. 1/16 m, zero code 160 (exactly -10 m). Camera ground contact at 5-25 m: slope 0.99-1.00 on three drives, zero within 0.2 m (0.7 m on a hilly drive). Settled tracks walk by metres record to record at 40 m+; young tracks can be far off.";
CM_ SG_ 1805 YREL_LEFT "Lateral offset, LEFT positive (openpilot yRel), m. 1/64 m, offset binary around 2048. Cartesian (constant across range), not an angle. Correct side 97.9-99.3% on held-out drives; scale bounded to about +/-10%. |code-2048| >= 2000 is a sentinel.";
CM_ SG_ 1805 UNK_56_7 "Candidate from the carry-chain split, unverified: LSB flips 0.355 per cycle, 84 distinct values 4..96. Strongest correlation: age r=+0.30. Size / class candidate: per-track median follows camera vehicle height (partial rho 0.48-0.61 at fixed range) and truck/bus class (docs/14).";
CM_ SG_ 1805 UNK_63_1 "Expanded-corpus correction: Rare changing bit; only two rows in the expanded corpus. See docs/14.";
CM_ SG_ 1805 VLONG_OVER_GROUND "Longitudinal velocity OVER GROUND, m/s. 0.15 m/s/code, zero 510.5. vRel = this - ego speed. Radar-only scale check (own range slope vs GPS ego) gives 0.150/0.149/0.153 on three drives. Beats zero and range differencing against a camera reference, but has unflagged ~1 s excursions at range. Unsettled for age < ~60.";
CM_ SG_ 1805 VLAT_OVER_GROUND_PROV "Lateral velocity over ground, LEFT positive (sign confirmed). Scale NOT pinned: the factor shown (0.15) is a placeholder. Radar-only estimates from its own lateral position change range 0.097-0.147 m/s per code across data sets, and the pre-registered test was unverified. See docs/14.";
CM_ SG_ 1805 ALONG_LIKE_84 "Acceleration-like, zero code 511 at standstill. Follows the VLONG change with a ~0.5 s lag, so it cannot flag or lead a velocity excursion. Radar-only scale about 0.04 m/s^2 per code on most data but drive-dependent (0.03-0.11); centred codes (docs/14).";
CM_ SG_ 1805 CONST_94_2 "Constant 0 (0x0) in the original small-corpus survey; not proof of reserved/padding bits or universal constancy.";
CM_ SG_ 1805 UNK_96 "Lateral ground-acceleration-like candidate: (raw-511)*0.05 m/s^2, calibration provisional. Rotation-corrected kinematics and a discovery-selected +0.5 s lag transfer to further drives (r about 0.90). Raw code retained; no accuracy gate or runtime use. See docs/14 for route exceptions and reference limitations.";
CM_ SG_ 1805 UNK_106_1 "Candidate from the carry-chain split, unverified: LSB flips 0.003 per cycle, 2 distinct values 0..1. Strongest correlation: v_over_ground r=-0.14.";
CM_ SG_ 1805 UNK_107_1 "Candidate from the carry-chain split, unverified: LSB flips 0.013 per cycle, 2 distinct values 0..1. Strongest correlation: v_over_ground r=-0.24. Coasting-flag candidate: about 0.02 in settled life, 0.5-0.66 just before deletion (docs/14).";
CM_ SG_ 1805 CONST_108_1 "Constant 0 (0x0) in the original small-corpus survey; not proof of reserved/padding bits or universal constancy.";
CM_ SG_ 1805 MOVE_STATE "Legacy low-two-bit motion projection. Full code = MOVE_STATE | ((UNK_111_4 & 1) << 2). Full 3 is rightward-like, 4 leftward-like, 5 initialization/unsettled-like, 7 stopped-like; meanings provisional. Old labels conflate these states. See docs/14.";
CM_ SG_ 1805 UNK_111_4 "Candidate from the carry-chain split, unverified: LSB flips 0.008 per cycle, 10 distinct values 0..9. Strongest correlation: dRel r=-0.53.";
CM_ SG_ 1805 UNK_115_8 "Candidate from the carry-chain split, unverified: LSB flips 0.052 per cycle, 26 distinct values 0..178. Strongest correlation: age r=+0.27.";
CM_ SG_ 1805 CONST_123_5 "Constant 31 (0x1F) in the original small-corpus survey; not proof of reserved/padding bits or universal constancy.";
CM_ SG_ 1805 UNK_128_2 "Candidate from the carry-chain split, unverified: LSB flips 0.013 per cycle, 4 distinct values 0..3. Strongest correlation: dRel r=+0.11.";
CM_ SG_ 1805 UNK_130_1 "Candidate from the carry-chain split, unverified: LSB flips 0.019 per cycle, 2 distinct values 0..1. Strongest correlation: abs_yRel r=+0.34.";
CM_ SG_ 1805 UNK_131_4 "Candidate from the carry-chain split, unverified: LSB flips 0.102 per cycle, 9 distinct values 7..15. Strongest correlation: abs_yRel r=+0.09.";
CM_ SG_ 1805 CONST_135_1 "Constant 0 (0x0) in the original small-corpus survey; not proof of reserved/padding bits or universal constancy.";
CM_ SG_ 1805 UNK_136_6 "Candidate from the carry-chain split, unverified: LSB flips 0.093 per cycle, 39 distinct values 3..63. Strongest correlation: age r=+0.20.";
CM_ SG_ 1805 UNK_142_1 "Candidate from the carry-chain split, unverified: LSB flips 0.007 per cycle, 2 distinct values 0..1. Strongest correlation: age r=+0.47.";
CM_ SG_ 1805 CONST_143_5 "Constant 30 (0x1E) in the original small-corpus survey; not proof of reserved/padding bits or universal constancy.";
CM_ SG_ 1805 UNK_148_8 "Candidate from the carry-chain split, unverified: LSB flips 0.009 per cycle, 27 distinct values 0..240. Strongest correlation: dRel r=-0.12.Legacy combined view of two candidate weight nibbles148|4 and152|4: first=value&15, second=value>>4. Together with156|4, nonzero triplets nearly always sum to15 or16, with two observed sum14 exceptions. Physical outcomes and probability calibration remain unresolved (docs/14).";
CM_ SG_ 1805 UNK_156_4 "Candidate from the carry-chain split, unverified: LSB flips 0.016 per cycle, 16 distinct values 0..15. Strongest correlation: abs_yRel r=-0.42.Third component of the candidate weight triplet148/152/156|4. All-zero meaning and physical outcomes unknown; not an excursion or validity gate (docs/14).";
CM_ SG_ 1805 CONST_160_3 "Constant 0 (0x0) in the original small-corpus survey; not proof of reserved/padding bits or universal constancy.";
CM_ SG_ 1805 UNK_163_2 "Candidate from the carry-chain split, unverified: LSB flips 0.006 per cycle, 3 distinct values 1..3. Strongest correlation: age r=+0.30.";
CM_ SG_ 1805 UNK_165_3 "Expanded-corpus correction: Changes within some tracks; observed codes 0 and 1. See docs/14.";
CM_ SG_ 1805 UNK_168_10 "Candidate from the carry-chain split, unverified: LSB flips 0.066 per cycle, 3 distinct values 0..1023. Strongest correlation: abs_yRel r=+0.14.";
CM_ SG_ 1805 CONST_178_3 "Constant 0 (0x0) in the original small-corpus survey; not proof of reserved/padding bits or universal constancy.";
CM_ SG_ 1805 UNK_181_1 "Candidate from the carry-chain split, unverified: LSB flips 0.071 per cycle, 2 distinct values 0..1. Strongest correlation: v_over_ground r=+0.34.";
CM_ SG_ 1805 UNK_182_1 "Expanded-corpus correction: Rare changing bit; observed in one short track episode. See docs/14.";
CM_ SG_ 1805 UNK_183_7 "Candidate from the carry-chain split, unverified: LSB flips 0.009 per cycle, 24 distinct values 26..73. Strongest correlation: age r=+0.20.";
CM_ SG_ 1805 UNK_190_10 "Expanded-corpus correction: Observed codes 0 and 1. Usually follows positive age, with three exceptions; not a validity gate. See docs/14.";
CM_ SG_ 1805 UNK_200_7 "Candidate from the carry-chain split, unverified: LSB flips 0.023 per cycle, 16 distinct values 0..127. Strongest correlation: v_over_ground r=-0.45.";
CM_ SG_ 1805 CONST_207_1 "Constant 0 (0x0) in the original small-corpus survey; not proof of reserved/padding bits or universal constancy.";
CM_ SG_ 1805 UNK_208_6 "Candidate from the carry-chain split, unverified: LSB flips 0.017 per cycle, 20 distinct values 0..63. Strongest correlation: v_over_ground r=-0.38.Coarse nonnegative velocity-heading-like candidate, about pi/64 rad/code. Negative headings almost always map to zero. Raw code retained; not a complete signed orientation, independent Doppler or control gate. See docs/14.";
CM_ SG_ 1805 CONST_214_2 "Constant 0 (0x0) in the original small-corpus survey; not proof of reserved/padding bits or universal constancy.";
CM_ SG_ 1805 UNK_216_6 "Candidate from the carry-chain split, unverified: LSB flips 0.150 per cycle, 34 distinct values 3..49. Strongest correlation: age r=+0.23. Size / class candidate: camera vehicle height partial rho 0.44-0.63, truck/bus 0.35-0.42; width on A/C. Compare ARS4-B Length / dZ (6 bits) (docs/14).";
CM_ SG_ 1805 CONST_222_2 "Constant 0 (0x0) in the original small-corpus survey; not proof of reserved/padding bits or universal constancy.";
CM_ SG_ 1805 UNK_224_7 "Candidate from the carry-chain split, unverified: LSB flips 0.344 per cycle, 127 distinct values 1..127. Strongest correlation: dRel r=+0.80. Uncertainty candidate: scales with range (r~0.8), falls with age at fixed range (rho -0.29 to -0.36), larger when range steps are noisier, rises before deletion. Weak near-range error indicator; does not single out excursions.";
CM_ SG_ 1805 CONST_231_1 "Constant 0 (0x0) in the original small-corpus survey; not proof of reserved/padding bits or universal constancy.";
CM_ SG_ 1805 UNK_232_7 "Candidate from the carry-chain split, unverified: LSB flips 0.096 per cycle, 72 distinct values 0..127. Strongest correlation: abs_yRel r=+0.60. Lateral-uncertainty candidate: scales with |yRel| (r~0.6), falls with age at fixed range (rho -0.50 to -0.59).";
CM_ SG_ 1805 UNK_239_1 "Expanded-corpus correction: Changes within tracks; often active near birth. The former PER_TRACK label was too strong. See docs/14.";
CM_ SG_ 1805 UNK_240_7 "Candidate from the carry-chain split, unverified: LSB flips 0.364 per cycle, 127 distinct values 1..127. Strongest correlation: dRel r=+0.80. Velocity-uncertainty candidate (like ARS408 VrelLong_rms): scales with range, falls with age, rises before deletion. Flags velocity glitches: stratified AUC 0.65 / 0.85 (discovery / confirmation) against clean labels where native vRel disagrees with both the radar ACC target (0x235) and vision (docs/15). Decoded as vel_unc_code.";
CM_ SG_ 1805 CONST_247_1 "Constant 0 (0x0) in the original small-corpus survey; not proof of reserved/padding bits or universal constancy.";
CM_ SG_ 1805 UNK_248_7 "Candidate from the carry-chain split, unverified: LSB flips 0.116 per cycle, 97 distinct values 0..127. Strongest correlation: abs_yRel r=+0.56. Uncertainty candidate: scales with |yRel| (r~0.56), falls with age at fixed range (rho -0.70 to -0.75).";
CM_ SG_ 1805 CONST_255_1 "Constant 0 (0x0) in the original small-corpus survey; not proof of reserved/padding bits or universal constancy.";
CM_ SG_ 1805 UNK_256_6 "Expanded-corpus correction: Expanded raw window: repeated 31-to-32 and reverse carries in discovery, confirmation and further drives. Full field width, units and meaning unresolved. See docs/14.";
CM_ SG_ 1805 UNK_262_2 "Expanded-corpus correction: Remaining upper bits are not universally constant. May belong to the preceding quantity; boundary unresolved. See docs/14.";
CM_ SG_ 1805 UNK_264_5 "Expanded-corpus correction: Expanded raw window: repeated 15-to-16 and reverse carries. Full field width and scan/uncertainty semantics unresolved; old four-bit analyses used only its low bits. See docs/14.";
CM_ SG_ 1805 UNK_269_3 "Expanded-corpus correction: Rare nonzero upper bits; may belong to the preceding quantity. Boundary unresolved. See docs/14.";
CM_ SG_ 1805 UNK_272_5 "Candidate from the carry-chain split, unverified: LSB flips 0.095 per cycle, 17 distinct values 2..18. Strongest correlation: age r=+0.30. Size / class candidate: camera vehicle height partial rho 0.41-0.71, width 0.36-0.69, truck/bus 0.24-0.39 (docs/14).";
CM_ SG_ 1805 CONST_277_11 "Constant 0 (0x0) in the original small-corpus survey; not proof of reserved/padding bits or universal constancy.";
CM_ BO_ 1806 "Reassembled 0x80 object slot 14 (record bytes 521-556), sent only when occupied. Little-endian bit field: bit 0 = LSB of slot byte 0.";
CM_ SG_ 1806 STATE_CODE "Raw lifecycle state. Measured/predicted semantics not proved; not an accuracy gate.";
CM_ SG_ 1806 SLOT_INDEX_CODE "Physical slot index or 63 in unallocated-form headers; verified against slot positions. Not class or reference point.";
CM_ SG_ 1806 UNK_8_6 "Candidate from the carry-chain split, unverified: LSB flips 0.103 per cycle, 32 distinct values 30..62. Strongest correlation: age r=+0.55.Legacy combined raw view: low five bits follow an exact startup decay while full movement code109|3 remains5 from birth; bit13 can change separately. Extract low5=value&31 and bit13=value>>5. Mature meaning, units and probability interpretation unresolved; not a validity or excursion gate. See docs/14.";
CM_ SG_ 1806 ONCOMING_FLAG "1 = oncoming now or earlier in the track life (persists after an oncoming object slows). Pre-registered test on unseen segments: over-ground speed < 0 on 100% of flagged rows, 88.5% of objects approaching faster than 2 m/s flagged (docs/14).";
CM_ SG_ 1806 UNK_15_1 "Expanded-corpus correction: Mostly set on newborn zero-range rows, with exceptions; not a validity gate. See docs/14.";
CM_ SG_ 1806 SCORE_CODE "Bounded score-like byte, not calibrated confidence or percent. Value 100 does not guarantee accurate geometry or velocity.";
CM_ SG_ 1806 AGE "Track age in radar cycles (~60 ms): 1 at birth, saturates at 126; 0 = slot being retired (geometry is the previous occupant's). A restart is a new track. Tracks younger than ~60 carry unconverged range and velocity.";
CM_ SG_ 1806 CONST_31_1 "Constant 0 (0x0) in the original small-corpus survey; not proof of reserved/padding bits or universal constancy.";
CM_ SG_ 1806 DREL "Longitudinal distance forward of the radar, m. 1/16 m, zero code 160 (exactly -10 m). Camera ground contact at 5-25 m: slope 0.99-1.00 on three drives, zero within 0.2 m (0.7 m on a hilly drive). Settled tracks walk by metres record to record at 40 m+; young tracks can be far off.";
CM_ SG_ 1806 YREL_LEFT "Lateral offset, LEFT positive (openpilot yRel), m. 1/64 m, offset binary around 2048. Cartesian (constant across range), not an angle. Correct side 97.9-99.3% on held-out drives; scale bounded to about +/-10%. |code-2048| >= 2000 is a sentinel.";
CM_ SG_ 1806 UNK_56_7 "Candidate from the carry-chain split, unverified: LSB flips 0.355 per cycle, 84 distinct values 4..96. Strongest correlation: age r=+0.30. Size / class candidate: per-track median follows camera vehicle height (partial rho 0.48-0.61 at fixed range) and truck/bus class (docs/14).";
CM_ SG_ 1806 UNK_63_1 "Expanded-corpus correction: Rare changing bit; only two rows in the expanded corpus. See docs/14.";
CM_ SG_ 1806 VLONG_OVER_GROUND "Longitudinal velocity OVER GROUND, m/s. 0.15 m/s/code, zero 510.5. vRel = this - ego speed. Radar-only scale check (own range slope vs GPS ego) gives 0.150/0.149/0.153 on three drives. Beats zero and range differencing against a camera reference, but has unflagged ~1 s excursions at range. Unsettled for age < ~60.";
CM_ SG_ 1806 VLAT_OVER_GROUND_PROV "Lateral velocity over ground, LEFT positive (sign confirmed). Scale NOT pinned: the factor shown (0.15) is a placeholder. Radar-only estimates from its own lateral position change range 0.097-0.147 m/s per code across data sets, and the pre-registered test was unverified. See docs/14.";
CM_ SG_ 1806 ALONG_LIKE_84 "Acceleration-like, zero code 511 at standstill. Follows the VLONG change with a ~0.5 s lag, so it cannot flag or lead a velocity excursion. Radar-only scale about 0.04 m/s^2 per code on most data but drive-dependent (0.03-0.11); centred codes (docs/14).";
CM_ SG_ 1806 CONST_94_2 "Constant 0 (0x0) in the original small-corpus survey; not proof of reserved/padding bits or universal constancy.";
CM_ SG_ 1806 UNK_96 "Lateral ground-acceleration-like candidate: (raw-511)*0.05 m/s^2, calibration provisional. Rotation-corrected kinematics and a discovery-selected +0.5 s lag transfer to further drives (r about 0.90). Raw code retained; no accuracy gate or runtime use. See docs/14 for route exceptions and reference limitations.";
CM_ SG_ 1806 UNK_106_1 "Candidate from the carry-chain split, unverified: LSB flips 0.003 per cycle, 2 distinct values 0..1. Strongest correlation: v_over_ground r=-0.14.";
CM_ SG_ 1806 UNK_107_1 "Candidate from the carry-chain split, unverified: LSB flips 0.013 per cycle, 2 distinct values 0..1. Strongest correlation: v_over_ground r=-0.24. Coasting-flag candidate: about 0.02 in settled life, 0.5-0.66 just before deletion (docs/14).";
CM_ SG_ 1806 CONST_108_1 "Constant 0 (0x0) in the original small-corpus survey; not proof of reserved/padding bits or universal constancy.";
CM_ SG_ 1806 MOVE_STATE "Legacy low-two-bit motion projection. Full code = MOVE_STATE | ((UNK_111_4 & 1) << 2). Full 3 is rightward-like, 4 leftward-like, 5 initialization/unsettled-like, 7 stopped-like; meanings provisional. Old labels conflate these states. See docs/14.";
CM_ SG_ 1806 UNK_111_4 "Candidate from the carry-chain split, unverified: LSB flips 0.008 per cycle, 10 distinct values 0..9. Strongest correlation: dRel r=-0.53.";
CM_ SG_ 1806 UNK_115_8 "Candidate from the carry-chain split, unverified: LSB flips 0.052 per cycle, 26 distinct values 0..178. Strongest correlation: age r=+0.27.";
CM_ SG_ 1806 CONST_123_5 "Constant 31 (0x1F) in the original small-corpus survey; not proof of reserved/padding bits or universal constancy.";
CM_ SG_ 1806 UNK_128_2 "Candidate from the carry-chain split, unverified: LSB flips 0.013 per cycle, 4 distinct values 0..3. Strongest correlation: dRel r=+0.11.";
CM_ SG_ 1806 UNK_130_1 "Candidate from the carry-chain split, unverified: LSB flips 0.019 per cycle, 2 distinct values 0..1. Strongest correlation: abs_yRel r=+0.34.";
CM_ SG_ 1806 UNK_131_4 "Candidate from the carry-chain split, unverified: LSB flips 0.102 per cycle, 9 distinct values 7..15. Strongest correlation: abs_yRel r=+0.09.";
CM_ SG_ 1806 CONST_135_1 "Constant 0 (0x0) in the original small-corpus survey; not proof of reserved/padding bits or universal constancy.";
CM_ SG_ 1806 UNK_136_6 "Candidate from the carry-chain split, unverified: LSB flips 0.093 per cycle, 39 distinct values 3..63. Strongest correlation: age r=+0.20.";
CM_ SG_ 1806 UNK_142_1 "Candidate from the carry-chain split, unverified: LSB flips 0.007 per cycle, 2 distinct values 0..1. Strongest correlation: age r=+0.47.";
CM_ SG_ 1806 CONST_143_5 "Constant 30 (0x1E) in the original small-corpus survey; not proof of reserved/padding bits or universal constancy.";
CM_ SG_ 1806 UNK_148_8 "Candidate from the carry-chain split, unverified: LSB flips 0.009 per cycle, 27 distinct values 0..240. Strongest correlation: dRel r=-0.12.Legacy combined view of two candidate weight nibbles148|4 and152|4: first=value&15, second=value>>4. Together with156|4, nonzero triplets nearly always sum to15 or16, with two observed sum14 exceptions. Physical outcomes and probability calibration remain unresolved (docs/14).";
CM_ SG_ 1806 UNK_156_4 "Candidate from the carry-chain split, unverified: LSB flips 0.016 per cycle, 16 distinct values 0..15. Strongest correlation: abs_yRel r=-0.42.Third component of the candidate weight triplet148/152/156|4. All-zero meaning and physical outcomes unknown; not an excursion or validity gate (docs/14).";
CM_ SG_ 1806 CONST_160_3 "Constant 0 (0x0) in the original small-corpus survey; not proof of reserved/padding bits or universal constancy.";
CM_ SG_ 1806 UNK_163_2 "Candidate from the carry-chain split, unverified: LSB flips 0.006 per cycle, 3 distinct values 1..3. Strongest correlation: age r=+0.30.";
CM_ SG_ 1806 UNK_165_3 "Expanded-corpus correction: Changes within some tracks; observed codes 0 and 1. See docs/14.";
CM_ SG_ 1806 UNK_168_10 "Candidate from the carry-chain split, unverified: LSB flips 0.066 per cycle, 3 distinct values 0..1023. Strongest correlation: abs_yRel r=+0.14.";
CM_ SG_ 1806 CONST_178_3 "Constant 0 (0x0) in the original small-corpus survey; not proof of reserved/padding bits or universal constancy.";
CM_ SG_ 1806 UNK_181_1 "Candidate from the carry-chain split, unverified: LSB flips 0.071 per cycle, 2 distinct values 0..1. Strongest correlation: v_over_ground r=+0.34.";
CM_ SG_ 1806 UNK_182_1 "Expanded-corpus correction: Rare changing bit; observed in one short track episode. See docs/14.";
CM_ SG_ 1806 UNK_183_7 "Candidate from the carry-chain split, unverified: LSB flips 0.009 per cycle, 24 distinct values 26..73. Strongest correlation: age r=+0.20.";
CM_ SG_ 1806 UNK_190_10 "Expanded-corpus correction: Observed codes 0 and 1. Usually follows positive age, with three exceptions; not a validity gate. See docs/14.";
CM_ SG_ 1806 UNK_200_7 "Candidate from the carry-chain split, unverified: LSB flips 0.023 per cycle, 16 distinct values 0..127. Strongest correlation: v_over_ground r=-0.45.";
CM_ SG_ 1806 CONST_207_1 "Constant 0 (0x0) in the original small-corpus survey; not proof of reserved/padding bits or universal constancy.";
CM_ SG_ 1806 UNK_208_6 "Candidate from the carry-chain split, unverified: LSB flips 0.017 per cycle, 20 distinct values 0..63. Strongest correlation: v_over_ground r=-0.38.Coarse nonnegative velocity-heading-like candidate, about pi/64 rad/code. Negative headings almost always map to zero. Raw code retained; not a complete signed orientation, independent Doppler or control gate. See docs/14.";
CM_ SG_ 1806 CONST_214_2 "Constant 0 (0x0) in the original small-corpus survey; not proof of reserved/padding bits or universal constancy.";
CM_ SG_ 1806 UNK_216_6 "Candidate from the carry-chain split, unverified: LSB flips 0.150 per cycle, 34 distinct values 3..49. Strongest correlation: age r=+0.23. Size / class candidate: camera vehicle height partial rho 0.44-0.63, truck/bus 0.35-0.42; width on A/C. Compare ARS4-B Length / dZ (6 bits) (docs/14).";
CM_ SG_ 1806 CONST_222_2 "Constant 0 (0x0) in the original small-corpus survey; not proof of reserved/padding bits or universal constancy.";
CM_ SG_ 1806 UNK_224_7 "Candidate from the carry-chain split, unverified: LSB flips 0.344 per cycle, 127 distinct values 1..127. Strongest correlation: dRel r=+0.80. Uncertainty candidate: scales with range (r~0.8), falls with age at fixed range (rho -0.29 to -0.36), larger when range steps are noisier, rises before deletion. Weak near-range error indicator; does not single out excursions.";
CM_ SG_ 1806 CONST_231_1 "Constant 0 (0x0) in the original small-corpus survey; not proof of reserved/padding bits or universal constancy.";
CM_ SG_ 1806 UNK_232_7 "Candidate from the carry-chain split, unverified: LSB flips 0.096 per cycle, 72 distinct values 0..127. Strongest correlation: abs_yRel r=+0.60. Lateral-uncertainty candidate: scales with |yRel| (r~0.6), falls with age at fixed range (rho -0.50 to -0.59).";
CM_ SG_ 1806 UNK_239_1 "Expanded-corpus correction: Changes within tracks; often active near birth. The former PER_TRACK label was too strong. See docs/14.";
CM_ SG_ 1806 UNK_240_7 "Candidate from the carry-chain split, unverified: LSB flips 0.364 per cycle, 127 distinct values 1..127. Strongest correlation: dRel r=+0.80. Velocity-uncertainty candidate (like ARS408 VrelLong_rms): scales with range, falls with age, rises before deletion. Flags velocity glitches: stratified AUC 0.65 / 0.85 (discovery / confirmation) against clean labels where native vRel disagrees with both the radar ACC target (0x235) and vision (docs/15). Decoded as vel_unc_code.";
CM_ SG_ 1806 CONST_247_1 "Constant 0 (0x0) in the original small-corpus survey; not proof of reserved/padding bits or universal constancy.";
CM_ SG_ 1806 UNK_248_7 "Candidate from the carry-chain split, unverified: LSB flips 0.116 per cycle, 97 distinct values 0..127. Strongest correlation: abs_yRel r=+0.56. Uncertainty candidate: scales with |yRel| (r~0.56), falls with age at fixed range (rho -0.70 to -0.75).";
CM_ SG_ 1806 CONST_255_1 "Constant 0 (0x0) in the original small-corpus survey; not proof of reserved/padding bits or universal constancy.";
CM_ SG_ 1806 UNK_256_6 "Expanded-corpus correction: Expanded raw window: repeated 31-to-32 and reverse carries in discovery, confirmation and further drives. Full field width, units and meaning unresolved. See docs/14.";
CM_ SG_ 1806 UNK_262_2 "Expanded-corpus correction: Remaining upper bits are not universally constant. May belong to the preceding quantity; boundary unresolved. See docs/14.";
CM_ SG_ 1806 UNK_264_5 "Expanded-corpus correction: Expanded raw window: repeated 15-to-16 and reverse carries. Full field width and scan/uncertainty semantics unresolved; old four-bit analyses used only its low bits. See docs/14.";
CM_ SG_ 1806 UNK_269_3 "Expanded-corpus correction: Rare nonzero upper bits; may belong to the preceding quantity. Boundary unresolved. See docs/14.";
CM_ SG_ 1806 UNK_272_5 "Candidate from the carry-chain split, unverified: LSB flips 0.095 per cycle, 17 distinct values 2..18. Strongest correlation: age r=+0.30. Size / class candidate: camera vehicle height partial rho 0.41-0.71, width 0.36-0.69, truck/bus 0.24-0.39 (docs/14).";
CM_ SG_ 1806 CONST_277_11 "Constant 0 (0x0) in the original small-corpus survey; not proof of reserved/padding bits or universal constancy.";
CM_ BO_ 1807 "Reassembled 0x80 object slot 15 (record bytes 557-592), sent only when occupied. Little-endian bit field: bit 0 = LSB of slot byte 0.";
CM_ SG_ 1807 STATE_CODE "Raw lifecycle state. Measured/predicted semantics not proved; not an accuracy gate.";
CM_ SG_ 1807 SLOT_INDEX_CODE "Physical slot index or 63 in unallocated-form headers; verified against slot positions. Not class or reference point.";
CM_ SG_ 1807 UNK_8_6 "Candidate from the carry-chain split, unverified: LSB flips 0.103 per cycle, 32 distinct values 30..62. Strongest correlation: age r=+0.55.Legacy combined raw view: low five bits follow an exact startup decay while full movement code109|3 remains5 from birth; bit13 can change separately. Extract low5=value&31 and bit13=value>>5. Mature meaning, units and probability interpretation unresolved; not a validity or excursion gate. See docs/14.";
CM_ SG_ 1807 ONCOMING_FLAG "1 = oncoming now or earlier in the track life (persists after an oncoming object slows). Pre-registered test on unseen segments: over-ground speed < 0 on 100% of flagged rows, 88.5% of objects approaching faster than 2 m/s flagged (docs/14).";
CM_ SG_ 1807 UNK_15_1 "Expanded-corpus correction: Mostly set on newborn zero-range rows, with exceptions; not a validity gate. See docs/14.";
CM_ SG_ 1807 SCORE_CODE "Bounded score-like byte, not calibrated confidence or percent. Value 100 does not guarantee accurate geometry or velocity.";
CM_ SG_ 1807 AGE "Track age in radar cycles (~60 ms): 1 at birth, saturates at 126; 0 = slot being retired (geometry is the previous occupant's). A restart is a new track. Tracks younger than ~60 carry unconverged range and velocity.";
CM_ SG_ 1807 CONST_31_1 "Constant 0 (0x0) in the original small-corpus survey; not proof of reserved/padding bits or universal constancy.";
CM_ SG_ 1807 DREL "Longitudinal distance forward of the radar, m. 1/16 m, zero code 160 (exactly -10 m). Camera ground contact at 5-25 m: slope 0.99-1.00 on three drives, zero within 0.2 m (0.7 m on a hilly drive). Settled tracks walk by metres record to record at 40 m+; young tracks can be far off.";
CM_ SG_ 1807 YREL_LEFT "Lateral offset, LEFT positive (openpilot yRel), m. 1/64 m, offset binary around 2048. Cartesian (constant across range), not an angle. Correct side 97.9-99.3% on held-out drives; scale bounded to about +/-10%. |code-2048| >= 2000 is a sentinel.";
CM_ SG_ 1807 UNK_56_7 "Candidate from the carry-chain split, unverified: LSB flips 0.355 per cycle, 84 distinct values 4..96. Strongest correlation: age r=+0.30. Size / class candidate: per-track median follows camera vehicle height (partial rho 0.48-0.61 at fixed range) and truck/bus class (docs/14).";
CM_ SG_ 1807 UNK_63_1 "Expanded-corpus correction: Rare changing bit; only two rows in the expanded corpus. See docs/14.";
CM_ SG_ 1807 VLONG_OVER_GROUND "Longitudinal velocity OVER GROUND, m/s. 0.15 m/s/code, zero 510.5. vRel = this - ego speed. Radar-only scale check (own range slope vs GPS ego) gives 0.150/0.149/0.153 on three drives. Beats zero and range differencing against a camera reference, but has unflagged ~1 s excursions at range. Unsettled for age < ~60.";
CM_ SG_ 1807 VLAT_OVER_GROUND_PROV "Lateral velocity over ground, LEFT positive (sign confirmed). Scale NOT pinned: the factor shown (0.15) is a placeholder. Radar-only estimates from its own lateral position change range 0.097-0.147 m/s per code across data sets, and the pre-registered test was unverified. See docs/14.";
CM_ SG_ 1807 ALONG_LIKE_84 "Acceleration-like, zero code 511 at standstill. Follows the VLONG change with a ~0.5 s lag, so it cannot flag or lead a velocity excursion. Radar-only scale about 0.04 m/s^2 per code on most data but drive-dependent (0.03-0.11); centred codes (docs/14).";
CM_ SG_ 1807 CONST_94_2 "Constant 0 (0x0) in the original small-corpus survey; not proof of reserved/padding bits or universal constancy.";
CM_ SG_ 1807 UNK_96 "Lateral ground-acceleration-like candidate: (raw-511)*0.05 m/s^2, calibration provisional. Rotation-corrected kinematics and a discovery-selected +0.5 s lag transfer to further drives (r about 0.90). Raw code retained; no accuracy gate or runtime use. See docs/14 for route exceptions and reference limitations.";
CM_ SG_ 1807 UNK_106_1 "Candidate from the carry-chain split, unverified: LSB flips 0.003 per cycle, 2 distinct values 0..1. Strongest correlation: v_over_ground r=-0.14.";
CM_ SG_ 1807 UNK_107_1 "Candidate from the carry-chain split, unverified: LSB flips 0.013 per cycle, 2 distinct values 0..1. Strongest correlation: v_over_ground r=-0.24. Coasting-flag candidate: about 0.02 in settled life, 0.5-0.66 just before deletion (docs/14).";
CM_ SG_ 1807 CONST_108_1 "Constant 0 (0x0) in the original small-corpus survey; not proof of reserved/padding bits or universal constancy.";
CM_ SG_ 1807 MOVE_STATE "Legacy low-two-bit motion projection. Full code = MOVE_STATE | ((UNK_111_4 & 1) << 2). Full 3 is rightward-like, 4 leftward-like, 5 initialization/unsettled-like, 7 stopped-like; meanings provisional. Old labels conflate these states. See docs/14.";
CM_ SG_ 1807 UNK_111_4 "Candidate from the carry-chain split, unverified: LSB flips 0.008 per cycle, 10 distinct values 0..9. Strongest correlation: dRel r=-0.53.";
CM_ SG_ 1807 UNK_115_8 "Candidate from the carry-chain split, unverified: LSB flips 0.052 per cycle, 26 distinct values 0..178. Strongest correlation: age r=+0.27.";
CM_ SG_ 1807 CONST_123_5 "Constant 31 (0x1F) in the original small-corpus survey; not proof of reserved/padding bits or universal constancy.";
CM_ SG_ 1807 UNK_128_2 "Candidate from the carry-chain split, unverified: LSB flips 0.013 per cycle, 4 distinct values 0..3. Strongest correlation: dRel r=+0.11.";
CM_ SG_ 1807 UNK_130_1 "Candidate from the carry-chain split, unverified: LSB flips 0.019 per cycle, 2 distinct values 0..1. Strongest correlation: abs_yRel r=+0.34.";
CM_ SG_ 1807 UNK_131_4 "Candidate from the carry-chain split, unverified: LSB flips 0.102 per cycle, 9 distinct values 7..15. Strongest correlation: abs_yRel r=+0.09.";
CM_ SG_ 1807 CONST_135_1 "Constant 0 (0x0) in the original small-corpus survey; not proof of reserved/padding bits or universal constancy.";
CM_ SG_ 1807 UNK_136_6 "Candidate from the carry-chain split, unverified: LSB flips 0.093 per cycle, 39 distinct values 3..63. Strongest correlation: age r=+0.20.";
CM_ SG_ 1807 UNK_142_1 "Candidate from the carry-chain split, unverified: LSB flips 0.007 per cycle, 2 distinct values 0..1. Strongest correlation: age r=+0.47.";
CM_ SG_ 1807 CONST_143_5 "Constant 30 (0x1E) in the original small-corpus survey; not proof of reserved/padding bits or universal constancy.";
CM_ SG_ 1807 UNK_148_8 "Candidate from the carry-chain split, unverified: LSB flips 0.009 per cycle, 27 distinct values 0..240. Strongest correlation: dRel r=-0.12.Legacy combined view of two candidate weight nibbles148|4 and152|4: first=value&15, second=value>>4. Together with156|4, nonzero triplets nearly always sum to15 or16, with two observed sum14 exceptions. Physical outcomes and probability calibration remain unresolved (docs/14).";
CM_ SG_ 1807 UNK_156_4 "Candidate from the carry-chain split, unverified: LSB flips 0.016 per cycle, 16 distinct values 0..15. Strongest correlation: abs_yRel r=-0.42.Third component of the candidate weight triplet148/152/156|4. All-zero meaning and physical outcomes unknown; not an excursion or validity gate (docs/14).";
CM_ SG_ 1807 CONST_160_3 "Constant 0 (0x0) in the original small-corpus survey; not proof of reserved/padding bits or universal constancy.";
CM_ SG_ 1807 UNK_163_2 "Candidate from the carry-chain split, unverified: LSB flips 0.006 per cycle, 3 distinct values 1..3. Strongest correlation: age r=+0.30.";
CM_ SG_ 1807 UNK_165_3 "Expanded-corpus correction: Changes within some tracks; observed codes 0 and 1. See docs/14.";
CM_ SG_ 1807 UNK_168_10 "Candidate from the carry-chain split, unverified: LSB flips 0.066 per cycle, 3 distinct values 0..1023. Strongest correlation: abs_yRel r=+0.14.";
CM_ SG_ 1807 CONST_178_3 "Constant 0 (0x0) in the original small-corpus survey; not proof of reserved/padding bits or universal constancy.";
CM_ SG_ 1807 UNK_181_1 "Candidate from the carry-chain split, unverified: LSB flips 0.071 per cycle, 2 distinct values 0..1. Strongest correlation: v_over_ground r=+0.34.";
CM_ SG_ 1807 UNK_182_1 "Expanded-corpus correction: Rare changing bit; observed in one short track episode. See docs/14.";
CM_ SG_ 1807 UNK_183_7 "Candidate from the carry-chain split, unverified: LSB flips 0.009 per cycle, 24 distinct values 26..73. Strongest correlation: age r=+0.20.";
CM_ SG_ 1807 UNK_190_10 "Expanded-corpus correction: Observed codes 0 and 1. Usually follows positive age, with three exceptions; not a validity gate. See docs/14.";
CM_ SG_ 1807 UNK_200_7 "Candidate from the carry-chain split, unverified: LSB flips 0.023 per cycle, 16 distinct values 0..127. Strongest correlation: v_over_ground r=-0.45.";
CM_ SG_ 1807 CONST_207_1 "Constant 0 (0x0) in the original small-corpus survey; not proof of reserved/padding bits or universal constancy.";
CM_ SG_ 1807 UNK_208_6 "Candidate from the carry-chain split, unverified: LSB flips 0.017 per cycle, 20 distinct values 0..63. Strongest correlation: v_over_ground r=-0.38.Coarse nonnegative velocity-heading-like candidate, about pi/64 rad/code. Negative headings almost always map to zero. Raw code retained; not a complete signed orientation, independent Doppler or control gate. See docs/14.";
CM_ SG_ 1807 CONST_214_2 "Constant 0 (0x0) in the original small-corpus survey; not proof of reserved/padding bits or universal constancy.";
CM_ SG_ 1807 UNK_216_6 "Candidate from the carry-chain split, unverified: LSB flips 0.150 per cycle, 34 distinct values 3..49. Strongest correlation: age r=+0.23. Size / class candidate: camera vehicle height partial rho 0.44-0.63, truck/bus 0.35-0.42; width on A/C. Compare ARS4-B Length / dZ (6 bits) (docs/14).";
CM_ SG_ 1807 CONST_222_2 "Constant 0 (0x0) in the original small-corpus survey; not proof of reserved/padding bits or universal constancy.";
CM_ SG_ 1807 UNK_224_7 "Candidate from the carry-chain split, unverified: LSB flips 0.344 per cycle, 127 distinct values 1..127. Strongest correlation: dRel r=+0.80. Uncertainty candidate: scales with range (r~0.8), falls with age at fixed range (rho -0.29 to -0.36), larger when range steps are noisier, rises before deletion. Weak near-range error indicator; does not single out excursions.";
CM_ SG_ 1807 CONST_231_1 "Constant 0 (0x0) in the original small-corpus survey; not proof of reserved/padding bits or universal constancy.";
CM_ SG_ 1807 UNK_232_7 "Candidate from the carry-chain split, unverified: LSB flips 0.096 per cycle, 72 distinct values 0..127. Strongest correlation: abs_yRel r=+0.60. Lateral-uncertainty candidate: scales with |yRel| (r~0.6), falls with age at fixed range (rho -0.50 to -0.59).";
CM_ SG_ 1807 UNK_239_1 "Expanded-corpus correction: Changes within tracks; often active near birth. The former PER_TRACK label was too strong. See docs/14.";
CM_ SG_ 1807 UNK_240_7 "Candidate from the carry-chain split, unverified: LSB flips 0.364 per cycle, 127 distinct values 1..127. Strongest correlation: dRel r=+0.80. Velocity-uncertainty candidate (like ARS408 VrelLong_rms): scales with range, falls with age, rises before deletion. Flags velocity glitches: stratified AUC 0.65 / 0.85 (discovery / confirmation) against clean labels where native vRel disagrees with both the radar ACC target (0x235) and vision (docs/15). Decoded as vel_unc_code.";
CM_ SG_ 1807 CONST_247_1 "Constant 0 (0x0) in the original small-corpus survey; not proof of reserved/padding bits or universal constancy.";
CM_ SG_ 1807 UNK_248_7 "Candidate from the carry-chain split, unverified: LSB flips 0.116 per cycle, 97 distinct values 0..127. Strongest correlation: abs_yRel r=+0.56. Uncertainty candidate: scales with |yRel| (r~0.56), falls with age at fixed range (rho -0.70 to -0.75).";
CM_ SG_ 1807 CONST_255_1 "Constant 0 (0x0) in the original small-corpus survey; not proof of reserved/padding bits or universal constancy.";
CM_ SG_ 1807 UNK_256_6 "Expanded-corpus correction: Expanded raw window: repeated 31-to-32 and reverse carries in discovery, confirmation and further drives. Full field width, units and meaning unresolved. See docs/14.";
CM_ SG_ 1807 UNK_262_2 "Expanded-corpus correction: Remaining upper bits are not universally constant. May belong to the preceding quantity; boundary unresolved. See docs/14.";
CM_ SG_ 1807 UNK_264_5 "Expanded-corpus correction: Expanded raw window: repeated 15-to-16 and reverse carries. Full field width and scan/uncertainty semantics unresolved; old four-bit analyses used only its low bits. See docs/14.";
CM_ SG_ 1807 UNK_269_3 "Expanded-corpus correction: Rare nonzero upper bits; may belong to the preceding quantity. Boundary unresolved. See docs/14.";
CM_ SG_ 1807 UNK_272_5 "Candidate from the carry-chain split, unverified: LSB flips 0.095 per cycle, 17 distinct values 2..18. Strongest correlation: age r=+0.30. Size / class candidate: camera vehicle height partial rho 0.41-0.71, width 0.36-0.69, truck/bus 0.24-0.39 (docs/14).";
CM_ SG_ 1807 CONST_277_11 "Constant 0 (0x0) in the original small-corpus survey; not proof of reserved/padding bits or universal constancy.";
CM_ BO_ 1808 "Reassembled 0x80 object slot 16 (record bytes 593-628), sent only when occupied. Little-endian bit field: bit 0 = LSB of slot byte 0.";
CM_ SG_ 1808 STATE_CODE "Raw lifecycle state. Measured/predicted semantics not proved; not an accuracy gate.";
CM_ SG_ 1808 SLOT_INDEX_CODE "Physical slot index or 63 in unallocated-form headers; verified against slot positions. Not class or reference point.";
CM_ SG_ 1808 UNK_8_6 "Candidate from the carry-chain split, unverified: LSB flips 0.103 per cycle, 32 distinct values 30..62. Strongest correlation: age r=+0.55.Legacy combined raw view: low five bits follow an exact startup decay while full movement code109|3 remains5 from birth; bit13 can change separately. Extract low5=value&31 and bit13=value>>5. Mature meaning, units and probability interpretation unresolved; not a validity or excursion gate. See docs/14.";
CM_ SG_ 1808 ONCOMING_FLAG "1 = oncoming now or earlier in the track life (persists after an oncoming object slows). Pre-registered test on unseen segments: over-ground speed < 0 on 100% of flagged rows, 88.5% of objects approaching faster than 2 m/s flagged (docs/14).";
CM_ SG_ 1808 UNK_15_1 "Expanded-corpus correction: Mostly set on newborn zero-range rows, with exceptions; not a validity gate. See docs/14.";
CM_ SG_ 1808 SCORE_CODE "Bounded score-like byte, not calibrated confidence or percent. Value 100 does not guarantee accurate geometry or velocity.";
CM_ SG_ 1808 AGE "Track age in radar cycles (~60 ms): 1 at birth, saturates at 126; 0 = slot being retired (geometry is the previous occupant's). A restart is a new track. Tracks younger than ~60 carry unconverged range and velocity.";
CM_ SG_ 1808 CONST_31_1 "Constant 0 (0x0) in the original small-corpus survey; not proof of reserved/padding bits or universal constancy.";
CM_ SG_ 1808 DREL "Longitudinal distance forward of the radar, m. 1/16 m, zero code 160 (exactly -10 m). Camera ground contact at 5-25 m: slope 0.99-1.00 on three drives, zero within 0.2 m (0.7 m on a hilly drive). Settled tracks walk by metres record to record at 40 m+; young tracks can be far off.";
CM_ SG_ 1808 YREL_LEFT "Lateral offset, LEFT positive (openpilot yRel), m. 1/64 m, offset binary around 2048. Cartesian (constant across range), not an angle. Correct side 97.9-99.3% on held-out drives; scale bounded to about +/-10%. |code-2048| >= 2000 is a sentinel.";
CM_ SG_ 1808 UNK_56_7 "Candidate from the carry-chain split, unverified: LSB flips 0.355 per cycle, 84 distinct values 4..96. Strongest correlation: age r=+0.30. Size / class candidate: per-track median follows camera vehicle height (partial rho 0.48-0.61 at fixed range) and truck/bus class (docs/14).";
CM_ SG_ 1808 UNK_63_1 "Expanded-corpus correction: Rare changing bit; only two rows in the expanded corpus. See docs/14.";
CM_ SG_ 1808 VLONG_OVER_GROUND "Longitudinal velocity OVER GROUND, m/s. 0.15 m/s/code, zero 510.5. vRel = this - ego speed. Radar-only scale check (own range slope vs GPS ego) gives 0.150/0.149/0.153 on three drives. Beats zero and range differencing against a camera reference, but has unflagged ~1 s excursions at range. Unsettled for age < ~60.";
CM_ SG_ 1808 VLAT_OVER_GROUND_PROV "Lateral velocity over ground, LEFT positive (sign confirmed). Scale NOT pinned: the factor shown (0.15) is a placeholder. Radar-only estimates from its own lateral position change range 0.097-0.147 m/s per code across data sets, and the pre-registered test was unverified. See docs/14.";
CM_ SG_ 1808 ALONG_LIKE_84 "Acceleration-like, zero code 511 at standstill. Follows the VLONG change with a ~0.5 s lag, so it cannot flag or lead a velocity excursion. Radar-only scale about 0.04 m/s^2 per code on most data but drive-dependent (0.03-0.11); centred codes (docs/14).";
CM_ SG_ 1808 CONST_94_2 "Constant 0 (0x0) in the original small-corpus survey; not proof of reserved/padding bits or universal constancy.";
CM_ SG_ 1808 UNK_96 "Lateral ground-acceleration-like candidate: (raw-511)*0.05 m/s^2, calibration provisional. Rotation-corrected kinematics and a discovery-selected +0.5 s lag transfer to further drives (r about 0.90). Raw code retained; no accuracy gate or runtime use. See docs/14 for route exceptions and reference limitations.";
CM_ SG_ 1808 UNK_106_1 "Candidate from the carry-chain split, unverified: LSB flips 0.003 per cycle, 2 distinct values 0..1. Strongest correlation: v_over_ground r=-0.14.";
CM_ SG_ 1808 UNK_107_1 "Candidate from the carry-chain split, unverified: LSB flips 0.013 per cycle, 2 distinct values 0..1. Strongest correlation: v_over_ground r=-0.24. Coasting-flag candidate: about 0.02 in settled life, 0.5-0.66 just before deletion (docs/14).";
CM_ SG_ 1808 CONST_108_1 "Constant 0 (0x0) in the original small-corpus survey; not proof of reserved/padding bits or universal constancy.";
CM_ SG_ 1808 MOVE_STATE "Legacy low-two-bit motion projection. Full code = MOVE_STATE | ((UNK_111_4 & 1) << 2). Full 3 is rightward-like, 4 leftward-like, 5 initialization/unsettled-like, 7 stopped-like; meanings provisional. Old labels conflate these states. See docs/14.";
CM_ SG_ 1808 UNK_111_4 "Candidate from the carry-chain split, unverified: LSB flips 0.008 per cycle, 10 distinct values 0..9. Strongest correlation: dRel r=-0.53.";
CM_ SG_ 1808 UNK_115_8 "Candidate from the carry-chain split, unverified: LSB flips 0.052 per cycle, 26 distinct values 0..178. Strongest correlation: age r=+0.27.";
CM_ SG_ 1808 CONST_123_5 "Constant 31 (0x1F) in the original small-corpus survey; not proof of reserved/padding bits or universal constancy.";
CM_ SG_ 1808 UNK_128_2 "Candidate from the carry-chain split, unverified: LSB flips 0.013 per cycle, 4 distinct values 0..3. Strongest correlation: dRel r=+0.11.";
CM_ SG_ 1808 UNK_130_1 "Candidate from the carry-chain split, unverified: LSB flips 0.019 per cycle, 2 distinct values 0..1. Strongest correlation: abs_yRel r=+0.34.";
CM_ SG_ 1808 UNK_131_4 "Candidate from the carry-chain split, unverified: LSB flips 0.102 per cycle, 9 distinct values 7..15. Strongest correlation: abs_yRel r=+0.09.";
CM_ SG_ 1808 CONST_135_1 "Constant 0 (0x0) in the original small-corpus survey; not proof of reserved/padding bits or universal constancy.";
CM_ SG_ 1808 UNK_136_6 "Candidate from the carry-chain split, unverified: LSB flips 0.093 per cycle, 39 distinct values 3..63. Strongest correlation: age r=+0.20.";
CM_ SG_ 1808 UNK_142_1 "Candidate from the carry-chain split, unverified: LSB flips 0.007 per cycle, 2 distinct values 0..1. Strongest correlation: age r=+0.47.";
CM_ SG_ 1808 CONST_143_5 "Constant 30 (0x1E) in the original small-corpus survey; not proof of reserved/padding bits or universal constancy.";
CM_ SG_ 1808 UNK_148_8 "Candidate from the carry-chain split, unverified: LSB flips 0.009 per cycle, 27 distinct values 0..240. Strongest correlation: dRel r=-0.12.Legacy combined view of two candidate weight nibbles148|4 and152|4: first=value&15, second=value>>4. Together with156|4, nonzero triplets nearly always sum to15 or16, with two observed sum14 exceptions. Physical outcomes and probability calibration remain unresolved (docs/14).";
CM_ SG_ 1808 UNK_156_4 "Candidate from the carry-chain split, unverified: LSB flips 0.016 per cycle, 16 distinct values 0..15. Strongest correlation: abs_yRel r=-0.42.Third component of the candidate weight triplet148/152/156|4. All-zero meaning and physical outcomes unknown; not an excursion or validity gate (docs/14).";
CM_ SG_ 1808 CONST_160_3 "Constant 0 (0x0) in the original small-corpus survey; not proof of reserved/padding bits or universal constancy.";
CM_ SG_ 1808 UNK_163_2 "Candidate from the carry-chain split, unverified: LSB flips 0.006 per cycle, 3 distinct values 1..3. Strongest correlation: age r=+0.30.";
CM_ SG_ 1808 UNK_165_3 "Expanded-corpus correction: Changes within some tracks; observed codes 0 and 1. See docs/14.";
CM_ SG_ 1808 UNK_168_10 "Candidate from the carry-chain split, unverified: LSB flips 0.066 per cycle, 3 distinct values 0..1023. Strongest correlation: abs_yRel r=+0.14.";
CM_ SG_ 1808 CONST_178_3 "Constant 0 (0x0) in the original small-corpus survey; not proof of reserved/padding bits or universal constancy.";
CM_ SG_ 1808 UNK_181_1 "Candidate from the carry-chain split, unverified: LSB flips 0.071 per cycle, 2 distinct values 0..1. Strongest correlation: v_over_ground r=+0.34.";
CM_ SG_ 1808 UNK_182_1 "Expanded-corpus correction: Rare changing bit; observed in one short track episode. See docs/14.";
CM_ SG_ 1808 UNK_183_7 "Candidate from the carry-chain split, unverified: LSB flips 0.009 per cycle, 24 distinct values 26..73. Strongest correlation: age r=+0.20.";
CM_ SG_ 1808 UNK_190_10 "Expanded-corpus correction: Observed codes 0 and 1. Usually follows positive age, with three exceptions; not a validity gate. See docs/14.";
CM_ SG_ 1808 UNK_200_7 "Candidate from the carry-chain split, unverified: LSB flips 0.023 per cycle, 16 distinct values 0..127. Strongest correlation: v_over_ground r=-0.45.";
CM_ SG_ 1808 CONST_207_1 "Constant 0 (0x0) in the original small-corpus survey; not proof of reserved/padding bits or universal constancy.";
CM_ SG_ 1808 UNK_208_6 "Candidate from the carry-chain split, unverified: LSB flips 0.017 per cycle, 20 distinct values 0..63. Strongest correlation: v_over_ground r=-0.38.Coarse nonnegative velocity-heading-like candidate, about pi/64 rad/code. Negative headings almost always map to zero. Raw code retained; not a complete signed orientation, independent Doppler or control gate. See docs/14.";
CM_ SG_ 1808 CONST_214_2 "Constant 0 (0x0) in the original small-corpus survey; not proof of reserved/padding bits or universal constancy.";
CM_ SG_ 1808 UNK_216_6 "Candidate from the carry-chain split, unverified: LSB flips 0.150 per cycle, 34 distinct values 3..49. Strongest correlation: age r=+0.23. Size / class candidate: camera vehicle height partial rho 0.44-0.63, truck/bus 0.35-0.42; width on A/C. Compare ARS4-B Length / dZ (6 bits) (docs/14).";
CM_ SG_ 1808 CONST_222_2 "Constant 0 (0x0) in the original small-corpus survey; not proof of reserved/padding bits or universal constancy.";
CM_ SG_ 1808 UNK_224_7 "Candidate from the carry-chain split, unverified: LSB flips 0.344 per cycle, 127 distinct values 1..127. Strongest correlation: dRel r=+0.80. Uncertainty candidate: scales with range (r~0.8), falls with age at fixed range (rho -0.29 to -0.36), larger when range steps are noisier, rises before deletion. Weak near-range error indicator; does not single out excursions.";
CM_ SG_ 1808 CONST_231_1 "Constant 0 (0x0) in the original small-corpus survey; not proof of reserved/padding bits or universal constancy.";
CM_ SG_ 1808 UNK_232_7 "Candidate from the carry-chain split, unverified: LSB flips 0.096 per cycle, 72 distinct values 0..127. Strongest correlation: abs_yRel r=+0.60. Lateral-uncertainty candidate: scales with |yRel| (r~0.6), falls with age at fixed range (rho -0.50 to -0.59).";
CM_ SG_ 1808 UNK_239_1 "Expanded-corpus correction: Changes within tracks; often active near birth. The former PER_TRACK label was too strong. See docs/14.";
CM_ SG_ 1808 UNK_240_7 "Candidate from the carry-chain split, unverified: LSB flips 0.364 per cycle, 127 distinct values 1..127. Strongest correlation: dRel r=+0.80. Velocity-uncertainty candidate (like ARS408 VrelLong_rms): scales with range, falls with age, rises before deletion. Flags velocity glitches: stratified AUC 0.65 / 0.85 (discovery / confirmation) against clean labels where native vRel disagrees with both the radar ACC target (0x235) and vision (docs/15). Decoded as vel_unc_code.";
CM_ SG_ 1808 CONST_247_1 "Constant 0 (0x0) in the original small-corpus survey; not proof of reserved/padding bits or universal constancy.";
CM_ SG_ 1808 UNK_248_7 "Candidate from the carry-chain split, unverified: LSB flips 0.116 per cycle, 97 distinct values 0..127. Strongest correlation: abs_yRel r=+0.56. Uncertainty candidate: scales with |yRel| (r~0.56), falls with age at fixed range (rho -0.70 to -0.75).";
CM_ SG_ 1808 CONST_255_1 "Constant 0 (0x0) in the original small-corpus survey; not proof of reserved/padding bits or universal constancy.";
CM_ SG_ 1808 UNK_256_6 "Expanded-corpus correction: Expanded raw window: repeated 31-to-32 and reverse carries in discovery, confirmation and further drives. Full field width, units and meaning unresolved. See docs/14.";
CM_ SG_ 1808 UNK_262_2 "Expanded-corpus correction: Remaining upper bits are not universally constant. May belong to the preceding quantity; boundary unresolved. See docs/14.";
CM_ SG_ 1808 UNK_264_5 "Expanded-corpus correction: Expanded raw window: repeated 15-to-16 and reverse carries. Full field width and scan/uncertainty semantics unresolved; old four-bit analyses used only its low bits. See docs/14.";
CM_ SG_ 1808 UNK_269_3 "Expanded-corpus correction: Rare nonzero upper bits; may belong to the preceding quantity. Boundary unresolved. See docs/14.";
CM_ SG_ 1808 UNK_272_5 "Candidate from the carry-chain split, unverified: LSB flips 0.095 per cycle, 17 distinct values 2..18. Strongest correlation: age r=+0.30. Size / class candidate: camera vehicle height partial rho 0.41-0.71, width 0.36-0.69, truck/bus 0.24-0.39 (docs/14).";
CM_ SG_ 1808 CONST_277_11 "Constant 0 (0x0) in the original small-corpus survey; not proof of reserved/padding bits or universal constancy.";
CM_ BO_ 1809 "Reassembled 0x80 object slot 17 (record bytes 629-664), sent only when occupied. Little-endian bit field: bit 0 = LSB of slot byte 0.";
CM_ SG_ 1809 STATE_CODE "Raw lifecycle state. Measured/predicted semantics not proved; not an accuracy gate.";
CM_ SG_ 1809 SLOT_INDEX_CODE "Physical slot index or 63 in unallocated-form headers; verified against slot positions. Not class or reference point.";
CM_ SG_ 1809 UNK_8_6 "Candidate from the carry-chain split, unverified: LSB flips 0.103 per cycle, 32 distinct values 30..62. Strongest correlation: age r=+0.55.Legacy combined raw view: low five bits follow an exact startup decay while full movement code109|3 remains5 from birth; bit13 can change separately. Extract low5=value&31 and bit13=value>>5. Mature meaning, units and probability interpretation unresolved; not a validity or excursion gate. See docs/14.";
CM_ SG_ 1809 ONCOMING_FLAG "1 = oncoming now or earlier in the track life (persists after an oncoming object slows). Pre-registered test on unseen segments: over-ground speed < 0 on 100% of flagged rows, 88.5% of objects approaching faster than 2 m/s flagged (docs/14).";
CM_ SG_ 1809 UNK_15_1 "Expanded-corpus correction: Mostly set on newborn zero-range rows, with exceptions; not a validity gate. See docs/14.";
CM_ SG_ 1809 SCORE_CODE "Bounded score-like byte, not calibrated confidence or percent. Value 100 does not guarantee accurate geometry or velocity.";
CM_ SG_ 1809 AGE "Track age in radar cycles (~60 ms): 1 at birth, saturates at 126; 0 = slot being retired (geometry is the previous occupant's). A restart is a new track. Tracks younger than ~60 carry unconverged range and velocity.";
CM_ SG_ 1809 CONST_31_1 "Constant 0 (0x0) in the original small-corpus survey; not proof of reserved/padding bits or universal constancy.";
CM_ SG_ 1809 DREL "Longitudinal distance forward of the radar, m. 1/16 m, zero code 160 (exactly -10 m). Camera ground contact at 5-25 m: slope 0.99-1.00 on three drives, zero within 0.2 m (0.7 m on a hilly drive). Settled tracks walk by metres record to record at 40 m+; young tracks can be far off.";
CM_ SG_ 1809 YREL_LEFT "Lateral offset, LEFT positive (openpilot yRel), m. 1/64 m, offset binary around 2048. Cartesian (constant across range), not an angle. Correct side 97.9-99.3% on held-out drives; scale bounded to about +/-10%. |code-2048| >= 2000 is a sentinel.";
CM_ SG_ 1809 UNK_56_7 "Candidate from the carry-chain split, unverified: LSB flips 0.355 per cycle, 84 distinct values 4..96. Strongest correlation: age r=+0.30. Size / class candidate: per-track median follows camera vehicle height (partial rho 0.48-0.61 at fixed range) and truck/bus class (docs/14).";
CM_ SG_ 1809 UNK_63_1 "Expanded-corpus correction: Rare changing bit; only two rows in the expanded corpus. See docs/14.";
CM_ SG_ 1809 VLONG_OVER_GROUND "Longitudinal velocity OVER GROUND, m/s. 0.15 m/s/code, zero 510.5. vRel = this - ego speed. Radar-only scale check (own range slope vs GPS ego) gives 0.150/0.149/0.153 on three drives. Beats zero and range differencing against a camera reference, but has unflagged ~1 s excursions at range. Unsettled for age < ~60.";
CM_ SG_ 1809 VLAT_OVER_GROUND_PROV "Lateral velocity over ground, LEFT positive (sign confirmed). Scale NOT pinned: the factor shown (0.15) is a placeholder. Radar-only estimates from its own lateral position change range 0.097-0.147 m/s per code across data sets, and the pre-registered test was unverified. See docs/14.";
CM_ SG_ 1809 ALONG_LIKE_84 "Acceleration-like, zero code 511 at standstill. Follows the VLONG change with a ~0.5 s lag, so it cannot flag or lead a velocity excursion. Radar-only scale about 0.04 m/s^2 per code on most data but drive-dependent (0.03-0.11); centred codes (docs/14).";
CM_ SG_ 1809 CONST_94_2 "Constant 0 (0x0) in the original small-corpus survey; not proof of reserved/padding bits or universal constancy.";
CM_ SG_ 1809 UNK_96 "Lateral ground-acceleration-like candidate: (raw-511)*0.05 m/s^2, calibration provisional. Rotation-corrected kinematics and a discovery-selected +0.5 s lag transfer to further drives (r about 0.90). Raw code retained; no accuracy gate or runtime use. See docs/14 for route exceptions and reference limitations.";
CM_ SG_ 1809 UNK_106_1 "Candidate from the carry-chain split, unverified: LSB flips 0.003 per cycle, 2 distinct values 0..1. Strongest correlation: v_over_ground r=-0.14.";
CM_ SG_ 1809 UNK_107_1 "Candidate from the carry-chain split, unverified: LSB flips 0.013 per cycle, 2 distinct values 0..1. Strongest correlation: v_over_ground r=-0.24. Coasting-flag candidate: about 0.02 in settled life, 0.5-0.66 just before deletion (docs/14).";
CM_ SG_ 1809 CONST_108_1 "Constant 0 (0x0) in the original small-corpus survey; not proof of reserved/padding bits or universal constancy.";
CM_ SG_ 1809 MOVE_STATE "Legacy low-two-bit motion projection. Full code = MOVE_STATE | ((UNK_111_4 & 1) << 2). Full 3 is rightward-like, 4 leftward-like, 5 initialization/unsettled-like, 7 stopped-like; meanings provisional. Old labels conflate these states. See docs/14.";
CM_ SG_ 1809 UNK_111_4 "Candidate from the carry-chain split, unverified: LSB flips 0.008 per cycle, 10 distinct values 0..9. Strongest correlation: dRel r=-0.53.";
CM_ SG_ 1809 UNK_115_8 "Candidate from the carry-chain split, unverified: LSB flips 0.052 per cycle, 26 distinct values 0..178. Strongest correlation: age r=+0.27.";
CM_ SG_ 1809 CONST_123_5 "Constant 31 (0x1F) in the original small-corpus survey; not proof of reserved/padding bits or universal constancy.";
CM_ SG_ 1809 UNK_128_2 "Candidate from the carry-chain split, unverified: LSB flips 0.013 per cycle, 4 distinct values 0..3. Strongest correlation: dRel r=+0.11.";
CM_ SG_ 1809 UNK_130_1 "Candidate from the carry-chain split, unverified: LSB flips 0.019 per cycle, 2 distinct values 0..1. Strongest correlation: abs_yRel r=+0.34.";
CM_ SG_ 1809 UNK_131_4 "Candidate from the carry-chain split, unverified: LSB flips 0.102 per cycle, 9 distinct values 7..15. Strongest correlation: abs_yRel r=+0.09.";
CM_ SG_ 1809 CONST_135_1 "Constant 0 (0x0) in the original small-corpus survey; not proof of reserved/padding bits or universal constancy.";
CM_ SG_ 1809 UNK_136_6 "Candidate from the carry-chain split, unverified: LSB flips 0.093 per cycle, 39 distinct values 3..63. Strongest correlation: age r=+0.20.";
CM_ SG_ 1809 UNK_142_1 "Candidate from the carry-chain split, unverified: LSB flips 0.007 per cycle, 2 distinct values 0..1. Strongest correlation: age r=+0.47.";
CM_ SG_ 1809 CONST_143_5 "Constant 30 (0x1E) in the original small-corpus survey; not proof of reserved/padding bits or universal constancy.";
CM_ SG_ 1809 UNK_148_8 "Candidate from the carry-chain split, unverified: LSB flips 0.009 per cycle, 27 distinct values 0..240. Strongest correlation: dRel r=-0.12.Legacy combined view of two candidate weight nibbles148|4 and152|4: first=value&15, second=value>>4. Together with156|4, nonzero triplets nearly always sum to15 or16, with two observed sum14 exceptions. Physical outcomes and probability calibration remain unresolved (docs/14).";
CM_ SG_ 1809 UNK_156_4 "Candidate from the carry-chain split, unverified: LSB flips 0.016 per cycle, 16 distinct values 0..15. Strongest correlation: abs_yRel r=-0.42.Third component of the candidate weight triplet148/152/156|4. All-zero meaning and physical outcomes unknown; not an excursion or validity gate (docs/14).";
CM_ SG_ 1809 CONST_160_3 "Constant 0 (0x0) in the original small-corpus survey; not proof of reserved/padding bits or universal constancy.";
CM_ SG_ 1809 UNK_163_2 "Candidate from the carry-chain split, unverified: LSB flips 0.006 per cycle, 3 distinct values 1..3. Strongest correlation: age r=+0.30.";
CM_ SG_ 1809 UNK_165_3 "Expanded-corpus correction: Changes within some tracks; observed codes 0 and 1. See docs/14.";
CM_ SG_ 1809 UNK_168_10 "Candidate from the carry-chain split, unverified: LSB flips 0.066 per cycle, 3 distinct values 0..1023. Strongest correlation: abs_yRel r=+0.14.";
CM_ SG_ 1809 CONST_178_3 "Constant 0 (0x0) in the original small-corpus survey; not proof of reserved/padding bits or universal constancy.";
CM_ SG_ 1809 UNK_181_1 "Candidate from the carry-chain split, unverified: LSB flips 0.071 per cycle, 2 distinct values 0..1. Strongest correlation: v_over_ground r=+0.34.";
CM_ SG_ 1809 UNK_182_1 "Expanded-corpus correction: Rare changing bit; observed in one short track episode. See docs/14.";
CM_ SG_ 1809 UNK_183_7 "Candidate from the carry-chain split, unverified: LSB flips 0.009 per cycle, 24 distinct values 26..73. Strongest correlation: age r=+0.20.";
CM_ SG_ 1809 UNK_190_10 "Expanded-corpus correction: Observed codes 0 and 1. Usually follows positive age, with three exceptions; not a validity gate. See docs/14.";
CM_ SG_ 1809 UNK_200_7 "Candidate from the carry-chain split, unverified: LSB flips 0.023 per cycle, 16 distinct values 0..127. Strongest correlation: v_over_ground r=-0.45.";
CM_ SG_ 1809 CONST_207_1 "Constant 0 (0x0) in the original small-corpus survey; not proof of reserved/padding bits or universal constancy.";
CM_ SG_ 1809 UNK_208_6 "Candidate from the carry-chain split, unverified: LSB flips 0.017 per cycle, 20 distinct values 0..63. Strongest correlation: v_over_ground r=-0.38.Coarse nonnegative velocity-heading-like candidate, about pi/64 rad/code. Negative headings almost always map to zero. Raw code retained; not a complete signed orientation, independent Doppler or control gate. See docs/14.";
CM_ SG_ 1809 CONST_214_2 "Constant 0 (0x0) in the original small-corpus survey; not proof of reserved/padding bits or universal constancy.";
CM_ SG_ 1809 UNK_216_6 "Candidate from the carry-chain split, unverified: LSB flips 0.150 per cycle, 34 distinct values 3..49. Strongest correlation: age r=+0.23. Size / class candidate: camera vehicle height partial rho 0.44-0.63, truck/bus 0.35-0.42; width on A/C. Compare ARS4-B Length / dZ (6 bits) (docs/14).";
CM_ SG_ 1809 CONST_222_2 "Constant 0 (0x0) in the original small-corpus survey; not proof of reserved/padding bits or universal constancy.";
CM_ SG_ 1809 UNK_224_7 "Candidate from the carry-chain split, unverified: LSB flips 0.344 per cycle, 127 distinct values 1..127. Strongest correlation: dRel r=+0.80. Uncertainty candidate: scales with range (r~0.8), falls with age at fixed range (rho -0.29 to -0.36), larger when range steps are noisier, rises before deletion. Weak near-range error indicator; does not single out excursions.";
CM_ SG_ 1809 CONST_231_1 "Constant 0 (0x0) in the original small-corpus survey; not proof of reserved/padding bits or universal constancy.";
CM_ SG_ 1809 UNK_232_7 "Candidate from the carry-chain split, unverified: LSB flips 0.096 per cycle, 72 distinct values 0..127. Strongest correlation: abs_yRel r=+0.60. Lateral-uncertainty candidate: scales with |yRel| (r~0.6), falls with age at fixed range (rho -0.50 to -0.59).";
CM_ SG_ 1809 UNK_239_1 "Expanded-corpus correction: Changes within tracks; often active near birth. The former PER_TRACK label was too strong. See docs/14.";
CM_ SG_ 1809 UNK_240_7 "Candidate from the carry-chain split, unverified: LSB flips 0.364 per cycle, 127 distinct values 1..127. Strongest correlation: dRel r=+0.80. Velocity-uncertainty candidate (like ARS408 VrelLong_rms): scales with range, falls with age, rises before deletion. Flags velocity glitches: stratified AUC 0.65 / 0.85 (discovery / confirmation) against clean labels where native vRel disagrees with both the radar ACC target (0x235) and vision (docs/15). Decoded as vel_unc_code.";
CM_ SG_ 1809 CONST_247_1 "Constant 0 (0x0) in the original small-corpus survey; not proof of reserved/padding bits or universal constancy.";
CM_ SG_ 1809 UNK_248_7 "Candidate from the carry-chain split, unverified: LSB flips 0.116 per cycle, 97 distinct values 0..127. Strongest correlation: abs_yRel r=+0.56. Uncertainty candidate: scales with |yRel| (r~0.56), falls with age at fixed range (rho -0.70 to -0.75).";
CM_ SG_ 1809 CONST_255_1 "Constant 0 (0x0) in the original small-corpus survey; not proof of reserved/padding bits or universal constancy.";
CM_ SG_ 1809 UNK_256_6 "Expanded-corpus correction: Expanded raw window: repeated 31-to-32 and reverse carries in discovery, confirmation and further drives. Full field width, units and meaning unresolved. See docs/14.";
CM_ SG_ 1809 UNK_262_2 "Expanded-corpus correction: Remaining upper bits are not universally constant. May belong to the preceding quantity; boundary unresolved. See docs/14.";
CM_ SG_ 1809 UNK_264_5 "Expanded-corpus correction: Expanded raw window: repeated 15-to-16 and reverse carries. Full field width and scan/uncertainty semantics unresolved; old four-bit analyses used only its low bits. See docs/14.";
CM_ SG_ 1809 UNK_269_3 "Expanded-corpus correction: Rare nonzero upper bits; may belong to the preceding quantity. Boundary unresolved. See docs/14.";
CM_ SG_ 1809 UNK_272_5 "Candidate from the carry-chain split, unverified: LSB flips 0.095 per cycle, 17 distinct values 2..18. Strongest correlation: age r=+0.30. Size / class candidate: camera vehicle height partial rho 0.41-0.71, width 0.36-0.69, truck/bus 0.24-0.39 (docs/14).";
CM_ SG_ 1809 CONST_277_11 "Constant 0 (0x0) in the original small-corpus survey; not proof of reserved/padding bits or universal constancy.";
CM_ BO_ 1810 "Reassembled 0x80 object slot 18 (record bytes 665-700), sent only when occupied. Little-endian bit field: bit 0 = LSB of slot byte 0.";
CM_ SG_ 1810 STATE_CODE "Raw lifecycle state. Measured/predicted semantics not proved; not an accuracy gate.";
CM_ SG_ 1810 SLOT_INDEX_CODE "Physical slot index or 63 in unallocated-form headers; verified against slot positions. Not class or reference point.";
CM_ SG_ 1810 UNK_8_6 "Candidate from the carry-chain split, unverified: LSB flips 0.103 per cycle, 32 distinct values 30..62. Strongest correlation: age r=+0.55.Legacy combined raw view: low five bits follow an exact startup decay while full movement code109|3 remains5 from birth; bit13 can change separately. Extract low5=value&31 and bit13=value>>5. Mature meaning, units and probability interpretation unresolved; not a validity or excursion gate. See docs/14.";
CM_ SG_ 1810 ONCOMING_FLAG "1 = oncoming now or earlier in the track life (persists after an oncoming object slows). Pre-registered test on unseen segments: over-ground speed < 0 on 100% of flagged rows, 88.5% of objects approaching faster than 2 m/s flagged (docs/14).";
CM_ SG_ 1810 UNK_15_1 "Expanded-corpus correction: Mostly set on newborn zero-range rows, with exceptions; not a validity gate. See docs/14.";
CM_ SG_ 1810 SCORE_CODE "Bounded score-like byte, not calibrated confidence or percent. Value 100 does not guarantee accurate geometry or velocity.";
CM_ SG_ 1810 AGE "Track age in radar cycles (~60 ms): 1 at birth, saturates at 126; 0 = slot being retired (geometry is the previous occupant's). A restart is a new track. Tracks younger than ~60 carry unconverged range and velocity.";
CM_ SG_ 1810 CONST_31_1 "Constant 0 (0x0) in the original small-corpus survey; not proof of reserved/padding bits or universal constancy.";
CM_ SG_ 1810 DREL "Longitudinal distance forward of the radar, m. 1/16 m, zero code 160 (exactly -10 m). Camera ground contact at 5-25 m: slope 0.99-1.00 on three drives, zero within 0.2 m (0.7 m on a hilly drive). Settled tracks walk by metres record to record at 40 m+; young tracks can be far off.";
CM_ SG_ 1810 YREL_LEFT "Lateral offset, LEFT positive (openpilot yRel), m. 1/64 m, offset binary around 2048. Cartesian (constant across range), not an angle. Correct side 97.9-99.3% on held-out drives; scale bounded to about +/-10%. |code-2048| >= 2000 is a sentinel.";
CM_ SG_ 1810 UNK_56_7 "Candidate from the carry-chain split, unverified: LSB flips 0.355 per cycle, 84 distinct values 4..96. Strongest correlation: age r=+0.30. Size / class candidate: per-track median follows camera vehicle height (partial rho 0.48-0.61 at fixed range) and truck/bus class (docs/14).";
CM_ SG_ 1810 UNK_63_1 "Expanded-corpus correction: Rare changing bit; only two rows in the expanded corpus. See docs/14.";
CM_ SG_ 1810 VLONG_OVER_GROUND "Longitudinal velocity OVER GROUND, m/s. 0.15 m/s/code, zero 510.5. vRel = this - ego speed. Radar-only scale check (own range slope vs GPS ego) gives 0.150/0.149/0.153 on three drives. Beats zero and range differencing against a camera reference, but has unflagged ~1 s excursions at range. Unsettled for age < ~60.";
CM_ SG_ 1810 VLAT_OVER_GROUND_PROV "Lateral velocity over ground, LEFT positive (sign confirmed). Scale NOT pinned: the factor shown (0.15) is a placeholder. Radar-only estimates from its own lateral position change range 0.097-0.147 m/s per code across data sets, and the pre-registered test was unverified. See docs/14.";
CM_ SG_ 1810 ALONG_LIKE_84 "Acceleration-like, zero code 511 at standstill. Follows the VLONG change with a ~0.5 s lag, so it cannot flag or lead a velocity excursion. Radar-only scale about 0.04 m/s^2 per code on most data but drive-dependent (0.03-0.11); centred codes (docs/14).";
CM_ SG_ 1810 CONST_94_2 "Constant 0 (0x0) in the original small-corpus survey; not proof of reserved/padding bits or universal constancy.";
CM_ SG_ 1810 UNK_96 "Lateral ground-acceleration-like candidate: (raw-511)*0.05 m/s^2, calibration provisional. Rotation-corrected kinematics and a discovery-selected +0.5 s lag transfer to further drives (r about 0.90). Raw code retained; no accuracy gate or runtime use. See docs/14 for route exceptions and reference limitations.";
CM_ SG_ 1810 UNK_106_1 "Candidate from the carry-chain split, unverified: LSB flips 0.003 per cycle, 2 distinct values 0..1. Strongest correlation: v_over_ground r=-0.14.";
CM_ SG_ 1810 UNK_107_1 "Candidate from the carry-chain split, unverified: LSB flips 0.013 per cycle, 2 distinct values 0..1. Strongest correlation: v_over_ground r=-0.24. Coasting-flag candidate: about 0.02 in settled life, 0.5-0.66 just before deletion (docs/14).";
CM_ SG_ 1810 CONST_108_1 "Constant 0 (0x0) in the original small-corpus survey; not proof of reserved/padding bits or universal constancy.";
CM_ SG_ 1810 MOVE_STATE "Legacy low-two-bit motion projection. Full code = MOVE_STATE | ((UNK_111_4 & 1) << 2). Full 3 is rightward-like, 4 leftward-like, 5 initialization/unsettled-like, 7 stopped-like; meanings provisional. Old labels conflate these states. See docs/14.";
CM_ SG_ 1810 UNK_111_4 "Candidate from the carry-chain split, unverified: LSB flips 0.008 per cycle, 10 distinct values 0..9. Strongest correlation: dRel r=-0.53.";
CM_ SG_ 1810 UNK_115_8 "Candidate from the carry-chain split, unverified: LSB flips 0.052 per cycle, 26 distinct values 0..178. Strongest correlation: age r=+0.27.";
CM_ SG_ 1810 CONST_123_5 "Constant 31 (0x1F) in the original small-corpus survey; not proof of reserved/padding bits or universal constancy.";
CM_ SG_ 1810 UNK_128_2 "Candidate from the carry-chain split, unverified: LSB flips 0.013 per cycle, 4 distinct values 0..3. Strongest correlation: dRel r=+0.11.";
CM_ SG_ 1810 UNK_130_1 "Candidate from the carry-chain split, unverified: LSB flips 0.019 per cycle, 2 distinct values 0..1. Strongest correlation: abs_yRel r=+0.34.";
CM_ SG_ 1810 UNK_131_4 "Candidate from the carry-chain split, unverified: LSB flips 0.102 per cycle, 9 distinct values 7..15. Strongest correlation: abs_yRel r=+0.09.";
CM_ SG_ 1810 CONST_135_1 "Constant 0 (0x0) in the original small-corpus survey; not proof of reserved/padding bits or universal constancy.";
CM_ SG_ 1810 UNK_136_6 "Candidate from the carry-chain split, unverified: LSB flips 0.093 per cycle, 39 distinct values 3..63. Strongest correlation: age r=+0.20.";
CM_ SG_ 1810 UNK_142_1 "Candidate from the carry-chain split, unverified: LSB flips 0.007 per cycle, 2 distinct values 0..1. Strongest correlation: age r=+0.47.";
CM_ SG_ 1810 CONST_143_5 "Constant 30 (0x1E) in the original small-corpus survey; not proof of reserved/padding bits or universal constancy.";
CM_ SG_ 1810 UNK_148_8 "Candidate from the carry-chain split, unverified: LSB flips 0.009 per cycle, 27 distinct values 0..240. Strongest correlation: dRel r=-0.12.Legacy combined view of two candidate weight nibbles148|4 and152|4: first=value&15, second=value>>4. Together with156|4, nonzero triplets nearly always sum to15 or16, with two observed sum14 exceptions. Physical outcomes and probability calibration remain unresolved (docs/14).";
CM_ SG_ 1810 UNK_156_4 "Candidate from the carry-chain split, unverified: LSB flips 0.016 per cycle, 16 distinct values 0..15. Strongest correlation: abs_yRel r=-0.42.Third component of the candidate weight triplet148/152/156|4. All-zero meaning and physical outcomes unknown; not an excursion or validity gate (docs/14).";
CM_ SG_ 1810 CONST_160_3 "Constant 0 (0x0) in the original small-corpus survey; not proof of reserved/padding bits or universal constancy.";
CM_ SG_ 1810 UNK_163_2 "Candidate from the carry-chain split, unverified: LSB flips 0.006 per cycle, 3 distinct values 1..3. Strongest correlation: age r=+0.30.";
CM_ SG_ 1810 UNK_165_3 "Expanded-corpus correction: Changes within some tracks; observed codes 0 and 1. See docs/14.";
CM_ SG_ 1810 UNK_168_10 "Candidate from the carry-chain split, unverified: LSB flips 0.066 per cycle, 3 distinct values 0..1023. Strongest correlation: abs_yRel r=+0.14.";
CM_ SG_ 1810 CONST_178_3 "Constant 0 (0x0) in the original small-corpus survey; not proof of reserved/padding bits or universal constancy.";
CM_ SG_ 1810 UNK_181_1 "Candidate from the carry-chain split, unverified: LSB flips 0.071 per cycle, 2 distinct values 0..1. Strongest correlation: v_over_ground r=+0.34.";
CM_ SG_ 1810 UNK_182_1 "Expanded-corpus correction: Rare changing bit; observed in one short track episode. See docs/14.";
CM_ SG_ 1810 UNK_183_7 "Candidate from the carry-chain split, unverified: LSB flips 0.009 per cycle, 24 distinct values 26..73. Strongest correlation: age r=+0.20.";
CM_ SG_ 1810 UNK_190_10 "Expanded-corpus correction: Observed codes 0 and 1. Usually follows positive age, with three exceptions; not a validity gate. See docs/14.";
CM_ SG_ 1810 UNK_200_7 "Candidate from the carry-chain split, unverified: LSB flips 0.023 per cycle, 16 distinct values 0..127. Strongest correlation: v_over_ground r=-0.45.";
CM_ SG_ 1810 CONST_207_1 "Constant 0 (0x0) in the original small-corpus survey; not proof of reserved/padding bits or universal constancy.";
CM_ SG_ 1810 UNK_208_6 "Candidate from the carry-chain split, unverified: LSB flips 0.017 per cycle, 20 distinct values 0..63. Strongest correlation: v_over_ground r=-0.38.Coarse nonnegative velocity-heading-like candidate, about pi/64 rad/code. Negative headings almost always map to zero. Raw code retained; not a complete signed orientation, independent Doppler or control gate. See docs/14.";
CM_ SG_ 1810 CONST_214_2 "Constant 0 (0x0) in the original small-corpus survey; not proof of reserved/padding bits or universal constancy.";
CM_ SG_ 1810 UNK_216_6 "Candidate from the carry-chain split, unverified: LSB flips 0.150 per cycle, 34 distinct values 3..49. Strongest correlation: age r=+0.23. Size / class candidate: camera vehicle height partial rho 0.44-0.63, truck/bus 0.35-0.42; width on A/C. Compare ARS4-B Length / dZ (6 bits) (docs/14).";
CM_ SG_ 1810 CONST_222_2 "Constant 0 (0x0) in the original small-corpus survey; not proof of reserved/padding bits or universal constancy.";
CM_ SG_ 1810 UNK_224_7 "Candidate from the carry-chain split, unverified: LSB flips 0.344 per cycle, 127 distinct values 1..127. Strongest correlation: dRel r=+0.80. Uncertainty candidate: scales with range (r~0.8), falls with age at fixed range (rho -0.29 to -0.36), larger when range steps are noisier, rises before deletion. Weak near-range error indicator; does not single out excursions.";
CM_ SG_ 1810 CONST_231_1 "Constant 0 (0x0) in the original small-corpus survey; not proof of reserved/padding bits or universal constancy.";
CM_ SG_ 1810 UNK_232_7 "Candidate from the carry-chain split, unverified: LSB flips 0.096 per cycle, 72 distinct values 0..127. Strongest correlation: abs_yRel r=+0.60. Lateral-uncertainty candidate: scales with |yRel| (r~0.6), falls with age at fixed range (rho -0.50 to -0.59).";
CM_ SG_ 1810 UNK_239_1 "Expanded-corpus correction: Changes within tracks; often active near birth. The former PER_TRACK label was too strong. See docs/14.";
CM_ SG_ 1810 UNK_240_7 "Candidate from the carry-chain split, unverified: LSB flips 0.364 per cycle, 127 distinct values 1..127. Strongest correlation: dRel r=+0.80. Velocity-uncertainty candidate (like ARS408 VrelLong_rms): scales with range, falls with age, rises before deletion. Flags velocity glitches: stratified AUC 0.65 / 0.85 (discovery / confirmation) against clean labels where native vRel disagrees with both the radar ACC target (0x235) and vision (docs/15). Decoded as vel_unc_code.";
CM_ SG_ 1810 CONST_247_1 "Constant 0 (0x0) in the original small-corpus survey; not proof of reserved/padding bits or universal constancy.";
CM_ SG_ 1810 UNK_248_7 "Candidate from the carry-chain split, unverified: LSB flips 0.116 per cycle, 97 distinct values 0..127. Strongest correlation: abs_yRel r=+0.56. Uncertainty candidate: scales with |yRel| (r~0.56), falls with age at fixed range (rho -0.70 to -0.75).";
CM_ SG_ 1810 CONST_255_1 "Constant 0 (0x0) in the original small-corpus survey; not proof of reserved/padding bits or universal constancy.";
CM_ SG_ 1810 UNK_256_6 "Expanded-corpus correction: Expanded raw window: repeated 31-to-32 and reverse carries in discovery, confirmation and further drives. Full field width, units and meaning unresolved. See docs/14.";
CM_ SG_ 1810 UNK_262_2 "Expanded-corpus correction: Remaining upper bits are not universally constant. May belong to the preceding quantity; boundary unresolved. See docs/14.";
CM_ SG_ 1810 UNK_264_5 "Expanded-corpus correction: Expanded raw window: repeated 15-to-16 and reverse carries. Full field width and scan/uncertainty semantics unresolved; old four-bit analyses used only its low bits. See docs/14.";
CM_ SG_ 1810 UNK_269_3 "Expanded-corpus correction: Rare nonzero upper bits; may belong to the preceding quantity. Boundary unresolved. See docs/14.";
CM_ SG_ 1810 UNK_272_5 "Candidate from the carry-chain split, unverified: LSB flips 0.095 per cycle, 17 distinct values 2..18. Strongest correlation: age r=+0.30. Size / class candidate: camera vehicle height partial rho 0.41-0.71, width 0.36-0.69, truck/bus 0.24-0.39 (docs/14).";
CM_ SG_ 1810 CONST_277_11 "Constant 0 (0x0) in the original small-corpus survey; not proof of reserved/padding bits or universal constancy.";
CM_ BO_ 1811 "Reassembled 0x80 object slot 19 (record bytes 701-736), sent only when occupied. Little-endian bit field: bit 0 = LSB of slot byte 0.";
CM_ SG_ 1811 STATE_CODE "Raw lifecycle state. Measured/predicted semantics not proved; not an accuracy gate.";
CM_ SG_ 1811 SLOT_INDEX_CODE "Physical slot index or 63 in unallocated-form headers; verified against slot positions. Not class or reference point.";
CM_ SG_ 1811 UNK_8_6 "Candidate from the carry-chain split, unverified: LSB flips 0.103 per cycle, 32 distinct values 30..62. Strongest correlation: age r=+0.55.Legacy combined raw view: low five bits follow an exact startup decay while full movement code109|3 remains5 from birth; bit13 can change separately. Extract low5=value&31 and bit13=value>>5. Mature meaning, units and probability interpretation unresolved; not a validity or excursion gate. See docs/14.";
CM_ SG_ 1811 ONCOMING_FLAG "1 = oncoming now or earlier in the track life (persists after an oncoming object slows). Pre-registered test on unseen segments: over-ground speed < 0 on 100% of flagged rows, 88.5% of objects approaching faster than 2 m/s flagged (docs/14).";
CM_ SG_ 1811 UNK_15_1 "Expanded-corpus correction: Mostly set on newborn zero-range rows, with exceptions; not a validity gate. See docs/14.";
CM_ SG_ 1811 SCORE_CODE "Bounded score-like byte, not calibrated confidence or percent. Value 100 does not guarantee accurate geometry or velocity.";
CM_ SG_ 1811 AGE "Track age in radar cycles (~60 ms): 1 at birth, saturates at 126; 0 = slot being retired (geometry is the previous occupant's). A restart is a new track. Tracks younger than ~60 carry unconverged range and velocity.";
CM_ SG_ 1811 CONST_31_1 "Constant 0 (0x0) in the original small-corpus survey; not proof of reserved/padding bits or universal constancy.";
CM_ SG_ 1811 DREL "Longitudinal distance forward of the radar, m. 1/16 m, zero code 160 (exactly -10 m). Camera ground contact at 5-25 m: slope 0.99-1.00 on three drives, zero within 0.2 m (0.7 m on a hilly drive). Settled tracks walk by metres record to record at 40 m+; young tracks can be far off.";
CM_ SG_ 1811 YREL_LEFT "Lateral offset, LEFT positive (openpilot yRel), m. 1/64 m, offset binary around 2048. Cartesian (constant across range), not an angle. Correct side 97.9-99.3% on held-out drives; scale bounded to about +/-10%. |code-2048| >= 2000 is a sentinel.";
CM_ SG_ 1811 UNK_56_7 "Candidate from the carry-chain split, unverified: LSB flips 0.355 per cycle, 84 distinct values 4..96. Strongest correlation: age r=+0.30. Size / class candidate: per-track median follows camera vehicle height (partial rho 0.48-0.61 at fixed range) and truck/bus class (docs/14).";
CM_ SG_ 1811 UNK_63_1 "Expanded-corpus correction: Rare changing bit; only two rows in the expanded corpus. See docs/14.";
CM_ SG_ 1811 VLONG_OVER_GROUND "Longitudinal velocity OVER GROUND, m/s. 0.15 m/s/code, zero 510.5. vRel = this - ego speed. Radar-only scale check (own range slope vs GPS ego) gives 0.150/0.149/0.153 on three drives. Beats zero and range differencing against a camera reference, but has unflagged ~1 s excursions at range. Unsettled for age < ~60.";
CM_ SG_ 1811 VLAT_OVER_GROUND_PROV "Lateral velocity over ground, LEFT positive (sign confirmed). Scale NOT pinned: the factor shown (0.15) is a placeholder. Radar-only estimates from its own lateral position change range 0.097-0.147 m/s per code across data sets, and the pre-registered test was unverified. See docs/14.";
CM_ SG_ 1811 ALONG_LIKE_84 "Acceleration-like, zero code 511 at standstill. Follows the VLONG change with a ~0.5 s lag, so it cannot flag or lead a velocity excursion. Radar-only scale about 0.04 m/s^2 per code on most data but drive-dependent (0.03-0.11); centred codes (docs/14).";
CM_ SG_ 1811 CONST_94_2 "Constant 0 (0x0) in the original small-corpus survey; not proof of reserved/padding bits or universal constancy.";
CM_ SG_ 1811 UNK_96 "Lateral ground-acceleration-like candidate: (raw-511)*0.05 m/s^2, calibration provisional. Rotation-corrected kinematics and a discovery-selected +0.5 s lag transfer to further drives (r about 0.90). Raw code retained; no accuracy gate or runtime use. See docs/14 for route exceptions and reference limitations.";
CM_ SG_ 1811 UNK_106_1 "Candidate from the carry-chain split, unverified: LSB flips 0.003 per cycle, 2 distinct values 0..1. Strongest correlation: v_over_ground r=-0.14.";
CM_ SG_ 1811 UNK_107_1 "Candidate from the carry-chain split, unverified: LSB flips 0.013 per cycle, 2 distinct values 0..1. Strongest correlation: v_over_ground r=-0.24. Coasting-flag candidate: about 0.02 in settled life, 0.5-0.66 just before deletion (docs/14).";
CM_ SG_ 1811 CONST_108_1 "Constant 0 (0x0) in the original small-corpus survey; not proof of reserved/padding bits or universal constancy.";
CM_ SG_ 1811 MOVE_STATE "Legacy low-two-bit motion projection. Full code = MOVE_STATE | ((UNK_111_4 & 1) << 2). Full 3 is rightward-like, 4 leftward-like, 5 initialization/unsettled-like, 7 stopped-like; meanings provisional. Old labels conflate these states. See docs/14.";
CM_ SG_ 1811 UNK_111_4 "Candidate from the carry-chain split, unverified: LSB flips 0.008 per cycle, 10 distinct values 0..9. Strongest correlation: dRel r=-0.53.";
CM_ SG_ 1811 UNK_115_8 "Candidate from the carry-chain split, unverified: LSB flips 0.052 per cycle, 26 distinct values 0..178. Strongest correlation: age r=+0.27.";
CM_ SG_ 1811 CONST_123_5 "Constant 31 (0x1F) in the original small-corpus survey; not proof of reserved/padding bits or universal constancy.";
CM_ SG_ 1811 UNK_128_2 "Candidate from the carry-chain split, unverified: LSB flips 0.013 per cycle, 4 distinct values 0..3. Strongest correlation: dRel r=+0.11.";
CM_ SG_ 1811 UNK_130_1 "Candidate from the carry-chain split, unverified: LSB flips 0.019 per cycle, 2 distinct values 0..1. Strongest correlation: abs_yRel r=+0.34.";
CM_ SG_ 1811 UNK_131_4 "Candidate from the carry-chain split, unverified: LSB flips 0.102 per cycle, 9 distinct values 7..15. Strongest correlation: abs_yRel r=+0.09.";
CM_ SG_ 1811 CONST_135_1 "Constant 0 (0x0) in the original small-corpus survey; not proof of reserved/padding bits or universal constancy.";
CM_ SG_ 1811 UNK_136_6 "Candidate from the carry-chain split, unverified: LSB flips 0.093 per cycle, 39 distinct values 3..63. Strongest correlation: age r=+0.20.";
CM_ SG_ 1811 UNK_142_1 "Candidate from the carry-chain split, unverified: LSB flips 0.007 per cycle, 2 distinct values 0..1. Strongest correlation: age r=+0.47.";
CM_ SG_ 1811 CONST_143_5 "Constant 30 (0x1E) in the original small-corpus survey; not proof of reserved/padding bits or universal constancy.";
CM_ SG_ 1811 UNK_148_8 "Candidate from the carry-chain split, unverified: LSB flips 0.009 per cycle, 27 distinct values 0..240. Strongest correlation: dRel r=-0.12.Legacy combined view of two candidate weight nibbles148|4 and152|4: first=value&15, second=value>>4. Together with156|4, nonzero triplets nearly always sum to15 or16, with two observed sum14 exceptions. Physical outcomes and probability calibration remain unresolved (docs/14).";
CM_ SG_ 1811 UNK_156_4 "Candidate from the carry-chain split, unverified: LSB flips 0.016 per cycle, 16 distinct values 0..15. Strongest correlation: abs_yRel r=-0.42.Third component of the candidate weight triplet148/152/156|4. All-zero meaning and physical outcomes unknown; not an excursion or validity gate (docs/14).";
CM_ SG_ 1811 CONST_160_3 "Constant 0 (0x0) in the original small-corpus survey; not proof of reserved/padding bits or universal constancy.";
CM_ SG_ 1811 UNK_163_2 "Candidate from the carry-chain split, unverified: LSB flips 0.006 per cycle, 3 distinct values 1..3. Strongest correlation: age r=+0.30.";
CM_ SG_ 1811 UNK_165_3 "Expanded-corpus correction: Changes within some tracks; observed codes 0 and 1. See docs/14.";
CM_ SG_ 1811 UNK_168_10 "Candidate from the carry-chain split, unverified: LSB flips 0.066 per cycle, 3 distinct values 0..1023. Strongest correlation: abs_yRel r=+0.14.";
CM_ SG_ 1811 CONST_178_3 "Constant 0 (0x0) in the original small-corpus survey; not proof of reserved/padding bits or universal constancy.";
CM_ SG_ 1811 UNK_181_1 "Candidate from the carry-chain split, unverified: LSB flips 0.071 per cycle, 2 distinct values 0..1. Strongest correlation: v_over_ground r=+0.34.";
CM_ SG_ 1811 UNK_182_1 "Expanded-corpus correction: Rare changing bit; observed in one short track episode. See docs/14.";
CM_ SG_ 1811 UNK_183_7 "Candidate from the carry-chain split, unverified: LSB flips 0.009 per cycle, 24 distinct values 26..73. Strongest correlation: age r=+0.20.";
CM_ SG_ 1811 UNK_190_10 "Expanded-corpus correction: Observed codes 0 and 1. Usually follows positive age, with three exceptions; not a validity gate. See docs/14.";
CM_ SG_ 1811 UNK_200_7 "Candidate from the carry-chain split, unverified: LSB flips 0.023 per cycle, 16 distinct values 0..127. Strongest correlation: v_over_ground r=-0.45.";
CM_ SG_ 1811 CONST_207_1 "Constant 0 (0x0) in the original small-corpus survey; not proof of reserved/padding bits or universal constancy.";
CM_ SG_ 1811 UNK_208_6 "Candidate from the carry-chain split, unverified: LSB flips 0.017 per cycle, 20 distinct values 0..63. Strongest correlation: v_over_ground r=-0.38.Coarse nonnegative velocity-heading-like candidate, about pi/64 rad/code. Negative headings almost always map to zero. Raw code retained; not a complete signed orientation, independent Doppler or control gate. See docs/14.";
CM_ SG_ 1811 CONST_214_2 "Constant 0 (0x0) in the original small-corpus survey; not proof of reserved/padding bits or universal constancy.";
CM_ SG_ 1811 UNK_216_6 "Candidate from the carry-chain split, unverified: LSB flips 0.150 per cycle, 34 distinct values 3..49. Strongest correlation: age r=+0.23. Size / class candidate: camera vehicle height partial rho 0.44-0.63, truck/bus 0.35-0.42; width on A/C. Compare ARS4-B Length / dZ (6 bits) (docs/14).";
CM_ SG_ 1811 CONST_222_2 "Constant 0 (0x0) in the original small-corpus survey; not proof of reserved/padding bits or universal constancy.";
CM_ SG_ 1811 UNK_224_7 "Candidate from the carry-chain split, unverified: LSB flips 0.344 per cycle, 127 distinct values 1..127. Strongest correlation: dRel r=+0.80. Uncertainty candidate: scales with range (r~0.8), falls with age at fixed range (rho -0.29 to -0.36), larger when range steps are noisier, rises before deletion. Weak near-range error indicator; does not single out excursions.";
CM_ SG_ 1811 CONST_231_1 "Constant 0 (0x0) in the original small-corpus survey; not proof of reserved/padding bits or universal constancy.";
CM_ SG_ 1811 UNK_232_7 "Candidate from the carry-chain split, unverified: LSB flips 0.096 per cycle, 72 distinct values 0..127. Strongest correlation: abs_yRel r=+0.60. Lateral-uncertainty candidate: scales with |yRel| (r~0.6), falls with age at fixed range (rho -0.50 to -0.59).";
CM_ SG_ 1811 UNK_239_1 "Expanded-corpus correction: Changes within tracks; often active near birth. The former PER_TRACK label was too strong. See docs/14.";
CM_ SG_ 1811 UNK_240_7 "Candidate from the carry-chain split, unverified: LSB flips 0.364 per cycle, 127 distinct values 1..127. Strongest correlation: dRel r=+0.80. Velocity-uncertainty candidate (like ARS408 VrelLong_rms): scales with range, falls with age, rises before deletion. Flags velocity glitches: stratified AUC 0.65 / 0.85 (discovery / confirmation) against clean labels where native vRel disagrees with both the radar ACC target (0x235) and vision (docs/15). Decoded as vel_unc_code.";
CM_ SG_ 1811 CONST_247_1 "Constant 0 (0x0) in the original small-corpus survey; not proof of reserved/padding bits or universal constancy.";
CM_ SG_ 1811 UNK_248_7 "Candidate from the carry-chain split, unverified: LSB flips 0.116 per cycle, 97 distinct values 0..127. Strongest correlation: abs_yRel r=+0.56. Uncertainty candidate: scales with |yRel| (r~0.56), falls with age at fixed range (rho -0.70 to -0.75).";
CM_ SG_ 1811 CONST_255_1 "Constant 0 (0x0) in the original small-corpus survey; not proof of reserved/padding bits or universal constancy.";
CM_ SG_ 1811 UNK_256_6 "Expanded-corpus correction: Expanded raw window: repeated 31-to-32 and reverse carries in discovery, confirmation and further drives. Full field width, units and meaning unresolved. See docs/14.";
CM_ SG_ 1811 UNK_262_2 "Expanded-corpus correction: Remaining upper bits are not universally constant. May belong to the preceding quantity; boundary unresolved. See docs/14.";
CM_ SG_ 1811 UNK_264_5 "Expanded-corpus correction: Expanded raw window: repeated 15-to-16 and reverse carries. Full field width and scan/uncertainty semantics unresolved; old four-bit analyses used only its low bits. See docs/14.";
CM_ SG_ 1811 UNK_269_3 "Expanded-corpus correction: Rare nonzero upper bits; may belong to the preceding quantity. Boundary unresolved. See docs/14.";
CM_ SG_ 1811 UNK_272_5 "Candidate from the carry-chain split, unverified: LSB flips 0.095 per cycle, 17 distinct values 2..18. Strongest correlation: age r=+0.30. Size / class candidate: camera vehicle height partial rho 0.41-0.71, width 0.36-0.69, truck/bus 0.24-0.39 (docs/14).";
CM_ SG_ 1811 CONST_277_11 "Constant 0 (0x0) in the original small-corpus survey; not proof of reserved/padding bits or universal constancy.";
CM_ BO_ 1824 "NOT radar bytes: values the ars510 interface computes for 0x80 slot 0, for plotting next to the raw fields.";
CM_ SG_ 1824 TRACK_ID_OP "trackId openpilot would see under OPENPILOT_CONFIG (held until age 60, re-link within 3.5 s); 0 when not published.";
CM_ SG_ 1824 TRACK_ID_RAW "trackId from the radar slot/age lifecycle alone (RAW_CONFIG).";
CM_ SG_ 1824 VREL "VLONG_OVER_GROUND - Toyota 0xB4 speed, m/s.";
CM_ SG_ 1824 V_EGO_0xB4 "Toyota 0xB4 SPEED used for VREL, m/s (reads ~1.5% below GPS / wheel speed).";
CM_ SG_ 1824 DREL_FUSED "Candidate, not in OPENPILOT_CONFIG: velocity-aided range (gain 0.1); halves short-term range walks vs the camera.";
CM_ SG_ 1824 VREL_SMOOTHED "Candidate, not in OPENPILOT_CONFIG: causal EMA on VREL, tau 0 s below 30 m rising to 1 s from 60 m; ~0.5 s later true braking.";
CM_ BO_ 1825 "NOT radar bytes: values the ars510 interface computes for 0x80 slot 1, for plotting next to the raw fields.";
CM_ SG_ 1825 TRACK_ID_OP "trackId openpilot would see under OPENPILOT_CONFIG (held until age 60, re-link within 3.5 s); 0 when not published.";
CM_ SG_ 1825 TRACK_ID_RAW "trackId from the radar slot/age lifecycle alone (RAW_CONFIG).";
CM_ SG_ 1825 VREL "VLONG_OVER_GROUND - Toyota 0xB4 speed, m/s.";
CM_ SG_ 1825 V_EGO_0xB4 "Toyota 0xB4 SPEED used for VREL, m/s (reads ~1.5% below GPS / wheel speed).";
CM_ SG_ 1825 DREL_FUSED "Candidate, not in OPENPILOT_CONFIG: velocity-aided range (gain 0.1); halves short-term range walks vs the camera.";
CM_ SG_ 1825 VREL_SMOOTHED "Candidate, not in OPENPILOT_CONFIG: causal EMA on VREL, tau 0 s below 30 m rising to 1 s from 60 m; ~0.5 s later true braking.";
CM_ BO_ 1826 "NOT radar bytes: values the ars510 interface computes for 0x80 slot 2, for plotting next to the raw fields.";
CM_ SG_ 1826 TRACK_ID_OP "trackId openpilot would see under OPENPILOT_CONFIG (held until age 60, re-link within 3.5 s); 0 when not published.";
CM_ SG_ 1826 TRACK_ID_RAW "trackId from the radar slot/age lifecycle alone (RAW_CONFIG).";
CM_ SG_ 1826 VREL "VLONG_OVER_GROUND - Toyota 0xB4 speed, m/s.";
CM_ SG_ 1826 V_EGO_0xB4 "Toyota 0xB4 SPEED used for VREL, m/s (reads ~1.5% below GPS / wheel speed).";
CM_ SG_ 1826 DREL_FUSED "Candidate, not in OPENPILOT_CONFIG: velocity-aided range (gain 0.1); halves short-term range walks vs the camera.";
CM_ SG_ 1826 VREL_SMOOTHED "Candidate, not in OPENPILOT_CONFIG: causal EMA on VREL, tau 0 s below 30 m rising to 1 s from 60 m; ~0.5 s later true braking.";
CM_ BO_ 1827 "NOT radar bytes: values the ars510 interface computes for 0x80 slot 3, for plotting next to the raw fields.";
CM_ SG_ 1827 TRACK_ID_OP "trackId openpilot would see under OPENPILOT_CONFIG (held until age 60, re-link within 3.5 s); 0 when not published.";
CM_ SG_ 1827 TRACK_ID_RAW "trackId from the radar slot/age lifecycle alone (RAW_CONFIG).";
CM_ SG_ 1827 VREL "VLONG_OVER_GROUND - Toyota 0xB4 speed, m/s.";
CM_ SG_ 1827 V_EGO_0xB4 "Toyota 0xB4 SPEED used for VREL, m/s (reads ~1.5% below GPS / wheel speed).";
CM_ SG_ 1827 DREL_FUSED "Candidate, not in OPENPILOT_CONFIG: velocity-aided range (gain 0.1); halves short-term range walks vs the camera.";
CM_ SG_ 1827 VREL_SMOOTHED "Candidate, not in OPENPILOT_CONFIG: causal EMA on VREL, tau 0 s below 30 m rising to 1 s from 60 m; ~0.5 s later true braking.";
CM_ BO_ 1828 "NOT radar bytes: values the ars510 interface computes for 0x80 slot 4, for plotting next to the raw fields.";
CM_ SG_ 1828 TRACK_ID_OP "trackId openpilot would see under OPENPILOT_CONFIG (held until age 60, re-link within 3.5 s); 0 when not published.";
CM_ SG_ 1828 TRACK_ID_RAW "trackId from the radar slot/age lifecycle alone (RAW_CONFIG).";
CM_ SG_ 1828 VREL "VLONG_OVER_GROUND - Toyota 0xB4 speed, m/s.";
CM_ SG_ 1828 V_EGO_0xB4 "Toyota 0xB4 SPEED used for VREL, m/s (reads ~1.5% below GPS / wheel speed).";
CM_ SG_ 1828 DREL_FUSED "Candidate, not in OPENPILOT_CONFIG: velocity-aided range (gain 0.1); halves short-term range walks vs the camera.";
CM_ SG_ 1828 VREL_SMOOTHED "Candidate, not in OPENPILOT_CONFIG: causal EMA on VREL, tau 0 s below 30 m rising to 1 s from 60 m; ~0.5 s later true braking.";
CM_ BO_ 1829 "NOT radar bytes: values the ars510 interface computes for 0x80 slot 5, for plotting next to the raw fields.";
CM_ SG_ 1829 TRACK_ID_OP "trackId openpilot would see under OPENPILOT_CONFIG (held until age 60, re-link within 3.5 s); 0 when not published.";
CM_ SG_ 1829 TRACK_ID_RAW "trackId from the radar slot/age lifecycle alone (RAW_CONFIG).";
CM_ SG_ 1829 VREL "VLONG_OVER_GROUND - Toyota 0xB4 speed, m/s.";
CM_ SG_ 1829 V_EGO_0xB4 "Toyota 0xB4 SPEED used for VREL, m/s (reads ~1.5% below GPS / wheel speed).";
CM_ SG_ 1829 DREL_FUSED "Candidate, not in OPENPILOT_CONFIG: velocity-aided range (gain 0.1); halves short-term range walks vs the camera.";
CM_ SG_ 1829 VREL_SMOOTHED "Candidate, not in OPENPILOT_CONFIG: causal EMA on VREL, tau 0 s below 30 m rising to 1 s from 60 m; ~0.5 s later true braking.";
CM_ BO_ 1830 "NOT radar bytes: values the ars510 interface computes for 0x80 slot 6, for plotting next to the raw fields.";
CM_ SG_ 1830 TRACK_ID_OP "trackId openpilot would see under OPENPILOT_CONFIG (held until age 60, re-link within 3.5 s); 0 when not published.";
CM_ SG_ 1830 TRACK_ID_RAW "trackId from the radar slot/age lifecycle alone (RAW_CONFIG).";
CM_ SG_ 1830 VREL "VLONG_OVER_GROUND - Toyota 0xB4 speed, m/s.";
CM_ SG_ 1830 V_EGO_0xB4 "Toyota 0xB4 SPEED used for VREL, m/s (reads ~1.5% below GPS / wheel speed).";
CM_ SG_ 1830 DREL_FUSED "Candidate, not in OPENPILOT_CONFIG: velocity-aided range (gain 0.1); halves short-term range walks vs the camera.";
CM_ SG_ 1830 VREL_SMOOTHED "Candidate, not in OPENPILOT_CONFIG: causal EMA on VREL, tau 0 s below 30 m rising to 1 s from 60 m; ~0.5 s later true braking.";
CM_ BO_ 1831 "NOT radar bytes: values the ars510 interface computes for 0x80 slot 7, for plotting next to the raw fields.";
CM_ SG_ 1831 TRACK_ID_OP "trackId openpilot would see under OPENPILOT_CONFIG (held until age 60, re-link within 3.5 s); 0 when not published.";
CM_ SG_ 1831 TRACK_ID_RAW "trackId from the radar slot/age lifecycle alone (RAW_CONFIG).";
CM_ SG_ 1831 VREL "VLONG_OVER_GROUND - Toyota 0xB4 speed, m/s.";
CM_ SG_ 1831 V_EGO_0xB4 "Toyota 0xB4 SPEED used for VREL, m/s (reads ~1.5% below GPS / wheel speed).";
CM_ SG_ 1831 DREL_FUSED "Candidate, not in OPENPILOT_CONFIG: velocity-aided range (gain 0.1); halves short-term range walks vs the camera.";
CM_ SG_ 1831 VREL_SMOOTHED "Candidate, not in OPENPILOT_CONFIG: causal EMA on VREL, tau 0 s below 30 m rising to 1 s from 60 m; ~0.5 s later true braking.";
CM_ BO_ 1832 "NOT radar bytes: values the ars510 interface computes for 0x80 slot 8, for plotting next to the raw fields.";
CM_ SG_ 1832 TRACK_ID_OP "trackId openpilot would see under OPENPILOT_CONFIG (held until age 60, re-link within 3.5 s); 0 when not published.";
CM_ SG_ 1832 TRACK_ID_RAW "trackId from the radar slot/age lifecycle alone (RAW_CONFIG).";
CM_ SG_ 1832 VREL "VLONG_OVER_GROUND - Toyota 0xB4 speed, m/s.";
CM_ SG_ 1832 V_EGO_0xB4 "Toyota 0xB4 SPEED used for VREL, m/s (reads ~1.5% below GPS / wheel speed).";
CM_ SG_ 1832 DREL_FUSED "Candidate, not in OPENPILOT_CONFIG: velocity-aided range (gain 0.1); halves short-term range walks vs the camera.";
CM_ SG_ 1832 VREL_SMOOTHED "Candidate, not in OPENPILOT_CONFIG: causal EMA on VREL, tau 0 s below 30 m rising to 1 s from 60 m; ~0.5 s later true braking.";
CM_ BO_ 1833 "NOT radar bytes: values the ars510 interface computes for 0x80 slot 9, for plotting next to the raw fields.";
CM_ SG_ 1833 TRACK_ID_OP "trackId openpilot would see under OPENPILOT_CONFIG (held until age 60, re-link within 3.5 s); 0 when not published.";
CM_ SG_ 1833 TRACK_ID_RAW "trackId from the radar slot/age lifecycle alone (RAW_CONFIG).";
CM_ SG_ 1833 VREL "VLONG_OVER_GROUND - Toyota 0xB4 speed, m/s.";
CM_ SG_ 1833 V_EGO_0xB4 "Toyota 0xB4 SPEED used for VREL, m/s (reads ~1.5% below GPS / wheel speed).";
CM_ SG_ 1833 DREL_FUSED "Candidate, not in OPENPILOT_CONFIG: velocity-aided range (gain 0.1); halves short-term range walks vs the camera.";
CM_ SG_ 1833 VREL_SMOOTHED "Candidate, not in OPENPILOT_CONFIG: causal EMA on VREL, tau 0 s below 30 m rising to 1 s from 60 m; ~0.5 s later true braking.";
CM_ BO_ 1834 "NOT radar bytes: values the ars510 interface computes for 0x80 slot 10, for plotting next to the raw fields.";
CM_ SG_ 1834 TRACK_ID_OP "trackId openpilot would see under OPENPILOT_CONFIG (held until age 60, re-link within 3.5 s); 0 when not published.";
CM_ SG_ 1834 TRACK_ID_RAW "trackId from the radar slot/age lifecycle alone (RAW_CONFIG).";
CM_ SG_ 1834 VREL "VLONG_OVER_GROUND - Toyota 0xB4 speed, m/s.";
CM_ SG_ 1834 V_EGO_0xB4 "Toyota 0xB4 SPEED used for VREL, m/s (reads ~1.5% below GPS / wheel speed).";
CM_ SG_ 1834 DREL_FUSED "Candidate, not in OPENPILOT_CONFIG: velocity-aided range (gain 0.1); halves short-term range walks vs the camera.";
CM_ SG_ 1834 VREL_SMOOTHED "Candidate, not in OPENPILOT_CONFIG: causal EMA on VREL, tau 0 s below 30 m rising to 1 s from 60 m; ~0.5 s later true braking.";
CM_ BO_ 1835 "NOT radar bytes: values the ars510 interface computes for 0x80 slot 11, for plotting next to the raw fields.";
CM_ SG_ 1835 TRACK_ID_OP "trackId openpilot would see under OPENPILOT_CONFIG (held until age 60, re-link within 3.5 s); 0 when not published.";
CM_ SG_ 1835 TRACK_ID_RAW "trackId from the radar slot/age lifecycle alone (RAW_CONFIG).";
CM_ SG_ 1835 VREL "VLONG_OVER_GROUND - Toyota 0xB4 speed, m/s.";
CM_ SG_ 1835 V_EGO_0xB4 "Toyota 0xB4 SPEED used for VREL, m/s (reads ~1.5% below GPS / wheel speed).";
CM_ SG_ 1835 DREL_FUSED "Candidate, not in OPENPILOT_CONFIG: velocity-aided range (gain 0.1); halves short-term range walks vs the camera.";
CM_ SG_ 1835 VREL_SMOOTHED "Candidate, not in OPENPILOT_CONFIG: causal EMA on VREL, tau 0 s below 30 m rising to 1 s from 60 m; ~0.5 s later true braking.";
CM_ BO_ 1836 "NOT radar bytes: values the ars510 interface computes for 0x80 slot 12, for plotting next to the raw fields.";
CM_ SG_ 1836 TRACK_ID_OP "trackId openpilot would see under OPENPILOT_CONFIG (held until age 60, re-link within 3.5 s); 0 when not published.";
CM_ SG_ 1836 TRACK_ID_RAW "trackId from the radar slot/age lifecycle alone (RAW_CONFIG).";
CM_ SG_ 1836 VREL "VLONG_OVER_GROUND - Toyota 0xB4 speed, m/s.";
CM_ SG_ 1836 V_EGO_0xB4 "Toyota 0xB4 SPEED used for VREL, m/s (reads ~1.5% below GPS / wheel speed).";
CM_ SG_ 1836 DREL_FUSED "Candidate, not in OPENPILOT_CONFIG: velocity-aided range (gain 0.1); halves short-term range walks vs the camera.";
CM_ SG_ 1836 VREL_SMOOTHED "Candidate, not in OPENPILOT_CONFIG: causal EMA on VREL, tau 0 s below 30 m rising to 1 s from 60 m; ~0.5 s later true braking.";
CM_ BO_ 1837 "NOT radar bytes: values the ars510 interface computes for 0x80 slot 13, for plotting next to the raw fields.";
CM_ SG_ 1837 TRACK_ID_OP "trackId openpilot would see under OPENPILOT_CONFIG (held until age 60, re-link within 3.5 s); 0 when not published.";
CM_ SG_ 1837 TRACK_ID_RAW "trackId from the radar slot/age lifecycle alone (RAW_CONFIG).";
CM_ SG_ 1837 VREL "VLONG_OVER_GROUND - Toyota 0xB4 speed, m/s.";
CM_ SG_ 1837 V_EGO_0xB4 "Toyota 0xB4 SPEED used for VREL, m/s (reads ~1.5% below GPS / wheel speed).";
CM_ SG_ 1837 DREL_FUSED "Candidate, not in OPENPILOT_CONFIG: velocity-aided range (gain 0.1); halves short-term range walks vs the camera.";
CM_ SG_ 1837 VREL_SMOOTHED "Candidate, not in OPENPILOT_CONFIG: causal EMA on VREL, tau 0 s below 30 m rising to 1 s from 60 m; ~0.5 s later true braking.";
CM_ BO_ 1838 "NOT radar bytes: values the ars510 interface computes for 0x80 slot 14, for plotting next to the raw fields.";
CM_ SG_ 1838 TRACK_ID_OP "trackId openpilot would see under OPENPILOT_CONFIG (held until age 60, re-link within 3.5 s); 0 when not published.";
CM_ SG_ 1838 TRACK_ID_RAW "trackId from the radar slot/age lifecycle alone (RAW_CONFIG).";
CM_ SG_ 1838 VREL "VLONG_OVER_GROUND - Toyota 0xB4 speed, m/s.";
CM_ SG_ 1838 V_EGO_0xB4 "Toyota 0xB4 SPEED used for VREL, m/s (reads ~1.5% below GPS / wheel speed).";
CM_ SG_ 1838 DREL_FUSED "Candidate, not in OPENPILOT_CONFIG: velocity-aided range (gain 0.1); halves short-term range walks vs the camera.";
CM_ SG_ 1838 VREL_SMOOTHED "Candidate, not in OPENPILOT_CONFIG: causal EMA on VREL, tau 0 s below 30 m rising to 1 s from 60 m; ~0.5 s later true braking.";
CM_ BO_ 1839 "NOT radar bytes: values the ars510 interface computes for 0x80 slot 15, for plotting next to the raw fields.";
CM_ SG_ 1839 TRACK_ID_OP "trackId openpilot would see under OPENPILOT_CONFIG (held until age 60, re-link within 3.5 s); 0 when not published.";
CM_ SG_ 1839 TRACK_ID_RAW "trackId from the radar slot/age lifecycle alone (RAW_CONFIG).";
CM_ SG_ 1839 VREL "VLONG_OVER_GROUND - Toyota 0xB4 speed, m/s.";
CM_ SG_ 1839 V_EGO_0xB4 "Toyota 0xB4 SPEED used for VREL, m/s (reads ~1.5% below GPS / wheel speed).";
CM_ SG_ 1839 DREL_FUSED "Candidate, not in OPENPILOT_CONFIG: velocity-aided range (gain 0.1); halves short-term range walks vs the camera.";
CM_ SG_ 1839 VREL_SMOOTHED "Candidate, not in OPENPILOT_CONFIG: causal EMA on VREL, tau 0 s below 30 m rising to 1 s from 60 m; ~0.5 s later true braking.";
CM_ BO_ 1840 "NOT radar bytes: values the ars510 interface computes for 0x80 slot 16, for plotting next to the raw fields.";
CM_ SG_ 1840 TRACK_ID_OP "trackId openpilot would see under OPENPILOT_CONFIG (held until age 60, re-link within 3.5 s); 0 when not published.";
CM_ SG_ 1840 TRACK_ID_RAW "trackId from the radar slot/age lifecycle alone (RAW_CONFIG).";
CM_ SG_ 1840 VREL "VLONG_OVER_GROUND - Toyota 0xB4 speed, m/s.";
CM_ SG_ 1840 V_EGO_0xB4 "Toyota 0xB4 SPEED used for VREL, m/s (reads ~1.5% below GPS / wheel speed).";
CM_ SG_ 1840 DREL_FUSED "Candidate, not in OPENPILOT_CONFIG: velocity-aided range (gain 0.1); halves short-term range walks vs the camera.";
CM_ SG_ 1840 VREL_SMOOTHED "Candidate, not in OPENPILOT_CONFIG: causal EMA on VREL, tau 0 s below 30 m rising to 1 s from 60 m; ~0.5 s later true braking.";
CM_ BO_ 1841 "NOT radar bytes: values the ars510 interface computes for 0x80 slot 17, for plotting next to the raw fields.";
CM_ SG_ 1841 TRACK_ID_OP "trackId openpilot would see under OPENPILOT_CONFIG (held until age 60, re-link within 3.5 s); 0 when not published.";
CM_ SG_ 1841 TRACK_ID_RAW "trackId from the radar slot/age lifecycle alone (RAW_CONFIG).";
CM_ SG_ 1841 VREL "VLONG_OVER_GROUND - Toyota 0xB4 speed, m/s.";
CM_ SG_ 1841 V_EGO_0xB4 "Toyota 0xB4 SPEED used for VREL, m/s (reads ~1.5% below GPS / wheel speed).";
CM_ SG_ 1841 DREL_FUSED "Candidate, not in OPENPILOT_CONFIG: velocity-aided range (gain 0.1); halves short-term range walks vs the camera.";
CM_ SG_ 1841 VREL_SMOOTHED "Candidate, not in OPENPILOT_CONFIG: causal EMA on VREL, tau 0 s below 30 m rising to 1 s from 60 m; ~0.5 s later true braking.";
CM_ BO_ 1842 "NOT radar bytes: values the ars510 interface computes for 0x80 slot 18, for plotting next to the raw fields.";
CM_ SG_ 1842 TRACK_ID_OP "trackId openpilot would see under OPENPILOT_CONFIG (held until age 60, re-link within 3.5 s); 0 when not published.";
CM_ SG_ 1842 TRACK_ID_RAW "trackId from the radar slot/age lifecycle alone (RAW_CONFIG).";
CM_ SG_ 1842 VREL "VLONG_OVER_GROUND - Toyota 0xB4 speed, m/s.";
CM_ SG_ 1842 V_EGO_0xB4 "Toyota 0xB4 SPEED used for VREL, m/s (reads ~1.5% below GPS / wheel speed).";
CM_ SG_ 1842 DREL_FUSED "Candidate, not in OPENPILOT_CONFIG: velocity-aided range (gain 0.1); halves short-term range walks vs the camera.";
CM_ SG_ 1842 VREL_SMOOTHED "Candidate, not in OPENPILOT_CONFIG: causal EMA on VREL, tau 0 s below 30 m rising to 1 s from 60 m; ~0.5 s later true braking.";
CM_ BO_ 1843 "NOT radar bytes: values the ars510 interface computes for 0x80 slot 19, for plotting next to the raw fields.";
CM_ SG_ 1843 TRACK_ID_OP "trackId openpilot would see under OPENPILOT_CONFIG (held until age 60, re-link within 3.5 s); 0 when not published.";
CM_ SG_ 1843 TRACK_ID_RAW "trackId from the radar slot/age lifecycle alone (RAW_CONFIG).";
CM_ SG_ 1843 VREL "VLONG_OVER_GROUND - Toyota 0xB4 speed, m/s.";
CM_ SG_ 1843 V_EGO_0xB4 "Toyota 0xB4 SPEED used for VREL, m/s (reads ~1.5% below GPS / wheel speed).";
CM_ SG_ 1843 DREL_FUSED "Candidate, not in OPENPILOT_CONFIG: velocity-aided range (gain 0.1); halves short-term range walks vs the camera.";
CM_ SG_ 1843 VREL_SMOOTHED "Candidate, not in OPENPILOT_CONFIG: causal EMA on VREL, tau 0 s below 30 m rising to 1 s from 60 m; ~0.5 s later true braking.";
CM_ BO_ 1856 "0x80 record bytes 0-16, before the 20 object slots. Byte 0 is 0xE4 (transport length low byte).";
CM_ SG_ 1856 CONST_HDR0_8 "Constant 228 (0xE4) in the original small-corpus survey; not proof of reserved/padding bits or universal constancy.";
CM_ SG_ 1856 UNK_HDR8_5 "Candidate from the carry-chain split, unverified: LSB flips 0.784 per cycle, 32 distinct values 0..31. Strongest correlation: v_ego r=-0.00.";
CM_ SG_ 1856 UNK_HDR13_4 "Candidate from the carry-chain split, unverified: LSB flips 0.837 per cycle, 16 distinct values 0..15. Strongest correlation: v_ego r=-0.00.";
CM_ SG_ 1856 UNK_HDR17_15 "Candidate from the carry-chain split, unverified: LSB flips 0.822 per cycle, 11800 distinct values 0..26788. Strongest correlation: v_ego r=-0.74.";
CM_ SG_ 1856 CONST_HDR32_1 "Constant 0 (0x0) in the original small-corpus survey; not proof of reserved/padding bits or universal constancy.";
CM_ SG_ 1856 UNK_HDR33_1 "Candidate from the carry-chain split, unverified: LSB flips 0.000 per cycle, 2 distinct values 0..1. Strongest correlation: v_ego r=+0.32.";
CM_ SG_ 1856 CONST_HDR34_7 "Constant 64 (0x40) in the original small-corpus survey; not proof of reserved/padding bits or universal constancy.";
CM_ SG_ 1856 UNK_HDR41_15 "Candidate from the carry-chain split, unverified: LSB flips 1.000 per cycle, 12930 distinct values 0..32767. Strongest correlation: v_ego r=-0.31.";
CM_ SG_ 1856 CONST_HDR56_12 "Constant 0 (0x0) in the original small-corpus survey; not proof of reserved/padding bits or universal constancy.";
CM_ SG_ 1856 UNK_HDR68_4 "Candidate from the carry-chain split, unverified: LSB flips 1.000 per cycle, 16 distinct values 0..15. Strongest correlation: v_ego r=-0.00.";
CM_ SG_ 1856 CONST_HDR72_32 "Constant 16777215 (0xFFFFFF) in the original small-corpus survey; not proof of reserved/padding bits or universal constancy.";
CM_ SG_ 1856 UNK_HDR104_3 "Candidate from the carry-chain split, unverified: LSB flips 0.315 per cycle, 8 distinct values 0..7. Strongest correlation: v_ego r=-0.04.";
CM_ SG_ 1856 UNK_HDR107_4 "Candidate from the carry-chain split, unverified: LSB flips 0.253 per cycle, 9 distinct values 0..11. Strongest correlation: v_ego r=-0.39.";
CM_ SG_ 1856 CONST_HDR111_4 "Constant 3 (0x3) in the original small-corpus survey; not proof of reserved/padding bits or universal constancy.";
CM_ SG_ 1856 OBJECT_COUNT "Number of live objects (slots with age >= 1) in this record. Exact on 384,144 records over 6.4 h (docs/15).";
CM_ SG_ 1856 CONST_HDR120_16 "Constant 0 (0x0) in the original small-corpus survey; not proof of reserved/padding bits or universal constancy.";
CM_ SG_ 1857 RECORD_CRC32 "zlib CRC32 over record bytes 1-736, little-endian; failing records are not exported.";
CM_ BO_ 1888 "0x85 bytes 0-20, proposed prefix only. Byte 0 is length-low 0x90. Cell alignment and semantics remain provisional.";
CM_ SG_ 1889 PARAMETERS_PRESENT "Observed nondefault parameter marker. Not accuracy, freshness, physical validity, fixed ego-lane identity, reflection presence or ECU origin.";
CM_ BO_ 1889 "Provisional 0x85 analysis cell 0, bytes 21-32; raw bytes, not a proven object. Excludes CRC and trailer.";
CM_ SG_ 1890 PARAMETERS_PRESENT "Observed nondefault parameter marker. Not accuracy, freshness, physical validity, fixed ego-lane identity, reflection presence or ECU origin.";
CM_ BO_ 1890 "Provisional 0x85 analysis cell 1, bytes 33-44; raw bytes, not a proven object. Excludes CRC and trailer.";
CM_ SG_ 1891 PARAMETERS_PRESENT "Observed nondefault parameter marker. Not accuracy, freshness, physical validity, fixed ego-lane identity, reflection presence or ECU origin.";
CM_ BO_ 1891 "Provisional 0x85 analysis cell 2, bytes 45-56; raw bytes, not a proven object. Excludes CRC and trailer.";
CM_ SG_ 1892 PARAMETERS_PRESENT "Observed nondefault parameter marker. Not accuracy, freshness, physical validity, fixed ego-lane identity, reflection presence or ECU origin.";
CM_ BO_ 1892 "Provisional 0x85 analysis cell 3, bytes 57-68; raw bytes, not a proven object. Excludes CRC and trailer.";
CM_ SG_ 1893 PARAMETERS_PRESENT "Observed nondefault parameter marker. Not accuracy, freshness, physical validity, fixed ego-lane identity, reflection presence or ECU origin.";
CM_ BO_ 1893 "Provisional 0x85 analysis cell 4, bytes 69-80; raw bytes, not a proven object. Excludes CRC and trailer.";
CM_ SG_ 1894 PARAMETERS_PRESENT "Observed nondefault parameter marker. Not accuracy, freshness, physical validity, fixed ego-lane identity, reflection presence or ECU origin.";
CM_ BO_ 1894 "Provisional 0x85 analysis cell 5, bytes 81-92; raw bytes, not a proven object. Excludes CRC and trailer.";
CM_ SG_ 1895 PARAMETERS_PRESENT "Observed nondefault parameter marker. Not accuracy, freshness, physical validity, fixed ego-lane identity, reflection presence or ECU origin.";
CM_ BO_ 1895 "Provisional 0x85 analysis cell 6, bytes 93-104; raw bytes, not a proven object. Excludes CRC and trailer.";
CM_ SG_ 1896 PARAMETERS_PRESENT "Observed nondefault parameter marker. Not accuracy, freshness, physical validity, fixed ego-lane identity, reflection presence or ECU origin.";
CM_ BO_ 1896 "Provisional 0x85 analysis cell 7, bytes 105-116; raw bytes, not a proven object. Excludes CRC and trailer.";
CM_ SG_ 1897 PARAMETERS_PRESENT "Observed nondefault parameter marker. Not accuracy, freshness, physical validity, fixed ego-lane identity, reflection presence or ECU origin.";
CM_ BO_ 1897 "Provisional 0x85 analysis cell 8, bytes 117-128; raw bytes, not a proven object. Excludes CRC and trailer.";
CM_ SG_ 1898 PARAMETERS_PRESENT "Observed nondefault parameter marker. Not accuracy, freshness, physical validity, fixed ego-lane identity, reflection presence or ECU origin.";
CM_ BO_ 1898 "Provisional 0x85 analysis cell 9, bytes 129-140; raw bytes, not a proven object. Excludes CRC and trailer.";
CM_ BO_ 1899 "CRC at record[141:145] over record[1:141], followed by trailer[145:147]. Failing records are not exported.";
VAL_ 1803 ONCOMING_FLAG 0 "not oncoming" 1 "oncoming (now or earlier)" ;
VAL_ 1803 MOVE_STATE 0 "moving away" 1 "not clearly moving" 2 "moving toward" 3 "not clearly moving (3)" ;
VAL_ 1804 ONCOMING_FLAG 0 "not oncoming" 1 "oncoming (now or earlier)" ;
VAL_ 1804 MOVE_STATE 0 "moving away" 1 "not clearly moving" 2 "moving toward" 3 "not clearly moving (3)" ;
VAL_ 1805 ONCOMING_FLAG 0 "not oncoming" 1 "oncoming (now or earlier)" ;
VAL_ 1805 MOVE_STATE 0 "moving away" 1 "not clearly moving" 2 "moving toward" 3 "not clearly moving (3)" ;
VAL_ 1806 ONCOMING_FLAG 0 "not oncoming" 1 "oncoming (now or earlier)" ;
VAL_ 1806 MOVE_STATE 0 "moving away" 1 "not clearly moving" 2 "moving toward" 3 "not clearly moving (3)" ;
VAL_ 1807 ONCOMING_FLAG 0 "not oncoming" 1 "oncoming (now or earlier)" ;
VAL_ 1807 MOVE_STATE 0 "moving away" 1 "not clearly moving" 2 "moving toward" 3 "not clearly moving (3)" ;
VAL_ 1808 ONCOMING_FLAG 0 "not oncoming" 1 "oncoming (now or earlier)" ;
VAL_ 1808 MOVE_STATE 0 "moving away" 1 "not clearly moving" 2 "moving toward" 3 "not clearly moving (3)" ;
VAL_ 1809 ONCOMING_FLAG 0 "not oncoming" 1 "oncoming (now or earlier)" ;
VAL_ 1809 MOVE_STATE 0 "moving away" 1 "not clearly moving" 2 "moving toward" 3 "not clearly moving (3)" ;
VAL_ 1810 ONCOMING_FLAG 0 "not oncoming" 1 "oncoming (now or earlier)" ;
VAL_ 1810 MOVE_STATE 0 "moving away" 1 "not clearly moving" 2 "moving toward" 3 "not clearly moving (3)" ;
VAL_ 1811 ONCOMING_FLAG 0 "not oncoming" 1 "oncoming (now or earlier)" ;
VAL_ 1811 MOVE_STATE 0 "moving away" 1 "not clearly moving" 2 "moving toward" 3 "not clearly moving (3)" ;
VAL_ 1824 PUBLISHED_OP 0 "held back or absent" 1 "published" ;
VAL_ 1824 SETTLED 0 "settling (age<60)" 1 "settled" ;
VAL_ 1825 PUBLISHED_OP 0 "held back or absent" 1 "published" ;
VAL_ 1825 SETTLED 0 "settling (age<60)" 1 "settled" ;
VAL_ 1826 PUBLISHED_OP 0 "held back or absent" 1 "published" ;
VAL_ 1826 SETTLED 0 "settling (age<60)" 1 "settled" ;
VAL_ 1827 PUBLISHED_OP 0 "held back or absent" 1 "published" ;
VAL_ 1827 SETTLED 0 "settling (age<60)" 1 "settled" ;
VAL_ 1828 PUBLISHED_OP 0 "held back or absent" 1 "published" ;
VAL_ 1828 SETTLED 0 "settling (age<60)" 1 "settled" ;
VAL_ 1829 PUBLISHED_OP 0 "held back or absent" 1 "published" ;
VAL_ 1829 SETTLED 0 "settling (age<60)" 1 "settled" ;
VAL_ 1830 PUBLISHED_OP 0 "held back or absent" 1 "published" ;
VAL_ 1830 SETTLED 0 "settling (age<60)" 1 "settled" ;
VAL_ 1831 PUBLISHED_OP 0 "held back or absent" 1 "published" ;
VAL_ 1831 SETTLED 0 "settling (age<60)" 1 "settled" ;
VAL_ 1832 PUBLISHED_OP 0 "held back or absent" 1 "published" ;
VAL_ 1832 SETTLED 0 "settling (age<60)" 1 "settled" ;
VAL_ 1833 PUBLISHED_OP 0 "held back or absent" 1 "published" ;
VAL_ 1833 SETTLED 0 "settling (age<60)" 1 "settled" ;
VAL_ 1834 PUBLISHED_OP 0 "held back or absent" 1 "published" ;
VAL_ 1834 SETTLED 0 "settling (age<60)" 1 "settled" ;
VAL_ 1835 PUBLISHED_OP 0 "held back or absent" 1 "published" ;
VAL_ 1835 SETTLED 0 "settling (age<60)" 1 "settled" ;
VAL_ 1836 PUBLISHED_OP 0 "held back or absent" 1 "published" ;
VAL_ 1836 SETTLED 0 "settling (age<60)" 1 "settled" ;
VAL_ 1837 PUBLISHED_OP 0 "held back or absent" 1 "published" ;
VAL_ 1837 SETTLED 0 "settling (age<60)" 1 "settled" ;
VAL_ 1838 PUBLISHED_OP 0 "held back or absent" 1 "published" ;
VAL_ 1838 SETTLED 0 "settling (age<60)" 1 "settled" ;
VAL_ 1839 PUBLISHED_OP 0 "held back or absent" 1 "published" ;
VAL_ 1839 SETTLED 0 "settling (age<60)" 1 "settled" ;
VAL_ 1840 PUBLISHED_OP 0 "held back or absent" 1 "published" ;
VAL_ 1840 SETTLED 0 "settling (age<60)" 1 "settled" ;
VAL_ 1841 PUBLISHED_OP 0 "held back or absent" 1 "published" ;
VAL_ 1841 SETTLED 0 "settling (age<60)" 1 "settled" ;
VAL_ 1842 PUBLISHED_OP 0 "held back or absent" 1 "published" ;
VAL_ 1842 SETTLED 0 "settling (age<60)" 1 "settled" ;
VAL_ 1843 PUBLISHED_OP 0 "held back or absent" 1 "published" ;
VAL_ 1843 SETTLED 0 "settling (age<60)" 1 "settled" ;
