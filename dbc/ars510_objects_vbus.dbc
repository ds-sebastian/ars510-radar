VERSION "ARS510 reassembled object / shell records on a virtual bus (generated by tools/build_cabana_route.py)"

NS_ :

BS_:

BU_: RADAR XXX

BO_ 1792 ARS510_OBJ_00: 48 RADAR
 SG_ STATE_CODE : 0|2@1+ (1,0) [0|3] "raw" XXX
 SG_ SLOT_INDEX_CODE : 2|6@1+ (1,0) [0|63] "raw" XXX
 SG_ UNK_8_6 : 8|6@1+ (1,0) [0|63] "raw" XXX
 SG_ ONCOMING_FLAG : 14|1@1+ (1,0) [0|1] "" XXX
 SG_ CONST_15_1 : 15|1@1+ (1,0) [0|1] "raw" XXX
 SG_ SCORE_CODE : 16|8@1+ (1,0) [0|255] "raw" XXX
 SG_ AGE : 24|7@1+ (1,0) [0|126] "cycles" XXX
 SG_ CONST_31_1 : 31|1@1+ (1,0) [0|1] "raw" XXX
 SG_ DREL : 32|12@1+ (0.0625,-10) [-10|245.9375] "m" XXX
 SG_ YREL_LEFT : 44|12@1+ (0.015625,-32) [-32|31.984375] "m" XXX
 SG_ UNK_56_7 : 56|7@1+ (1,0) [0|127] "raw" XXX
 SG_ CONST_63_1 : 63|1@1+ (1,0) [0|1] "raw" XXX
 SG_ VLONG_OVER_GROUND : 64|10@1+ (0.15,-76.575) [-76.575|76.875] "m/s" XXX
 SG_ VLAT_OVER_GROUND_PROV : 74|10@1+ (0.15,-76.575) [-76.575|76.875] "m/s" XXX
 SG_ ALONG_LIKE_84 : 84|10@1+ (1,-511) [-511|512] "code" XXX
 SG_ CONST_94_2 : 94|2@1+ (1,0) [0|3] "raw" XXX
 SG_ UNK_96 : 96|10@1+ (1,0) [0|1023] "raw" XXX
 SG_ UNK_106_1 : 106|1@1+ (1,0) [0|1] "raw" XXX
 SG_ UNK_107_1 : 107|1@1+ (1,0) [0|1] "raw" XXX
 SG_ CONST_108_1 : 108|1@1+ (1,0) [0|1] "raw" XXX
 SG_ MOVE_STATE : 109|2@1+ (1,0) [0|3] "" XXX
 SG_ UNK_111_4 : 111|4@1+ (1,0) [0|15] "raw" XXX
 SG_ UNK_115_8 : 115|8@1+ (1,0) [0|255] "raw" XXX
 SG_ CONST_123_5 : 123|5@1+ (1,0) [0|31] "raw" XXX
 SG_ UNK_128_2 : 128|2@1+ (1,0) [0|3] "raw" XXX
 SG_ UNK_130_1 : 130|1@1+ (1,0) [0|1] "raw" XXX
 SG_ UNK_131_4 : 131|4@1+ (1,0) [0|15] "raw" XXX
 SG_ CONST_135_1 : 135|1@1+ (1,0) [0|1] "raw" XXX
 SG_ UNK_136_6 : 136|6@1+ (1,0) [0|63] "raw" XXX
 SG_ UNK_142_1 : 142|1@1+ (1,0) [0|1] "raw" XXX
 SG_ CONST_143_5 : 143|5@1+ (1,0) [0|31] "raw" XXX
 SG_ UNK_148_8 : 148|8@1+ (1,0) [0|255] "raw" XXX
 SG_ UNK_156_4 : 156|4@1+ (1,0) [0|15] "raw" XXX
 SG_ CONST_160_3 : 160|3@1+ (1,0) [0|7] "raw" XXX
 SG_ UNK_163_2 : 163|2@1+ (1,0) [0|3] "raw" XXX
 SG_ CONST_165_3 : 165|3@1+ (1,0) [0|7] "raw" XXX
 SG_ UNK_168_10 : 168|10@1+ (1,0) [0|1023] "raw" XXX
 SG_ CONST_178_3 : 178|3@1+ (1,0) [0|7] "raw" XXX
 SG_ UNK_181_1 : 181|1@1+ (1,0) [0|1] "raw" XXX
 SG_ CONST_182_1 : 182|1@1+ (1,0) [0|1] "raw" XXX
 SG_ UNK_183_7 : 183|7@1+ (1,0) [0|127] "raw" XXX
 SG_ CONST_190_10 : 190|10@1+ (1,0) [0|1023] "raw" XXX
 SG_ UNK_200_7 : 200|7@1+ (1,0) [0|127] "raw" XXX
 SG_ CONST_207_1 : 207|1@1+ (1,0) [0|1] "raw" XXX
 SG_ UNK_208_6 : 208|6@1+ (1,0) [0|63] "raw" XXX
 SG_ CONST_214_2 : 214|2@1+ (1,0) [0|3] "raw" XXX
 SG_ UNK_216_6 : 216|6@1+ (1,0) [0|63] "raw" XXX
 SG_ CONST_222_2 : 222|2@1+ (1,0) [0|3] "raw" XXX
 SG_ UNK_224_7 : 224|7@1+ (1,0) [0|127] "raw" XXX
 SG_ CONST_231_1 : 231|1@1+ (1,0) [0|1] "raw" XXX
 SG_ UNK_232_7 : 232|7@1+ (1,0) [0|127] "raw" XXX
 SG_ PER_TRACK_239_1 : 239|1@1+ (1,0) [0|1] "raw" XXX
 SG_ UNK_240_7 : 240|7@1+ (1,0) [0|127] "raw" XXX
 SG_ CONST_247_1 : 247|1@1+ (1,0) [0|1] "raw" XXX
 SG_ UNK_248_7 : 248|7@1+ (1,0) [0|127] "raw" XXX
 SG_ CONST_255_1 : 255|1@1+ (1,0) [0|1] "raw" XXX
 SG_ UNK_256_5 : 256|5@1+ (1,0) [0|31] "raw" XXX
 SG_ CONST_261_3 : 261|3@1+ (1,0) [0|7] "raw" XXX
 SG_ UNK_264_5 : 264|5@1+ (1,0) [0|31] "raw" XXX
 SG_ CONST_269_3 : 269|3@1+ (1,0) [0|7] "raw" XXX
 SG_ UNK_272_5 : 272|5@1+ (1,0) [0|31] "raw" XXX
 SG_ CONST_277_11 : 277|11@1+ (1,0) [0|2047] "raw" XXX

BO_ 1793 ARS510_OBJ_01: 48 RADAR
 SG_ STATE_CODE : 0|2@1+ (1,0) [0|3] "raw" XXX
 SG_ SLOT_INDEX_CODE : 2|6@1+ (1,0) [0|63] "raw" XXX
 SG_ UNK_8_6 : 8|6@1+ (1,0) [0|63] "raw" XXX
 SG_ ONCOMING_FLAG : 14|1@1+ (1,0) [0|1] "" XXX
 SG_ CONST_15_1 : 15|1@1+ (1,0) [0|1] "raw" XXX
 SG_ SCORE_CODE : 16|8@1+ (1,0) [0|255] "raw" XXX
 SG_ AGE : 24|7@1+ (1,0) [0|126] "cycles" XXX
 SG_ CONST_31_1 : 31|1@1+ (1,0) [0|1] "raw" XXX
 SG_ DREL : 32|12@1+ (0.0625,-10) [-10|245.9375] "m" XXX
 SG_ YREL_LEFT : 44|12@1+ (0.015625,-32) [-32|31.984375] "m" XXX
 SG_ UNK_56_7 : 56|7@1+ (1,0) [0|127] "raw" XXX
 SG_ CONST_63_1 : 63|1@1+ (1,0) [0|1] "raw" XXX
 SG_ VLONG_OVER_GROUND : 64|10@1+ (0.15,-76.575) [-76.575|76.875] "m/s" XXX
 SG_ VLAT_OVER_GROUND_PROV : 74|10@1+ (0.15,-76.575) [-76.575|76.875] "m/s" XXX
 SG_ ALONG_LIKE_84 : 84|10@1+ (1,-511) [-511|512] "code" XXX
 SG_ CONST_94_2 : 94|2@1+ (1,0) [0|3] "raw" XXX
 SG_ UNK_96 : 96|10@1+ (1,0) [0|1023] "raw" XXX
 SG_ UNK_106_1 : 106|1@1+ (1,0) [0|1] "raw" XXX
 SG_ UNK_107_1 : 107|1@1+ (1,0) [0|1] "raw" XXX
 SG_ CONST_108_1 : 108|1@1+ (1,0) [0|1] "raw" XXX
 SG_ MOVE_STATE : 109|2@1+ (1,0) [0|3] "" XXX
 SG_ UNK_111_4 : 111|4@1+ (1,0) [0|15] "raw" XXX
 SG_ UNK_115_8 : 115|8@1+ (1,0) [0|255] "raw" XXX
 SG_ CONST_123_5 : 123|5@1+ (1,0) [0|31] "raw" XXX
 SG_ UNK_128_2 : 128|2@1+ (1,0) [0|3] "raw" XXX
 SG_ UNK_130_1 : 130|1@1+ (1,0) [0|1] "raw" XXX
 SG_ UNK_131_4 : 131|4@1+ (1,0) [0|15] "raw" XXX
 SG_ CONST_135_1 : 135|1@1+ (1,0) [0|1] "raw" XXX
 SG_ UNK_136_6 : 136|6@1+ (1,0) [0|63] "raw" XXX
 SG_ UNK_142_1 : 142|1@1+ (1,0) [0|1] "raw" XXX
 SG_ CONST_143_5 : 143|5@1+ (1,0) [0|31] "raw" XXX
 SG_ UNK_148_8 : 148|8@1+ (1,0) [0|255] "raw" XXX
 SG_ UNK_156_4 : 156|4@1+ (1,0) [0|15] "raw" XXX
 SG_ CONST_160_3 : 160|3@1+ (1,0) [0|7] "raw" XXX
 SG_ UNK_163_2 : 163|2@1+ (1,0) [0|3] "raw" XXX
 SG_ CONST_165_3 : 165|3@1+ (1,0) [0|7] "raw" XXX
 SG_ UNK_168_10 : 168|10@1+ (1,0) [0|1023] "raw" XXX
 SG_ CONST_178_3 : 178|3@1+ (1,0) [0|7] "raw" XXX
 SG_ UNK_181_1 : 181|1@1+ (1,0) [0|1] "raw" XXX
 SG_ CONST_182_1 : 182|1@1+ (1,0) [0|1] "raw" XXX
 SG_ UNK_183_7 : 183|7@1+ (1,0) [0|127] "raw" XXX
 SG_ CONST_190_10 : 190|10@1+ (1,0) [0|1023] "raw" XXX
 SG_ UNK_200_7 : 200|7@1+ (1,0) [0|127] "raw" XXX
 SG_ CONST_207_1 : 207|1@1+ (1,0) [0|1] "raw" XXX
 SG_ UNK_208_6 : 208|6@1+ (1,0) [0|63] "raw" XXX
 SG_ CONST_214_2 : 214|2@1+ (1,0) [0|3] "raw" XXX
 SG_ UNK_216_6 : 216|6@1+ (1,0) [0|63] "raw" XXX
 SG_ CONST_222_2 : 222|2@1+ (1,0) [0|3] "raw" XXX
 SG_ UNK_224_7 : 224|7@1+ (1,0) [0|127] "raw" XXX
 SG_ CONST_231_1 : 231|1@1+ (1,0) [0|1] "raw" XXX
 SG_ UNK_232_7 : 232|7@1+ (1,0) [0|127] "raw" XXX
 SG_ PER_TRACK_239_1 : 239|1@1+ (1,0) [0|1] "raw" XXX
 SG_ UNK_240_7 : 240|7@1+ (1,0) [0|127] "raw" XXX
 SG_ CONST_247_1 : 247|1@1+ (1,0) [0|1] "raw" XXX
 SG_ UNK_248_7 : 248|7@1+ (1,0) [0|127] "raw" XXX
 SG_ CONST_255_1 : 255|1@1+ (1,0) [0|1] "raw" XXX
 SG_ UNK_256_5 : 256|5@1+ (1,0) [0|31] "raw" XXX
 SG_ CONST_261_3 : 261|3@1+ (1,0) [0|7] "raw" XXX
 SG_ UNK_264_5 : 264|5@1+ (1,0) [0|31] "raw" XXX
 SG_ CONST_269_3 : 269|3@1+ (1,0) [0|7] "raw" XXX
 SG_ UNK_272_5 : 272|5@1+ (1,0) [0|31] "raw" XXX
 SG_ CONST_277_11 : 277|11@1+ (1,0) [0|2047] "raw" XXX

BO_ 1794 ARS510_OBJ_02: 48 RADAR
 SG_ STATE_CODE : 0|2@1+ (1,0) [0|3] "raw" XXX
 SG_ SLOT_INDEX_CODE : 2|6@1+ (1,0) [0|63] "raw" XXX
 SG_ UNK_8_6 : 8|6@1+ (1,0) [0|63] "raw" XXX
 SG_ ONCOMING_FLAG : 14|1@1+ (1,0) [0|1] "" XXX
 SG_ CONST_15_1 : 15|1@1+ (1,0) [0|1] "raw" XXX
 SG_ SCORE_CODE : 16|8@1+ (1,0) [0|255] "raw" XXX
 SG_ AGE : 24|7@1+ (1,0) [0|126] "cycles" XXX
 SG_ CONST_31_1 : 31|1@1+ (1,0) [0|1] "raw" XXX
 SG_ DREL : 32|12@1+ (0.0625,-10) [-10|245.9375] "m" XXX
 SG_ YREL_LEFT : 44|12@1+ (0.015625,-32) [-32|31.984375] "m" XXX
 SG_ UNK_56_7 : 56|7@1+ (1,0) [0|127] "raw" XXX
 SG_ CONST_63_1 : 63|1@1+ (1,0) [0|1] "raw" XXX
 SG_ VLONG_OVER_GROUND : 64|10@1+ (0.15,-76.575) [-76.575|76.875] "m/s" XXX
 SG_ VLAT_OVER_GROUND_PROV : 74|10@1+ (0.15,-76.575) [-76.575|76.875] "m/s" XXX
 SG_ ALONG_LIKE_84 : 84|10@1+ (1,-511) [-511|512] "code" XXX
 SG_ CONST_94_2 : 94|2@1+ (1,0) [0|3] "raw" XXX
 SG_ UNK_96 : 96|10@1+ (1,0) [0|1023] "raw" XXX
 SG_ UNK_106_1 : 106|1@1+ (1,0) [0|1] "raw" XXX
 SG_ UNK_107_1 : 107|1@1+ (1,0) [0|1] "raw" XXX
 SG_ CONST_108_1 : 108|1@1+ (1,0) [0|1] "raw" XXX
 SG_ MOVE_STATE : 109|2@1+ (1,0) [0|3] "" XXX
 SG_ UNK_111_4 : 111|4@1+ (1,0) [0|15] "raw" XXX
 SG_ UNK_115_8 : 115|8@1+ (1,0) [0|255] "raw" XXX
 SG_ CONST_123_5 : 123|5@1+ (1,0) [0|31] "raw" XXX
 SG_ UNK_128_2 : 128|2@1+ (1,0) [0|3] "raw" XXX
 SG_ UNK_130_1 : 130|1@1+ (1,0) [0|1] "raw" XXX
 SG_ UNK_131_4 : 131|4@1+ (1,0) [0|15] "raw" XXX
 SG_ CONST_135_1 : 135|1@1+ (1,0) [0|1] "raw" XXX
 SG_ UNK_136_6 : 136|6@1+ (1,0) [0|63] "raw" XXX
 SG_ UNK_142_1 : 142|1@1+ (1,0) [0|1] "raw" XXX
 SG_ CONST_143_5 : 143|5@1+ (1,0) [0|31] "raw" XXX
 SG_ UNK_148_8 : 148|8@1+ (1,0) [0|255] "raw" XXX
 SG_ UNK_156_4 : 156|4@1+ (1,0) [0|15] "raw" XXX
 SG_ CONST_160_3 : 160|3@1+ (1,0) [0|7] "raw" XXX
 SG_ UNK_163_2 : 163|2@1+ (1,0) [0|3] "raw" XXX
 SG_ CONST_165_3 : 165|3@1+ (1,0) [0|7] "raw" XXX
 SG_ UNK_168_10 : 168|10@1+ (1,0) [0|1023] "raw" XXX
 SG_ CONST_178_3 : 178|3@1+ (1,0) [0|7] "raw" XXX
 SG_ UNK_181_1 : 181|1@1+ (1,0) [0|1] "raw" XXX
 SG_ CONST_182_1 : 182|1@1+ (1,0) [0|1] "raw" XXX
 SG_ UNK_183_7 : 183|7@1+ (1,0) [0|127] "raw" XXX
 SG_ CONST_190_10 : 190|10@1+ (1,0) [0|1023] "raw" XXX
 SG_ UNK_200_7 : 200|7@1+ (1,0) [0|127] "raw" XXX
 SG_ CONST_207_1 : 207|1@1+ (1,0) [0|1] "raw" XXX
 SG_ UNK_208_6 : 208|6@1+ (1,0) [0|63] "raw" XXX
 SG_ CONST_214_2 : 214|2@1+ (1,0) [0|3] "raw" XXX
 SG_ UNK_216_6 : 216|6@1+ (1,0) [0|63] "raw" XXX
 SG_ CONST_222_2 : 222|2@1+ (1,0) [0|3] "raw" XXX
 SG_ UNK_224_7 : 224|7@1+ (1,0) [0|127] "raw" XXX
 SG_ CONST_231_1 : 231|1@1+ (1,0) [0|1] "raw" XXX
 SG_ UNK_232_7 : 232|7@1+ (1,0) [0|127] "raw" XXX
 SG_ PER_TRACK_239_1 : 239|1@1+ (1,0) [0|1] "raw" XXX
 SG_ UNK_240_7 : 240|7@1+ (1,0) [0|127] "raw" XXX
 SG_ CONST_247_1 : 247|1@1+ (1,0) [0|1] "raw" XXX
 SG_ UNK_248_7 : 248|7@1+ (1,0) [0|127] "raw" XXX
 SG_ CONST_255_1 : 255|1@1+ (1,0) [0|1] "raw" XXX
 SG_ UNK_256_5 : 256|5@1+ (1,0) [0|31] "raw" XXX
 SG_ CONST_261_3 : 261|3@1+ (1,0) [0|7] "raw" XXX
 SG_ UNK_264_5 : 264|5@1+ (1,0) [0|31] "raw" XXX
 SG_ CONST_269_3 : 269|3@1+ (1,0) [0|7] "raw" XXX
 SG_ UNK_272_5 : 272|5@1+ (1,0) [0|31] "raw" XXX
 SG_ CONST_277_11 : 277|11@1+ (1,0) [0|2047] "raw" XXX

BO_ 1795 ARS510_OBJ_03: 48 RADAR
 SG_ STATE_CODE : 0|2@1+ (1,0) [0|3] "raw" XXX
 SG_ SLOT_INDEX_CODE : 2|6@1+ (1,0) [0|63] "raw" XXX
 SG_ UNK_8_6 : 8|6@1+ (1,0) [0|63] "raw" XXX
 SG_ ONCOMING_FLAG : 14|1@1+ (1,0) [0|1] "" XXX
 SG_ CONST_15_1 : 15|1@1+ (1,0) [0|1] "raw" XXX
 SG_ SCORE_CODE : 16|8@1+ (1,0) [0|255] "raw" XXX
 SG_ AGE : 24|7@1+ (1,0) [0|126] "cycles" XXX
 SG_ CONST_31_1 : 31|1@1+ (1,0) [0|1] "raw" XXX
 SG_ DREL : 32|12@1+ (0.0625,-10) [-10|245.9375] "m" XXX
 SG_ YREL_LEFT : 44|12@1+ (0.015625,-32) [-32|31.984375] "m" XXX
 SG_ UNK_56_7 : 56|7@1+ (1,0) [0|127] "raw" XXX
 SG_ CONST_63_1 : 63|1@1+ (1,0) [0|1] "raw" XXX
 SG_ VLONG_OVER_GROUND : 64|10@1+ (0.15,-76.575) [-76.575|76.875] "m/s" XXX
 SG_ VLAT_OVER_GROUND_PROV : 74|10@1+ (0.15,-76.575) [-76.575|76.875] "m/s" XXX
 SG_ ALONG_LIKE_84 : 84|10@1+ (1,-511) [-511|512] "code" XXX
 SG_ CONST_94_2 : 94|2@1+ (1,0) [0|3] "raw" XXX
 SG_ UNK_96 : 96|10@1+ (1,0) [0|1023] "raw" XXX
 SG_ UNK_106_1 : 106|1@1+ (1,0) [0|1] "raw" XXX
 SG_ UNK_107_1 : 107|1@1+ (1,0) [0|1] "raw" XXX
 SG_ CONST_108_1 : 108|1@1+ (1,0) [0|1] "raw" XXX
 SG_ MOVE_STATE : 109|2@1+ (1,0) [0|3] "" XXX
 SG_ UNK_111_4 : 111|4@1+ (1,0) [0|15] "raw" XXX
 SG_ UNK_115_8 : 115|8@1+ (1,0) [0|255] "raw" XXX
 SG_ CONST_123_5 : 123|5@1+ (1,0) [0|31] "raw" XXX
 SG_ UNK_128_2 : 128|2@1+ (1,0) [0|3] "raw" XXX
 SG_ UNK_130_1 : 130|1@1+ (1,0) [0|1] "raw" XXX
 SG_ UNK_131_4 : 131|4@1+ (1,0) [0|15] "raw" XXX
 SG_ CONST_135_1 : 135|1@1+ (1,0) [0|1] "raw" XXX
 SG_ UNK_136_6 : 136|6@1+ (1,0) [0|63] "raw" XXX
 SG_ UNK_142_1 : 142|1@1+ (1,0) [0|1] "raw" XXX
 SG_ CONST_143_5 : 143|5@1+ (1,0) [0|31] "raw" XXX
 SG_ UNK_148_8 : 148|8@1+ (1,0) [0|255] "raw" XXX
 SG_ UNK_156_4 : 156|4@1+ (1,0) [0|15] "raw" XXX
 SG_ CONST_160_3 : 160|3@1+ (1,0) [0|7] "raw" XXX
 SG_ UNK_163_2 : 163|2@1+ (1,0) [0|3] "raw" XXX
 SG_ CONST_165_3 : 165|3@1+ (1,0) [0|7] "raw" XXX
 SG_ UNK_168_10 : 168|10@1+ (1,0) [0|1023] "raw" XXX
 SG_ CONST_178_3 : 178|3@1+ (1,0) [0|7] "raw" XXX
 SG_ UNK_181_1 : 181|1@1+ (1,0) [0|1] "raw" XXX
 SG_ CONST_182_1 : 182|1@1+ (1,0) [0|1] "raw" XXX
 SG_ UNK_183_7 : 183|7@1+ (1,0) [0|127] "raw" XXX
 SG_ CONST_190_10 : 190|10@1+ (1,0) [0|1023] "raw" XXX
 SG_ UNK_200_7 : 200|7@1+ (1,0) [0|127] "raw" XXX
 SG_ CONST_207_1 : 207|1@1+ (1,0) [0|1] "raw" XXX
 SG_ UNK_208_6 : 208|6@1+ (1,0) [0|63] "raw" XXX
 SG_ CONST_214_2 : 214|2@1+ (1,0) [0|3] "raw" XXX
 SG_ UNK_216_6 : 216|6@1+ (1,0) [0|63] "raw" XXX
 SG_ CONST_222_2 : 222|2@1+ (1,0) [0|3] "raw" XXX
 SG_ UNK_224_7 : 224|7@1+ (1,0) [0|127] "raw" XXX
 SG_ CONST_231_1 : 231|1@1+ (1,0) [0|1] "raw" XXX
 SG_ UNK_232_7 : 232|7@1+ (1,0) [0|127] "raw" XXX
 SG_ PER_TRACK_239_1 : 239|1@1+ (1,0) [0|1] "raw" XXX
 SG_ UNK_240_7 : 240|7@1+ (1,0) [0|127] "raw" XXX
 SG_ CONST_247_1 : 247|1@1+ (1,0) [0|1] "raw" XXX
 SG_ UNK_248_7 : 248|7@1+ (1,0) [0|127] "raw" XXX
 SG_ CONST_255_1 : 255|1@1+ (1,0) [0|1] "raw" XXX
 SG_ UNK_256_5 : 256|5@1+ (1,0) [0|31] "raw" XXX
 SG_ CONST_261_3 : 261|3@1+ (1,0) [0|7] "raw" XXX
 SG_ UNK_264_5 : 264|5@1+ (1,0) [0|31] "raw" XXX
 SG_ CONST_269_3 : 269|3@1+ (1,0) [0|7] "raw" XXX
 SG_ UNK_272_5 : 272|5@1+ (1,0) [0|31] "raw" XXX
 SG_ CONST_277_11 : 277|11@1+ (1,0) [0|2047] "raw" XXX

BO_ 1796 ARS510_OBJ_04: 48 RADAR
 SG_ STATE_CODE : 0|2@1+ (1,0) [0|3] "raw" XXX
 SG_ SLOT_INDEX_CODE : 2|6@1+ (1,0) [0|63] "raw" XXX
 SG_ UNK_8_6 : 8|6@1+ (1,0) [0|63] "raw" XXX
 SG_ ONCOMING_FLAG : 14|1@1+ (1,0) [0|1] "" XXX
 SG_ CONST_15_1 : 15|1@1+ (1,0) [0|1] "raw" XXX
 SG_ SCORE_CODE : 16|8@1+ (1,0) [0|255] "raw" XXX
 SG_ AGE : 24|7@1+ (1,0) [0|126] "cycles" XXX
 SG_ CONST_31_1 : 31|1@1+ (1,0) [0|1] "raw" XXX
 SG_ DREL : 32|12@1+ (0.0625,-10) [-10|245.9375] "m" XXX
 SG_ YREL_LEFT : 44|12@1+ (0.015625,-32) [-32|31.984375] "m" XXX
 SG_ UNK_56_7 : 56|7@1+ (1,0) [0|127] "raw" XXX
 SG_ CONST_63_1 : 63|1@1+ (1,0) [0|1] "raw" XXX
 SG_ VLONG_OVER_GROUND : 64|10@1+ (0.15,-76.575) [-76.575|76.875] "m/s" XXX
 SG_ VLAT_OVER_GROUND_PROV : 74|10@1+ (0.15,-76.575) [-76.575|76.875] "m/s" XXX
 SG_ ALONG_LIKE_84 : 84|10@1+ (1,-511) [-511|512] "code" XXX
 SG_ CONST_94_2 : 94|2@1+ (1,0) [0|3] "raw" XXX
 SG_ UNK_96 : 96|10@1+ (1,0) [0|1023] "raw" XXX
 SG_ UNK_106_1 : 106|1@1+ (1,0) [0|1] "raw" XXX
 SG_ UNK_107_1 : 107|1@1+ (1,0) [0|1] "raw" XXX
 SG_ CONST_108_1 : 108|1@1+ (1,0) [0|1] "raw" XXX
 SG_ MOVE_STATE : 109|2@1+ (1,0) [0|3] "" XXX
 SG_ UNK_111_4 : 111|4@1+ (1,0) [0|15] "raw" XXX
 SG_ UNK_115_8 : 115|8@1+ (1,0) [0|255] "raw" XXX
 SG_ CONST_123_5 : 123|5@1+ (1,0) [0|31] "raw" XXX
 SG_ UNK_128_2 : 128|2@1+ (1,0) [0|3] "raw" XXX
 SG_ UNK_130_1 : 130|1@1+ (1,0) [0|1] "raw" XXX
 SG_ UNK_131_4 : 131|4@1+ (1,0) [0|15] "raw" XXX
 SG_ CONST_135_1 : 135|1@1+ (1,0) [0|1] "raw" XXX
 SG_ UNK_136_6 : 136|6@1+ (1,0) [0|63] "raw" XXX
 SG_ UNK_142_1 : 142|1@1+ (1,0) [0|1] "raw" XXX
 SG_ CONST_143_5 : 143|5@1+ (1,0) [0|31] "raw" XXX
 SG_ UNK_148_8 : 148|8@1+ (1,0) [0|255] "raw" XXX
 SG_ UNK_156_4 : 156|4@1+ (1,0) [0|15] "raw" XXX
 SG_ CONST_160_3 : 160|3@1+ (1,0) [0|7] "raw" XXX
 SG_ UNK_163_2 : 163|2@1+ (1,0) [0|3] "raw" XXX
 SG_ CONST_165_3 : 165|3@1+ (1,0) [0|7] "raw" XXX
 SG_ UNK_168_10 : 168|10@1+ (1,0) [0|1023] "raw" XXX
 SG_ CONST_178_3 : 178|3@1+ (1,0) [0|7] "raw" XXX
 SG_ UNK_181_1 : 181|1@1+ (1,0) [0|1] "raw" XXX
 SG_ CONST_182_1 : 182|1@1+ (1,0) [0|1] "raw" XXX
 SG_ UNK_183_7 : 183|7@1+ (1,0) [0|127] "raw" XXX
 SG_ CONST_190_10 : 190|10@1+ (1,0) [0|1023] "raw" XXX
 SG_ UNK_200_7 : 200|7@1+ (1,0) [0|127] "raw" XXX
 SG_ CONST_207_1 : 207|1@1+ (1,0) [0|1] "raw" XXX
 SG_ UNK_208_6 : 208|6@1+ (1,0) [0|63] "raw" XXX
 SG_ CONST_214_2 : 214|2@1+ (1,0) [0|3] "raw" XXX
 SG_ UNK_216_6 : 216|6@1+ (1,0) [0|63] "raw" XXX
 SG_ CONST_222_2 : 222|2@1+ (1,0) [0|3] "raw" XXX
 SG_ UNK_224_7 : 224|7@1+ (1,0) [0|127] "raw" XXX
 SG_ CONST_231_1 : 231|1@1+ (1,0) [0|1] "raw" XXX
 SG_ UNK_232_7 : 232|7@1+ (1,0) [0|127] "raw" XXX
 SG_ PER_TRACK_239_1 : 239|1@1+ (1,0) [0|1] "raw" XXX
 SG_ UNK_240_7 : 240|7@1+ (1,0) [0|127] "raw" XXX
 SG_ CONST_247_1 : 247|1@1+ (1,0) [0|1] "raw" XXX
 SG_ UNK_248_7 : 248|7@1+ (1,0) [0|127] "raw" XXX
 SG_ CONST_255_1 : 255|1@1+ (1,0) [0|1] "raw" XXX
 SG_ UNK_256_5 : 256|5@1+ (1,0) [0|31] "raw" XXX
 SG_ CONST_261_3 : 261|3@1+ (1,0) [0|7] "raw" XXX
 SG_ UNK_264_5 : 264|5@1+ (1,0) [0|31] "raw" XXX
 SG_ CONST_269_3 : 269|3@1+ (1,0) [0|7] "raw" XXX
 SG_ UNK_272_5 : 272|5@1+ (1,0) [0|31] "raw" XXX
 SG_ CONST_277_11 : 277|11@1+ (1,0) [0|2047] "raw" XXX

BO_ 1797 ARS510_OBJ_05: 48 RADAR
 SG_ STATE_CODE : 0|2@1+ (1,0) [0|3] "raw" XXX
 SG_ SLOT_INDEX_CODE : 2|6@1+ (1,0) [0|63] "raw" XXX
 SG_ UNK_8_6 : 8|6@1+ (1,0) [0|63] "raw" XXX
 SG_ ONCOMING_FLAG : 14|1@1+ (1,0) [0|1] "" XXX
 SG_ CONST_15_1 : 15|1@1+ (1,0) [0|1] "raw" XXX
 SG_ SCORE_CODE : 16|8@1+ (1,0) [0|255] "raw" XXX
 SG_ AGE : 24|7@1+ (1,0) [0|126] "cycles" XXX
 SG_ CONST_31_1 : 31|1@1+ (1,0) [0|1] "raw" XXX
 SG_ DREL : 32|12@1+ (0.0625,-10) [-10|245.9375] "m" XXX
 SG_ YREL_LEFT : 44|12@1+ (0.015625,-32) [-32|31.984375] "m" XXX
 SG_ UNK_56_7 : 56|7@1+ (1,0) [0|127] "raw" XXX
 SG_ CONST_63_1 : 63|1@1+ (1,0) [0|1] "raw" XXX
 SG_ VLONG_OVER_GROUND : 64|10@1+ (0.15,-76.575) [-76.575|76.875] "m/s" XXX
 SG_ VLAT_OVER_GROUND_PROV : 74|10@1+ (0.15,-76.575) [-76.575|76.875] "m/s" XXX
 SG_ ALONG_LIKE_84 : 84|10@1+ (1,-511) [-511|512] "code" XXX
 SG_ CONST_94_2 : 94|2@1+ (1,0) [0|3] "raw" XXX
 SG_ UNK_96 : 96|10@1+ (1,0) [0|1023] "raw" XXX
 SG_ UNK_106_1 : 106|1@1+ (1,0) [0|1] "raw" XXX
 SG_ UNK_107_1 : 107|1@1+ (1,0) [0|1] "raw" XXX
 SG_ CONST_108_1 : 108|1@1+ (1,0) [0|1] "raw" XXX
 SG_ MOVE_STATE : 109|2@1+ (1,0) [0|3] "" XXX
 SG_ UNK_111_4 : 111|4@1+ (1,0) [0|15] "raw" XXX
 SG_ UNK_115_8 : 115|8@1+ (1,0) [0|255] "raw" XXX
 SG_ CONST_123_5 : 123|5@1+ (1,0) [0|31] "raw" XXX
 SG_ UNK_128_2 : 128|2@1+ (1,0) [0|3] "raw" XXX
 SG_ UNK_130_1 : 130|1@1+ (1,0) [0|1] "raw" XXX
 SG_ UNK_131_4 : 131|4@1+ (1,0) [0|15] "raw" XXX
 SG_ CONST_135_1 : 135|1@1+ (1,0) [0|1] "raw" XXX
 SG_ UNK_136_6 : 136|6@1+ (1,0) [0|63] "raw" XXX
 SG_ UNK_142_1 : 142|1@1+ (1,0) [0|1] "raw" XXX
 SG_ CONST_143_5 : 143|5@1+ (1,0) [0|31] "raw" XXX
 SG_ UNK_148_8 : 148|8@1+ (1,0) [0|255] "raw" XXX
 SG_ UNK_156_4 : 156|4@1+ (1,0) [0|15] "raw" XXX
 SG_ CONST_160_3 : 160|3@1+ (1,0) [0|7] "raw" XXX
 SG_ UNK_163_2 : 163|2@1+ (1,0) [0|3] "raw" XXX
 SG_ CONST_165_3 : 165|3@1+ (1,0) [0|7] "raw" XXX
 SG_ UNK_168_10 : 168|10@1+ (1,0) [0|1023] "raw" XXX
 SG_ CONST_178_3 : 178|3@1+ (1,0) [0|7] "raw" XXX
 SG_ UNK_181_1 : 181|1@1+ (1,0) [0|1] "raw" XXX
 SG_ CONST_182_1 : 182|1@1+ (1,0) [0|1] "raw" XXX
 SG_ UNK_183_7 : 183|7@1+ (1,0) [0|127] "raw" XXX
 SG_ CONST_190_10 : 190|10@1+ (1,0) [0|1023] "raw" XXX
 SG_ UNK_200_7 : 200|7@1+ (1,0) [0|127] "raw" XXX
 SG_ CONST_207_1 : 207|1@1+ (1,0) [0|1] "raw" XXX
 SG_ UNK_208_6 : 208|6@1+ (1,0) [0|63] "raw" XXX
 SG_ CONST_214_2 : 214|2@1+ (1,0) [0|3] "raw" XXX
 SG_ UNK_216_6 : 216|6@1+ (1,0) [0|63] "raw" XXX
 SG_ CONST_222_2 : 222|2@1+ (1,0) [0|3] "raw" XXX
 SG_ UNK_224_7 : 224|7@1+ (1,0) [0|127] "raw" XXX
 SG_ CONST_231_1 : 231|1@1+ (1,0) [0|1] "raw" XXX
 SG_ UNK_232_7 : 232|7@1+ (1,0) [0|127] "raw" XXX
 SG_ PER_TRACK_239_1 : 239|1@1+ (1,0) [0|1] "raw" XXX
 SG_ UNK_240_7 : 240|7@1+ (1,0) [0|127] "raw" XXX
 SG_ CONST_247_1 : 247|1@1+ (1,0) [0|1] "raw" XXX
 SG_ UNK_248_7 : 248|7@1+ (1,0) [0|127] "raw" XXX
 SG_ CONST_255_1 : 255|1@1+ (1,0) [0|1] "raw" XXX
 SG_ UNK_256_5 : 256|5@1+ (1,0) [0|31] "raw" XXX
 SG_ CONST_261_3 : 261|3@1+ (1,0) [0|7] "raw" XXX
 SG_ UNK_264_5 : 264|5@1+ (1,0) [0|31] "raw" XXX
 SG_ CONST_269_3 : 269|3@1+ (1,0) [0|7] "raw" XXX
 SG_ UNK_272_5 : 272|5@1+ (1,0) [0|31] "raw" XXX
 SG_ CONST_277_11 : 277|11@1+ (1,0) [0|2047] "raw" XXX

BO_ 1798 ARS510_OBJ_06: 48 RADAR
 SG_ STATE_CODE : 0|2@1+ (1,0) [0|3] "raw" XXX
 SG_ SLOT_INDEX_CODE : 2|6@1+ (1,0) [0|63] "raw" XXX
 SG_ UNK_8_6 : 8|6@1+ (1,0) [0|63] "raw" XXX
 SG_ ONCOMING_FLAG : 14|1@1+ (1,0) [0|1] "" XXX
 SG_ CONST_15_1 : 15|1@1+ (1,0) [0|1] "raw" XXX
 SG_ SCORE_CODE : 16|8@1+ (1,0) [0|255] "raw" XXX
 SG_ AGE : 24|7@1+ (1,0) [0|126] "cycles" XXX
 SG_ CONST_31_1 : 31|1@1+ (1,0) [0|1] "raw" XXX
 SG_ DREL : 32|12@1+ (0.0625,-10) [-10|245.9375] "m" XXX
 SG_ YREL_LEFT : 44|12@1+ (0.015625,-32) [-32|31.984375] "m" XXX
 SG_ UNK_56_7 : 56|7@1+ (1,0) [0|127] "raw" XXX
 SG_ CONST_63_1 : 63|1@1+ (1,0) [0|1] "raw" XXX
 SG_ VLONG_OVER_GROUND : 64|10@1+ (0.15,-76.575) [-76.575|76.875] "m/s" XXX
 SG_ VLAT_OVER_GROUND_PROV : 74|10@1+ (0.15,-76.575) [-76.575|76.875] "m/s" XXX
 SG_ ALONG_LIKE_84 : 84|10@1+ (1,-511) [-511|512] "code" XXX
 SG_ CONST_94_2 : 94|2@1+ (1,0) [0|3] "raw" XXX
 SG_ UNK_96 : 96|10@1+ (1,0) [0|1023] "raw" XXX
 SG_ UNK_106_1 : 106|1@1+ (1,0) [0|1] "raw" XXX
 SG_ UNK_107_1 : 107|1@1+ (1,0) [0|1] "raw" XXX
 SG_ CONST_108_1 : 108|1@1+ (1,0) [0|1] "raw" XXX
 SG_ MOVE_STATE : 109|2@1+ (1,0) [0|3] "" XXX
 SG_ UNK_111_4 : 111|4@1+ (1,0) [0|15] "raw" XXX
 SG_ UNK_115_8 : 115|8@1+ (1,0) [0|255] "raw" XXX
 SG_ CONST_123_5 : 123|5@1+ (1,0) [0|31] "raw" XXX
 SG_ UNK_128_2 : 128|2@1+ (1,0) [0|3] "raw" XXX
 SG_ UNK_130_1 : 130|1@1+ (1,0) [0|1] "raw" XXX
 SG_ UNK_131_4 : 131|4@1+ (1,0) [0|15] "raw" XXX
 SG_ CONST_135_1 : 135|1@1+ (1,0) [0|1] "raw" XXX
 SG_ UNK_136_6 : 136|6@1+ (1,0) [0|63] "raw" XXX
 SG_ UNK_142_1 : 142|1@1+ (1,0) [0|1] "raw" XXX
 SG_ CONST_143_5 : 143|5@1+ (1,0) [0|31] "raw" XXX
 SG_ UNK_148_8 : 148|8@1+ (1,0) [0|255] "raw" XXX
 SG_ UNK_156_4 : 156|4@1+ (1,0) [0|15] "raw" XXX
 SG_ CONST_160_3 : 160|3@1+ (1,0) [0|7] "raw" XXX
 SG_ UNK_163_2 : 163|2@1+ (1,0) [0|3] "raw" XXX
 SG_ CONST_165_3 : 165|3@1+ (1,0) [0|7] "raw" XXX
 SG_ UNK_168_10 : 168|10@1+ (1,0) [0|1023] "raw" XXX
 SG_ CONST_178_3 : 178|3@1+ (1,0) [0|7] "raw" XXX
 SG_ UNK_181_1 : 181|1@1+ (1,0) [0|1] "raw" XXX
 SG_ CONST_182_1 : 182|1@1+ (1,0) [0|1] "raw" XXX
 SG_ UNK_183_7 : 183|7@1+ (1,0) [0|127] "raw" XXX
 SG_ CONST_190_10 : 190|10@1+ (1,0) [0|1023] "raw" XXX
 SG_ UNK_200_7 : 200|7@1+ (1,0) [0|127] "raw" XXX
 SG_ CONST_207_1 : 207|1@1+ (1,0) [0|1] "raw" XXX
 SG_ UNK_208_6 : 208|6@1+ (1,0) [0|63] "raw" XXX
 SG_ CONST_214_2 : 214|2@1+ (1,0) [0|3] "raw" XXX
 SG_ UNK_216_6 : 216|6@1+ (1,0) [0|63] "raw" XXX
 SG_ CONST_222_2 : 222|2@1+ (1,0) [0|3] "raw" XXX
 SG_ UNK_224_7 : 224|7@1+ (1,0) [0|127] "raw" XXX
 SG_ CONST_231_1 : 231|1@1+ (1,0) [0|1] "raw" XXX
 SG_ UNK_232_7 : 232|7@1+ (1,0) [0|127] "raw" XXX
 SG_ PER_TRACK_239_1 : 239|1@1+ (1,0) [0|1] "raw" XXX
 SG_ UNK_240_7 : 240|7@1+ (1,0) [0|127] "raw" XXX
 SG_ CONST_247_1 : 247|1@1+ (1,0) [0|1] "raw" XXX
 SG_ UNK_248_7 : 248|7@1+ (1,0) [0|127] "raw" XXX
 SG_ CONST_255_1 : 255|1@1+ (1,0) [0|1] "raw" XXX
 SG_ UNK_256_5 : 256|5@1+ (1,0) [0|31] "raw" XXX
 SG_ CONST_261_3 : 261|3@1+ (1,0) [0|7] "raw" XXX
 SG_ UNK_264_5 : 264|5@1+ (1,0) [0|31] "raw" XXX
 SG_ CONST_269_3 : 269|3@1+ (1,0) [0|7] "raw" XXX
 SG_ UNK_272_5 : 272|5@1+ (1,0) [0|31] "raw" XXX
 SG_ CONST_277_11 : 277|11@1+ (1,0) [0|2047] "raw" XXX

BO_ 1799 ARS510_OBJ_07: 48 RADAR
 SG_ STATE_CODE : 0|2@1+ (1,0) [0|3] "raw" XXX
 SG_ SLOT_INDEX_CODE : 2|6@1+ (1,0) [0|63] "raw" XXX
 SG_ UNK_8_6 : 8|6@1+ (1,0) [0|63] "raw" XXX
 SG_ ONCOMING_FLAG : 14|1@1+ (1,0) [0|1] "" XXX
 SG_ CONST_15_1 : 15|1@1+ (1,0) [0|1] "raw" XXX
 SG_ SCORE_CODE : 16|8@1+ (1,0) [0|255] "raw" XXX
 SG_ AGE : 24|7@1+ (1,0) [0|126] "cycles" XXX
 SG_ CONST_31_1 : 31|1@1+ (1,0) [0|1] "raw" XXX
 SG_ DREL : 32|12@1+ (0.0625,-10) [-10|245.9375] "m" XXX
 SG_ YREL_LEFT : 44|12@1+ (0.015625,-32) [-32|31.984375] "m" XXX
 SG_ UNK_56_7 : 56|7@1+ (1,0) [0|127] "raw" XXX
 SG_ CONST_63_1 : 63|1@1+ (1,0) [0|1] "raw" XXX
 SG_ VLONG_OVER_GROUND : 64|10@1+ (0.15,-76.575) [-76.575|76.875] "m/s" XXX
 SG_ VLAT_OVER_GROUND_PROV : 74|10@1+ (0.15,-76.575) [-76.575|76.875] "m/s" XXX
 SG_ ALONG_LIKE_84 : 84|10@1+ (1,-511) [-511|512] "code" XXX
 SG_ CONST_94_2 : 94|2@1+ (1,0) [0|3] "raw" XXX
 SG_ UNK_96 : 96|10@1+ (1,0) [0|1023] "raw" XXX
 SG_ UNK_106_1 : 106|1@1+ (1,0) [0|1] "raw" XXX
 SG_ UNK_107_1 : 107|1@1+ (1,0) [0|1] "raw" XXX
 SG_ CONST_108_1 : 108|1@1+ (1,0) [0|1] "raw" XXX
 SG_ MOVE_STATE : 109|2@1+ (1,0) [0|3] "" XXX
 SG_ UNK_111_4 : 111|4@1+ (1,0) [0|15] "raw" XXX
 SG_ UNK_115_8 : 115|8@1+ (1,0) [0|255] "raw" XXX
 SG_ CONST_123_5 : 123|5@1+ (1,0) [0|31] "raw" XXX
 SG_ UNK_128_2 : 128|2@1+ (1,0) [0|3] "raw" XXX
 SG_ UNK_130_1 : 130|1@1+ (1,0) [0|1] "raw" XXX
 SG_ UNK_131_4 : 131|4@1+ (1,0) [0|15] "raw" XXX
 SG_ CONST_135_1 : 135|1@1+ (1,0) [0|1] "raw" XXX
 SG_ UNK_136_6 : 136|6@1+ (1,0) [0|63] "raw" XXX
 SG_ UNK_142_1 : 142|1@1+ (1,0) [0|1] "raw" XXX
 SG_ CONST_143_5 : 143|5@1+ (1,0) [0|31] "raw" XXX
 SG_ UNK_148_8 : 148|8@1+ (1,0) [0|255] "raw" XXX
 SG_ UNK_156_4 : 156|4@1+ (1,0) [0|15] "raw" XXX
 SG_ CONST_160_3 : 160|3@1+ (1,0) [0|7] "raw" XXX
 SG_ UNK_163_2 : 163|2@1+ (1,0) [0|3] "raw" XXX
 SG_ CONST_165_3 : 165|3@1+ (1,0) [0|7] "raw" XXX
 SG_ UNK_168_10 : 168|10@1+ (1,0) [0|1023] "raw" XXX
 SG_ CONST_178_3 : 178|3@1+ (1,0) [0|7] "raw" XXX
 SG_ UNK_181_1 : 181|1@1+ (1,0) [0|1] "raw" XXX
 SG_ CONST_182_1 : 182|1@1+ (1,0) [0|1] "raw" XXX
 SG_ UNK_183_7 : 183|7@1+ (1,0) [0|127] "raw" XXX
 SG_ CONST_190_10 : 190|10@1+ (1,0) [0|1023] "raw" XXX
 SG_ UNK_200_7 : 200|7@1+ (1,0) [0|127] "raw" XXX
 SG_ CONST_207_1 : 207|1@1+ (1,0) [0|1] "raw" XXX
 SG_ UNK_208_6 : 208|6@1+ (1,0) [0|63] "raw" XXX
 SG_ CONST_214_2 : 214|2@1+ (1,0) [0|3] "raw" XXX
 SG_ UNK_216_6 : 216|6@1+ (1,0) [0|63] "raw" XXX
 SG_ CONST_222_2 : 222|2@1+ (1,0) [0|3] "raw" XXX
 SG_ UNK_224_7 : 224|7@1+ (1,0) [0|127] "raw" XXX
 SG_ CONST_231_1 : 231|1@1+ (1,0) [0|1] "raw" XXX
 SG_ UNK_232_7 : 232|7@1+ (1,0) [0|127] "raw" XXX
 SG_ PER_TRACK_239_1 : 239|1@1+ (1,0) [0|1] "raw" XXX
 SG_ UNK_240_7 : 240|7@1+ (1,0) [0|127] "raw" XXX
 SG_ CONST_247_1 : 247|1@1+ (1,0) [0|1] "raw" XXX
 SG_ UNK_248_7 : 248|7@1+ (1,0) [0|127] "raw" XXX
 SG_ CONST_255_1 : 255|1@1+ (1,0) [0|1] "raw" XXX
 SG_ UNK_256_5 : 256|5@1+ (1,0) [0|31] "raw" XXX
 SG_ CONST_261_3 : 261|3@1+ (1,0) [0|7] "raw" XXX
 SG_ UNK_264_5 : 264|5@1+ (1,0) [0|31] "raw" XXX
 SG_ CONST_269_3 : 269|3@1+ (1,0) [0|7] "raw" XXX
 SG_ UNK_272_5 : 272|5@1+ (1,0) [0|31] "raw" XXX
 SG_ CONST_277_11 : 277|11@1+ (1,0) [0|2047] "raw" XXX

BO_ 1800 ARS510_OBJ_08: 48 RADAR
 SG_ STATE_CODE : 0|2@1+ (1,0) [0|3] "raw" XXX
 SG_ SLOT_INDEX_CODE : 2|6@1+ (1,0) [0|63] "raw" XXX
 SG_ UNK_8_6 : 8|6@1+ (1,0) [0|63] "raw" XXX
 SG_ ONCOMING_FLAG : 14|1@1+ (1,0) [0|1] "" XXX
 SG_ CONST_15_1 : 15|1@1+ (1,0) [0|1] "raw" XXX
 SG_ SCORE_CODE : 16|8@1+ (1,0) [0|255] "raw" XXX
 SG_ AGE : 24|7@1+ (1,0) [0|126] "cycles" XXX
 SG_ CONST_31_1 : 31|1@1+ (1,0) [0|1] "raw" XXX
 SG_ DREL : 32|12@1+ (0.0625,-10) [-10|245.9375] "m" XXX
 SG_ YREL_LEFT : 44|12@1+ (0.015625,-32) [-32|31.984375] "m" XXX
 SG_ UNK_56_7 : 56|7@1+ (1,0) [0|127] "raw" XXX
 SG_ CONST_63_1 : 63|1@1+ (1,0) [0|1] "raw" XXX
 SG_ VLONG_OVER_GROUND : 64|10@1+ (0.15,-76.575) [-76.575|76.875] "m/s" XXX
 SG_ VLAT_OVER_GROUND_PROV : 74|10@1+ (0.15,-76.575) [-76.575|76.875] "m/s" XXX
 SG_ ALONG_LIKE_84 : 84|10@1+ (1,-511) [-511|512] "code" XXX
 SG_ CONST_94_2 : 94|2@1+ (1,0) [0|3] "raw" XXX
 SG_ UNK_96 : 96|10@1+ (1,0) [0|1023] "raw" XXX
 SG_ UNK_106_1 : 106|1@1+ (1,0) [0|1] "raw" XXX
 SG_ UNK_107_1 : 107|1@1+ (1,0) [0|1] "raw" XXX
 SG_ CONST_108_1 : 108|1@1+ (1,0) [0|1] "raw" XXX
 SG_ MOVE_STATE : 109|2@1+ (1,0) [0|3] "" XXX
 SG_ UNK_111_4 : 111|4@1+ (1,0) [0|15] "raw" XXX
 SG_ UNK_115_8 : 115|8@1+ (1,0) [0|255] "raw" XXX
 SG_ CONST_123_5 : 123|5@1+ (1,0) [0|31] "raw" XXX
 SG_ UNK_128_2 : 128|2@1+ (1,0) [0|3] "raw" XXX
 SG_ UNK_130_1 : 130|1@1+ (1,0) [0|1] "raw" XXX
 SG_ UNK_131_4 : 131|4@1+ (1,0) [0|15] "raw" XXX
 SG_ CONST_135_1 : 135|1@1+ (1,0) [0|1] "raw" XXX
 SG_ UNK_136_6 : 136|6@1+ (1,0) [0|63] "raw" XXX
 SG_ UNK_142_1 : 142|1@1+ (1,0) [0|1] "raw" XXX
 SG_ CONST_143_5 : 143|5@1+ (1,0) [0|31] "raw" XXX
 SG_ UNK_148_8 : 148|8@1+ (1,0) [0|255] "raw" XXX
 SG_ UNK_156_4 : 156|4@1+ (1,0) [0|15] "raw" XXX
 SG_ CONST_160_3 : 160|3@1+ (1,0) [0|7] "raw" XXX
 SG_ UNK_163_2 : 163|2@1+ (1,0) [0|3] "raw" XXX
 SG_ CONST_165_3 : 165|3@1+ (1,0) [0|7] "raw" XXX
 SG_ UNK_168_10 : 168|10@1+ (1,0) [0|1023] "raw" XXX
 SG_ CONST_178_3 : 178|3@1+ (1,0) [0|7] "raw" XXX
 SG_ UNK_181_1 : 181|1@1+ (1,0) [0|1] "raw" XXX
 SG_ CONST_182_1 : 182|1@1+ (1,0) [0|1] "raw" XXX
 SG_ UNK_183_7 : 183|7@1+ (1,0) [0|127] "raw" XXX
 SG_ CONST_190_10 : 190|10@1+ (1,0) [0|1023] "raw" XXX
 SG_ UNK_200_7 : 200|7@1+ (1,0) [0|127] "raw" XXX
 SG_ CONST_207_1 : 207|1@1+ (1,0) [0|1] "raw" XXX
 SG_ UNK_208_6 : 208|6@1+ (1,0) [0|63] "raw" XXX
 SG_ CONST_214_2 : 214|2@1+ (1,0) [0|3] "raw" XXX
 SG_ UNK_216_6 : 216|6@1+ (1,0) [0|63] "raw" XXX
 SG_ CONST_222_2 : 222|2@1+ (1,0) [0|3] "raw" XXX
 SG_ UNK_224_7 : 224|7@1+ (1,0) [0|127] "raw" XXX
 SG_ CONST_231_1 : 231|1@1+ (1,0) [0|1] "raw" XXX
 SG_ UNK_232_7 : 232|7@1+ (1,0) [0|127] "raw" XXX
 SG_ PER_TRACK_239_1 : 239|1@1+ (1,0) [0|1] "raw" XXX
 SG_ UNK_240_7 : 240|7@1+ (1,0) [0|127] "raw" XXX
 SG_ CONST_247_1 : 247|1@1+ (1,0) [0|1] "raw" XXX
 SG_ UNK_248_7 : 248|7@1+ (1,0) [0|127] "raw" XXX
 SG_ CONST_255_1 : 255|1@1+ (1,0) [0|1] "raw" XXX
 SG_ UNK_256_5 : 256|5@1+ (1,0) [0|31] "raw" XXX
 SG_ CONST_261_3 : 261|3@1+ (1,0) [0|7] "raw" XXX
 SG_ UNK_264_5 : 264|5@1+ (1,0) [0|31] "raw" XXX
 SG_ CONST_269_3 : 269|3@1+ (1,0) [0|7] "raw" XXX
 SG_ UNK_272_5 : 272|5@1+ (1,0) [0|31] "raw" XXX
 SG_ CONST_277_11 : 277|11@1+ (1,0) [0|2047] "raw" XXX

BO_ 1801 ARS510_OBJ_09: 48 RADAR
 SG_ STATE_CODE : 0|2@1+ (1,0) [0|3] "raw" XXX
 SG_ SLOT_INDEX_CODE : 2|6@1+ (1,0) [0|63] "raw" XXX
 SG_ UNK_8_6 : 8|6@1+ (1,0) [0|63] "raw" XXX
 SG_ ONCOMING_FLAG : 14|1@1+ (1,0) [0|1] "" XXX
 SG_ CONST_15_1 : 15|1@1+ (1,0) [0|1] "raw" XXX
 SG_ SCORE_CODE : 16|8@1+ (1,0) [0|255] "raw" XXX
 SG_ AGE : 24|7@1+ (1,0) [0|126] "cycles" XXX
 SG_ CONST_31_1 : 31|1@1+ (1,0) [0|1] "raw" XXX
 SG_ DREL : 32|12@1+ (0.0625,-10) [-10|245.9375] "m" XXX
 SG_ YREL_LEFT : 44|12@1+ (0.015625,-32) [-32|31.984375] "m" XXX
 SG_ UNK_56_7 : 56|7@1+ (1,0) [0|127] "raw" XXX
 SG_ CONST_63_1 : 63|1@1+ (1,0) [0|1] "raw" XXX
 SG_ VLONG_OVER_GROUND : 64|10@1+ (0.15,-76.575) [-76.575|76.875] "m/s" XXX
 SG_ VLAT_OVER_GROUND_PROV : 74|10@1+ (0.15,-76.575) [-76.575|76.875] "m/s" XXX
 SG_ ALONG_LIKE_84 : 84|10@1+ (1,-511) [-511|512] "code" XXX
 SG_ CONST_94_2 : 94|2@1+ (1,0) [0|3] "raw" XXX
 SG_ UNK_96 : 96|10@1+ (1,0) [0|1023] "raw" XXX
 SG_ UNK_106_1 : 106|1@1+ (1,0) [0|1] "raw" XXX
 SG_ UNK_107_1 : 107|1@1+ (1,0) [0|1] "raw" XXX
 SG_ CONST_108_1 : 108|1@1+ (1,0) [0|1] "raw" XXX
 SG_ MOVE_STATE : 109|2@1+ (1,0) [0|3] "" XXX
 SG_ UNK_111_4 : 111|4@1+ (1,0) [0|15] "raw" XXX
 SG_ UNK_115_8 : 115|8@1+ (1,0) [0|255] "raw" XXX
 SG_ CONST_123_5 : 123|5@1+ (1,0) [0|31] "raw" XXX
 SG_ UNK_128_2 : 128|2@1+ (1,0) [0|3] "raw" XXX
 SG_ UNK_130_1 : 130|1@1+ (1,0) [0|1] "raw" XXX
 SG_ UNK_131_4 : 131|4@1+ (1,0) [0|15] "raw" XXX
 SG_ CONST_135_1 : 135|1@1+ (1,0) [0|1] "raw" XXX
 SG_ UNK_136_6 : 136|6@1+ (1,0) [0|63] "raw" XXX
 SG_ UNK_142_1 : 142|1@1+ (1,0) [0|1] "raw" XXX
 SG_ CONST_143_5 : 143|5@1+ (1,0) [0|31] "raw" XXX
 SG_ UNK_148_8 : 148|8@1+ (1,0) [0|255] "raw" XXX
 SG_ UNK_156_4 : 156|4@1+ (1,0) [0|15] "raw" XXX
 SG_ CONST_160_3 : 160|3@1+ (1,0) [0|7] "raw" XXX
 SG_ UNK_163_2 : 163|2@1+ (1,0) [0|3] "raw" XXX
 SG_ CONST_165_3 : 165|3@1+ (1,0) [0|7] "raw" XXX
 SG_ UNK_168_10 : 168|10@1+ (1,0) [0|1023] "raw" XXX
 SG_ CONST_178_3 : 178|3@1+ (1,0) [0|7] "raw" XXX
 SG_ UNK_181_1 : 181|1@1+ (1,0) [0|1] "raw" XXX
 SG_ CONST_182_1 : 182|1@1+ (1,0) [0|1] "raw" XXX
 SG_ UNK_183_7 : 183|7@1+ (1,0) [0|127] "raw" XXX
 SG_ CONST_190_10 : 190|10@1+ (1,0) [0|1023] "raw" XXX
 SG_ UNK_200_7 : 200|7@1+ (1,0) [0|127] "raw" XXX
 SG_ CONST_207_1 : 207|1@1+ (1,0) [0|1] "raw" XXX
 SG_ UNK_208_6 : 208|6@1+ (1,0) [0|63] "raw" XXX
 SG_ CONST_214_2 : 214|2@1+ (1,0) [0|3] "raw" XXX
 SG_ UNK_216_6 : 216|6@1+ (1,0) [0|63] "raw" XXX
 SG_ CONST_222_2 : 222|2@1+ (1,0) [0|3] "raw" XXX
 SG_ UNK_224_7 : 224|7@1+ (1,0) [0|127] "raw" XXX
 SG_ CONST_231_1 : 231|1@1+ (1,0) [0|1] "raw" XXX
 SG_ UNK_232_7 : 232|7@1+ (1,0) [0|127] "raw" XXX
 SG_ PER_TRACK_239_1 : 239|1@1+ (1,0) [0|1] "raw" XXX
 SG_ UNK_240_7 : 240|7@1+ (1,0) [0|127] "raw" XXX
 SG_ CONST_247_1 : 247|1@1+ (1,0) [0|1] "raw" XXX
 SG_ UNK_248_7 : 248|7@1+ (1,0) [0|127] "raw" XXX
 SG_ CONST_255_1 : 255|1@1+ (1,0) [0|1] "raw" XXX
 SG_ UNK_256_5 : 256|5@1+ (1,0) [0|31] "raw" XXX
 SG_ CONST_261_3 : 261|3@1+ (1,0) [0|7] "raw" XXX
 SG_ UNK_264_5 : 264|5@1+ (1,0) [0|31] "raw" XXX
 SG_ CONST_269_3 : 269|3@1+ (1,0) [0|7] "raw" XXX
 SG_ UNK_272_5 : 272|5@1+ (1,0) [0|31] "raw" XXX
 SG_ CONST_277_11 : 277|11@1+ (1,0) [0|2047] "raw" XXX

BO_ 1802 ARS510_OBJ_10: 48 RADAR
 SG_ STATE_CODE : 0|2@1+ (1,0) [0|3] "raw" XXX
 SG_ SLOT_INDEX_CODE : 2|6@1+ (1,0) [0|63] "raw" XXX
 SG_ UNK_8_6 : 8|6@1+ (1,0) [0|63] "raw" XXX
 SG_ ONCOMING_FLAG : 14|1@1+ (1,0) [0|1] "" XXX
 SG_ CONST_15_1 : 15|1@1+ (1,0) [0|1] "raw" XXX
 SG_ SCORE_CODE : 16|8@1+ (1,0) [0|255] "raw" XXX
 SG_ AGE : 24|7@1+ (1,0) [0|126] "cycles" XXX
 SG_ CONST_31_1 : 31|1@1+ (1,0) [0|1] "raw" XXX
 SG_ DREL : 32|12@1+ (0.0625,-10) [-10|245.9375] "m" XXX
 SG_ YREL_LEFT : 44|12@1+ (0.015625,-32) [-32|31.984375] "m" XXX
 SG_ UNK_56_7 : 56|7@1+ (1,0) [0|127] "raw" XXX
 SG_ CONST_63_1 : 63|1@1+ (1,0) [0|1] "raw" XXX
 SG_ VLONG_OVER_GROUND : 64|10@1+ (0.15,-76.575) [-76.575|76.875] "m/s" XXX
 SG_ VLAT_OVER_GROUND_PROV : 74|10@1+ (0.15,-76.575) [-76.575|76.875] "m/s" XXX
 SG_ ALONG_LIKE_84 : 84|10@1+ (1,-511) [-511|512] "code" XXX
 SG_ CONST_94_2 : 94|2@1+ (1,0) [0|3] "raw" XXX
 SG_ UNK_96 : 96|10@1+ (1,0) [0|1023] "raw" XXX
 SG_ UNK_106_1 : 106|1@1+ (1,0) [0|1] "raw" XXX
 SG_ UNK_107_1 : 107|1@1+ (1,0) [0|1] "raw" XXX
 SG_ CONST_108_1 : 108|1@1+ (1,0) [0|1] "raw" XXX
 SG_ MOVE_STATE : 109|2@1+ (1,0) [0|3] "" XXX
 SG_ UNK_111_4 : 111|4@1+ (1,0) [0|15] "raw" XXX
 SG_ UNK_115_8 : 115|8@1+ (1,0) [0|255] "raw" XXX
 SG_ CONST_123_5 : 123|5@1+ (1,0) [0|31] "raw" XXX
 SG_ UNK_128_2 : 128|2@1+ (1,0) [0|3] "raw" XXX
 SG_ UNK_130_1 : 130|1@1+ (1,0) [0|1] "raw" XXX
 SG_ UNK_131_4 : 131|4@1+ (1,0) [0|15] "raw" XXX
 SG_ CONST_135_1 : 135|1@1+ (1,0) [0|1] "raw" XXX
 SG_ UNK_136_6 : 136|6@1+ (1,0) [0|63] "raw" XXX
 SG_ UNK_142_1 : 142|1@1+ (1,0) [0|1] "raw" XXX
 SG_ CONST_143_5 : 143|5@1+ (1,0) [0|31] "raw" XXX
 SG_ UNK_148_8 : 148|8@1+ (1,0) [0|255] "raw" XXX
 SG_ UNK_156_4 : 156|4@1+ (1,0) [0|15] "raw" XXX
 SG_ CONST_160_3 : 160|3@1+ (1,0) [0|7] "raw" XXX
 SG_ UNK_163_2 : 163|2@1+ (1,0) [0|3] "raw" XXX
 SG_ CONST_165_3 : 165|3@1+ (1,0) [0|7] "raw" XXX
 SG_ UNK_168_10 : 168|10@1+ (1,0) [0|1023] "raw" XXX
 SG_ CONST_178_3 : 178|3@1+ (1,0) [0|7] "raw" XXX
 SG_ UNK_181_1 : 181|1@1+ (1,0) [0|1] "raw" XXX
 SG_ CONST_182_1 : 182|1@1+ (1,0) [0|1] "raw" XXX
 SG_ UNK_183_7 : 183|7@1+ (1,0) [0|127] "raw" XXX
 SG_ CONST_190_10 : 190|10@1+ (1,0) [0|1023] "raw" XXX
 SG_ UNK_200_7 : 200|7@1+ (1,0) [0|127] "raw" XXX
 SG_ CONST_207_1 : 207|1@1+ (1,0) [0|1] "raw" XXX
 SG_ UNK_208_6 : 208|6@1+ (1,0) [0|63] "raw" XXX
 SG_ CONST_214_2 : 214|2@1+ (1,0) [0|3] "raw" XXX
 SG_ UNK_216_6 : 216|6@1+ (1,0) [0|63] "raw" XXX
 SG_ CONST_222_2 : 222|2@1+ (1,0) [0|3] "raw" XXX
 SG_ UNK_224_7 : 224|7@1+ (1,0) [0|127] "raw" XXX
 SG_ CONST_231_1 : 231|1@1+ (1,0) [0|1] "raw" XXX
 SG_ UNK_232_7 : 232|7@1+ (1,0) [0|127] "raw" XXX
 SG_ PER_TRACK_239_1 : 239|1@1+ (1,0) [0|1] "raw" XXX
 SG_ UNK_240_7 : 240|7@1+ (1,0) [0|127] "raw" XXX
 SG_ CONST_247_1 : 247|1@1+ (1,0) [0|1] "raw" XXX
 SG_ UNK_248_7 : 248|7@1+ (1,0) [0|127] "raw" XXX
 SG_ CONST_255_1 : 255|1@1+ (1,0) [0|1] "raw" XXX
 SG_ UNK_256_5 : 256|5@1+ (1,0) [0|31] "raw" XXX
 SG_ CONST_261_3 : 261|3@1+ (1,0) [0|7] "raw" XXX
 SG_ UNK_264_5 : 264|5@1+ (1,0) [0|31] "raw" XXX
 SG_ CONST_269_3 : 269|3@1+ (1,0) [0|7] "raw" XXX
 SG_ UNK_272_5 : 272|5@1+ (1,0) [0|31] "raw" XXX
 SG_ CONST_277_11 : 277|11@1+ (1,0) [0|2047] "raw" XXX

BO_ 1803 ARS510_OBJ_11: 48 RADAR
 SG_ STATE_CODE : 0|2@1+ (1,0) [0|3] "raw" XXX
 SG_ SLOT_INDEX_CODE : 2|6@1+ (1,0) [0|63] "raw" XXX
 SG_ UNK_8_6 : 8|6@1+ (1,0) [0|63] "raw" XXX
 SG_ ONCOMING_FLAG : 14|1@1+ (1,0) [0|1] "" XXX
 SG_ CONST_15_1 : 15|1@1+ (1,0) [0|1] "raw" XXX
 SG_ SCORE_CODE : 16|8@1+ (1,0) [0|255] "raw" XXX
 SG_ AGE : 24|7@1+ (1,0) [0|126] "cycles" XXX
 SG_ CONST_31_1 : 31|1@1+ (1,0) [0|1] "raw" XXX
 SG_ DREL : 32|12@1+ (0.0625,-10) [-10|245.9375] "m" XXX
 SG_ YREL_LEFT : 44|12@1+ (0.015625,-32) [-32|31.984375] "m" XXX
 SG_ UNK_56_7 : 56|7@1+ (1,0) [0|127] "raw" XXX
 SG_ CONST_63_1 : 63|1@1+ (1,0) [0|1] "raw" XXX
 SG_ VLONG_OVER_GROUND : 64|10@1+ (0.15,-76.575) [-76.575|76.875] "m/s" XXX
 SG_ VLAT_OVER_GROUND_PROV : 74|10@1+ (0.15,-76.575) [-76.575|76.875] "m/s" XXX
 SG_ ALONG_LIKE_84 : 84|10@1+ (1,-511) [-511|512] "code" XXX
 SG_ CONST_94_2 : 94|2@1+ (1,0) [0|3] "raw" XXX
 SG_ UNK_96 : 96|10@1+ (1,0) [0|1023] "raw" XXX
 SG_ UNK_106_1 : 106|1@1+ (1,0) [0|1] "raw" XXX
 SG_ UNK_107_1 : 107|1@1+ (1,0) [0|1] "raw" XXX
 SG_ CONST_108_1 : 108|1@1+ (1,0) [0|1] "raw" XXX
 SG_ MOVE_STATE : 109|2@1+ (1,0) [0|3] "" XXX
 SG_ UNK_111_4 : 111|4@1+ (1,0) [0|15] "raw" XXX
 SG_ UNK_115_8 : 115|8@1+ (1,0) [0|255] "raw" XXX
 SG_ CONST_123_5 : 123|5@1+ (1,0) [0|31] "raw" XXX
 SG_ UNK_128_2 : 128|2@1+ (1,0) [0|3] "raw" XXX
 SG_ UNK_130_1 : 130|1@1+ (1,0) [0|1] "raw" XXX
 SG_ UNK_131_4 : 131|4@1+ (1,0) [0|15] "raw" XXX
 SG_ CONST_135_1 : 135|1@1+ (1,0) [0|1] "raw" XXX
 SG_ UNK_136_6 : 136|6@1+ (1,0) [0|63] "raw" XXX
 SG_ UNK_142_1 : 142|1@1+ (1,0) [0|1] "raw" XXX
 SG_ CONST_143_5 : 143|5@1+ (1,0) [0|31] "raw" XXX
 SG_ UNK_148_8 : 148|8@1+ (1,0) [0|255] "raw" XXX
 SG_ UNK_156_4 : 156|4@1+ (1,0) [0|15] "raw" XXX
 SG_ CONST_160_3 : 160|3@1+ (1,0) [0|7] "raw" XXX
 SG_ UNK_163_2 : 163|2@1+ (1,0) [0|3] "raw" XXX
 SG_ CONST_165_3 : 165|3@1+ (1,0) [0|7] "raw" XXX
 SG_ UNK_168_10 : 168|10@1+ (1,0) [0|1023] "raw" XXX
 SG_ CONST_178_3 : 178|3@1+ (1,0) [0|7] "raw" XXX
 SG_ UNK_181_1 : 181|1@1+ (1,0) [0|1] "raw" XXX
 SG_ CONST_182_1 : 182|1@1+ (1,0) [0|1] "raw" XXX
 SG_ UNK_183_7 : 183|7@1+ (1,0) [0|127] "raw" XXX
 SG_ CONST_190_10 : 190|10@1+ (1,0) [0|1023] "raw" XXX
 SG_ UNK_200_7 : 200|7@1+ (1,0) [0|127] "raw" XXX
 SG_ CONST_207_1 : 207|1@1+ (1,0) [0|1] "raw" XXX
 SG_ UNK_208_6 : 208|6@1+ (1,0) [0|63] "raw" XXX
 SG_ CONST_214_2 : 214|2@1+ (1,0) [0|3] "raw" XXX
 SG_ UNK_216_6 : 216|6@1+ (1,0) [0|63] "raw" XXX
 SG_ CONST_222_2 : 222|2@1+ (1,0) [0|3] "raw" XXX
 SG_ UNK_224_7 : 224|7@1+ (1,0) [0|127] "raw" XXX
 SG_ CONST_231_1 : 231|1@1+ (1,0) [0|1] "raw" XXX
 SG_ UNK_232_7 : 232|7@1+ (1,0) [0|127] "raw" XXX
 SG_ PER_TRACK_239_1 : 239|1@1+ (1,0) [0|1] "raw" XXX
 SG_ UNK_240_7 : 240|7@1+ (1,0) [0|127] "raw" XXX
 SG_ CONST_247_1 : 247|1@1+ (1,0) [0|1] "raw" XXX
 SG_ UNK_248_7 : 248|7@1+ (1,0) [0|127] "raw" XXX
 SG_ CONST_255_1 : 255|1@1+ (1,0) [0|1] "raw" XXX
 SG_ UNK_256_5 : 256|5@1+ (1,0) [0|31] "raw" XXX
 SG_ CONST_261_3 : 261|3@1+ (1,0) [0|7] "raw" XXX
 SG_ UNK_264_5 : 264|5@1+ (1,0) [0|31] "raw" XXX
 SG_ CONST_269_3 : 269|3@1+ (1,0) [0|7] "raw" XXX
 SG_ UNK_272_5 : 272|5@1+ (1,0) [0|31] "raw" XXX
 SG_ CONST_277_11 : 277|11@1+ (1,0) [0|2047] "raw" XXX

CM_ "Virtual-bus view of the ARS510 0x80 / 0x85 records. Only valid for logs produced by tools/build_cabana_route.py.";
CM_ BO_ 1792 "Reassembled 0x80 object slot 0 (record bytes 17-52), sent only when occupied. Little-endian bit field: bit 0 = LSB of slot byte 0.";
CM_ SG_ 1792 STATE_CODE "Raw lifecycle state. Measured/predicted semantics not proved; not an accuracy gate.";
CM_ SG_ 1792 SLOT_INDEX_CODE "Physical slot index or 63 in unallocated-form headers; verified against slot positions. Not class or reference point.";
CM_ SG_ 1792 UNK_8_6 "Candidate from the carry-chain split, unverified: LSB flips 0.103 per cycle, 32 distinct values 30..62. Strongest correlation: age r=+0.55. Ramps up with age and saturates at 62; tracks range and scenario, not measured error.";
CM_ SG_ 1792 ONCOMING_FLAG "1 = oncoming now or earlier in the track life (persists after an oncoming object slows). Pre-registered test on unseen segments: over-ground speed < 0 on 100% of flagged rows, 88.5% of objects approaching faster than 2 m/s flagged (docs/14).";
CM_ SG_ 1792 CONST_15_1 "Constant 0 (0x0) in every record observed: reserved/padding or configuration.";
CM_ SG_ 1792 SCORE_CODE "Bounded score-like byte, not calibrated confidence or percent. Value 100 does not guarantee accurate geometry or velocity.";
CM_ SG_ 1792 AGE "Track age in radar cycles (~60 ms): 1 at birth, saturates at 126; 0 = slot being retired (geometry is the previous occupant's). A restart is a new track. Tracks younger than ~60 carry unconverged range and velocity.";
CM_ SG_ 1792 CONST_31_1 "Constant 0 (0x0) in every record observed: reserved/padding or configuration.";
CM_ SG_ 1792 DREL "Longitudinal distance forward of the radar, m. 1/16 m, zero code 160 (exactly -10 m). Camera ground contact at 5-25 m: slope 0.99-1.00 on three drives, zero within 0.2 m (0.7 m on a hilly drive). Settled tracks walk by metres record to record at 40 m+; young tracks can be far off.";
CM_ SG_ 1792 YREL_LEFT "Lateral offset, LEFT positive (openpilot yRel), m. 1/64 m, offset binary around 2048. Cartesian (constant across range), not an angle. Correct side 97.9-99.3% on held-out drives; scale bounded to about +/-10%. |code-2048| >= 2000 is a sentinel.";
CM_ SG_ 1792 UNK_56_7 "Candidate from the carry-chain split, unverified: LSB flips 0.355 per cycle, 84 distinct values 4..96. Strongest correlation: age r=+0.30. Size / class candidate: per-track median follows camera vehicle height (partial rho 0.48-0.61 at fixed range) and truck/bus class (docs/14).";
CM_ SG_ 1792 CONST_63_1 "Constant 0 (0x0) in every record observed: reserved/padding or configuration.";
CM_ SG_ 1792 VLONG_OVER_GROUND "Longitudinal velocity OVER GROUND, m/s. 0.15 m/s/code, zero 510.5. vRel = this - ego speed. Radar-only scale check (own range slope vs GPS ego) gives 0.150/0.149/0.153 on three drives. Beats zero and range differencing against a camera reference, but has unflagged ~1 s excursions at range. Unsettled for age < ~60.";
CM_ SG_ 1792 VLAT_OVER_GROUND_PROV "Lateral velocity over ground, LEFT positive (sign confirmed). Scale NOT pinned: the factor shown (0.15) is a placeholder. Radar-only estimates from its own lateral position change range 0.097-0.147 m/s per code across data sets, and the pre-registered test was unverified. See docs/14.";
CM_ SG_ 1792 ALONG_LIKE_84 "Acceleration-like, zero code 511 at standstill. Follows the VLONG change with a ~0.5 s lag, so it cannot flag or lead a velocity excursion. Radar-only scale about 0.04 m/s^2 per code on most data but drive-dependent (0.03-0.11); centred codes (docs/14).";
CM_ SG_ 1792 CONST_94_2 "Constant 0 (0x0) in every record observed: reserved/padding or configuration.";
CM_ SG_ 1792 UNK_96 "Unnamed 10-bit carry chain centred near 511; no relation to velocity or range error on three drives.";
CM_ SG_ 1792 UNK_106_1 "Candidate from the carry-chain split, unverified: LSB flips 0.003 per cycle, 2 distinct values 0..1. Strongest correlation: v_over_ground r=-0.14.";
CM_ SG_ 1792 UNK_107_1 "Candidate from the carry-chain split, unverified: LSB flips 0.013 per cycle, 2 distinct values 0..1. Strongest correlation: v_over_ground r=-0.24. Coasting-flag candidate: about 0.02 in settled life, 0.5-0.66 just before deletion (docs/14).";
CM_ SG_ 1792 CONST_108_1 "Constant 0 (0x0) in every record observed: reserved/padding or configuration.";
CM_ SG_ 1792 MOVE_STATE "Movement state. 0 = moving away / same direction, 2 = moving toward (oncoming), 1 and 3 = not clearly moving (1 vs 3 unresolved). Pre-registered test on unseen segments: value 0 had over-ground speed > 0.5 m/s on 99.65% of rows, value 2 < -0.5 m/s on 99.88%, values 1/3 |v| < 2 m/s on 89.5% (docs/14).";
CM_ SG_ 1792 UNK_111_4 "Candidate from the carry-chain split, unverified: LSB flips 0.008 per cycle, 10 distinct values 0..9. Strongest correlation: dRel r=-0.53.";
CM_ SG_ 1792 UNK_115_8 "Candidate from the carry-chain split, unverified: LSB flips 0.052 per cycle, 26 distinct values 0..178. Strongest correlation: age r=+0.27.";
CM_ SG_ 1792 CONST_123_5 "Constant 31 (0x1F) in every record observed: reserved/padding or configuration.";
CM_ SG_ 1792 UNK_128_2 "Candidate from the carry-chain split, unverified: LSB flips 0.013 per cycle, 4 distinct values 0..3. Strongest correlation: dRel r=+0.11.";
CM_ SG_ 1792 UNK_130_1 "Candidate from the carry-chain split, unverified: LSB flips 0.019 per cycle, 2 distinct values 0..1. Strongest correlation: abs_yRel r=+0.34.";
CM_ SG_ 1792 UNK_131_4 "Candidate from the carry-chain split, unverified: LSB flips 0.102 per cycle, 9 distinct values 7..15. Strongest correlation: abs_yRel r=+0.09.";
CM_ SG_ 1792 CONST_135_1 "Constant 0 (0x0) in every record observed: reserved/padding or configuration.";
CM_ SG_ 1792 UNK_136_6 "Candidate from the carry-chain split, unverified: LSB flips 0.093 per cycle, 39 distinct values 3..63. Strongest correlation: age r=+0.20.";
CM_ SG_ 1792 UNK_142_1 "Candidate from the carry-chain split, unverified: LSB flips 0.007 per cycle, 2 distinct values 0..1. Strongest correlation: age r=+0.47.";
CM_ SG_ 1792 CONST_143_5 "Constant 30 (0x1E) in every record observed: reserved/padding or configuration.";
CM_ SG_ 1792 UNK_148_8 "Candidate from the carry-chain split, unverified: LSB flips 0.009 per cycle, 27 distinct values 0..240. Strongest correlation: dRel r=-0.12.";
CM_ SG_ 1792 UNK_156_4 "Candidate from the carry-chain split, unverified: LSB flips 0.016 per cycle, 16 distinct values 0..15. Strongest correlation: abs_yRel r=-0.42.";
CM_ SG_ 1792 CONST_160_3 "Constant 0 (0x0) in every record observed: reserved/padding or configuration.";
CM_ SG_ 1792 UNK_163_2 "Candidate from the carry-chain split, unverified: LSB flips 0.006 per cycle, 3 distinct values 1..3. Strongest correlation: age r=+0.30.";
CM_ SG_ 1792 CONST_165_3 "Constant 0 (0x0) in every record observed: reserved/padding or configuration.";
CM_ SG_ 1792 UNK_168_10 "Candidate from the carry-chain split, unverified: LSB flips 0.066 per cycle, 3 distinct values 0..1023. Strongest correlation: abs_yRel r=+0.14.";
CM_ SG_ 1792 CONST_178_3 "Constant 0 (0x0) in every record observed: reserved/padding or configuration.";
CM_ SG_ 1792 UNK_181_1 "Candidate from the carry-chain split, unverified: LSB flips 0.071 per cycle, 2 distinct values 0..1. Strongest correlation: v_over_ground r=+0.34.";
CM_ SG_ 1792 CONST_182_1 "Constant 0 (0x0) in every record observed: reserved/padding or configuration.";
CM_ SG_ 1792 UNK_183_7 "Candidate from the carry-chain split, unverified: LSB flips 0.009 per cycle, 24 distinct values 26..73. Strongest correlation: age r=+0.20.";
CM_ SG_ 1792 CONST_190_10 "Constant 1 (0x1) in every record observed: reserved/padding or configuration.";
CM_ SG_ 1792 UNK_200_7 "Candidate from the carry-chain split, unverified: LSB flips 0.023 per cycle, 16 distinct values 0..127. Strongest correlation: v_over_ground r=-0.45.";
CM_ SG_ 1792 CONST_207_1 "Constant 0 (0x0) in every record observed: reserved/padding or configuration.";
CM_ SG_ 1792 UNK_208_6 "Candidate from the carry-chain split, unverified: LSB flips 0.017 per cycle, 20 distinct values 0..63. Strongest correlation: v_over_ground r=-0.38.";
CM_ SG_ 1792 CONST_214_2 "Constant 0 (0x0) in every record observed: reserved/padding or configuration.";
CM_ SG_ 1792 UNK_216_6 "Candidate from the carry-chain split, unverified: LSB flips 0.150 per cycle, 34 distinct values 3..49. Strongest correlation: age r=+0.23. Size / class candidate: camera vehicle height partial rho 0.44-0.63, truck/bus 0.35-0.42; width on A/C. Compare ARS4-B Length / dZ (6 bits) (docs/14).";
CM_ SG_ 1792 CONST_222_2 "Constant 0 (0x0) in every record observed: reserved/padding or configuration.";
CM_ SG_ 1792 UNK_224_7 "Candidate from the carry-chain split, unverified: LSB flips 0.344 per cycle, 127 distinct values 1..127. Strongest correlation: dRel r=+0.80. Uncertainty candidate: scales with range (r~0.8), falls with age at fixed range (rho -0.29 to -0.36), larger when range steps are noisier, rises before deletion. Weak near-range error indicator; does not single out excursions.";
CM_ SG_ 1792 CONST_231_1 "Constant 0 (0x0) in every record observed: reserved/padding or configuration.";
CM_ SG_ 1792 UNK_232_7 "Candidate from the carry-chain split, unverified: LSB flips 0.096 per cycle, 72 distinct values 0..127. Strongest correlation: abs_yRel r=+0.60. Lateral-uncertainty candidate: scales with |yRel| (r~0.6), falls with age at fixed range (rho -0.50 to -0.59).";
CM_ SG_ 1792 PER_TRACK_239_1 "Constant within a track, differs between tracks (2 values 0..1): object attribute candidate, unverified. Strongest correlation: abs_yRel r=+0.09.";
CM_ SG_ 1792 UNK_240_7 "Candidate from the carry-chain split, unverified: LSB flips 0.364 per cycle, 127 distinct values 1..127. Strongest correlation: dRel r=+0.80. Velocity-uncertainty candidate (like ARS408 VrelLong_rms): scales with range, falls with age, rises before deletion. Higher when native vRel disagrees with the camera by > 2 m/s (stratified AUC ~0.62 on drives A-C); moderate, not a clean excursion flag (docs/14). Decoded as vel_unc_code.";
CM_ SG_ 1792 CONST_247_1 "Constant 0 (0x0) in every record observed: reserved/padding or configuration.";
CM_ SG_ 1792 UNK_248_7 "Candidate from the carry-chain split, unverified: LSB flips 0.116 per cycle, 97 distinct values 0..127. Strongest correlation: abs_yRel r=+0.56. Uncertainty candidate: scales with |yRel| (r~0.56), falls with age at fixed range (rho -0.70 to -0.75).";
CM_ SG_ 1792 CONST_255_1 "Constant 0 (0x0) in every record observed: reserved/padding or configuration.";
CM_ SG_ 1792 UNK_256_5 "Candidate from the carry-chain split, unverified: LSB flips 0.177 per cycle, 30 distinct values 0..30. Strongest correlation: age r=+0.72. Existence / confidence candidate: rises with age at fixed range (rho +0.86 to +0.90), drops about 1.5 codes before deletion. Compare ARS4-B ProbExist (5 bits).";
CM_ SG_ 1792 CONST_261_3 "Constant 0 (0x0) in every record observed: reserved/padding or configuration.";
CM_ SG_ 1792 UNK_264_5 "Candidate from the carry-chain split, unverified: LSB flips 0.100 per cycle, 19 distinct values 0..18. Strongest correlation: age r=-0.81. Uncertainty candidate: falls with age at fixed range (rho -0.61 to -0.68), rises before deletion.";
CM_ SG_ 1792 CONST_269_3 "Constant 0 (0x0) in every record observed: reserved/padding or configuration.";
CM_ SG_ 1792 UNK_272_5 "Candidate from the carry-chain split, unverified: LSB flips 0.095 per cycle, 17 distinct values 2..18. Strongest correlation: age r=+0.30. Size / class candidate: camera vehicle height partial rho 0.41-0.71, width 0.36-0.69, truck/bus 0.24-0.39 (docs/14).";
CM_ SG_ 1792 CONST_277_11 "Constant 0 (0x0) in every record observed: reserved/padding or configuration.";
CM_ BO_ 1793 "Reassembled 0x80 object slot 1 (record bytes 53-88), sent only when occupied. Little-endian bit field: bit 0 = LSB of slot byte 0.";
CM_ SG_ 1793 STATE_CODE "Raw lifecycle state. Measured/predicted semantics not proved; not an accuracy gate.";
CM_ SG_ 1793 SLOT_INDEX_CODE "Physical slot index or 63 in unallocated-form headers; verified against slot positions. Not class or reference point.";
CM_ SG_ 1793 UNK_8_6 "Candidate from the carry-chain split, unverified: LSB flips 0.103 per cycle, 32 distinct values 30..62. Strongest correlation: age r=+0.55. Ramps up with age and saturates at 62; tracks range and scenario, not measured error.";
CM_ SG_ 1793 ONCOMING_FLAG "1 = oncoming now or earlier in the track life (persists after an oncoming object slows). Pre-registered test on unseen segments: over-ground speed < 0 on 100% of flagged rows, 88.5% of objects approaching faster than 2 m/s flagged (docs/14).";
CM_ SG_ 1793 CONST_15_1 "Constant 0 (0x0) in every record observed: reserved/padding or configuration.";
CM_ SG_ 1793 SCORE_CODE "Bounded score-like byte, not calibrated confidence or percent. Value 100 does not guarantee accurate geometry or velocity.";
CM_ SG_ 1793 AGE "Track age in radar cycles (~60 ms): 1 at birth, saturates at 126; 0 = slot being retired (geometry is the previous occupant's). A restart is a new track. Tracks younger than ~60 carry unconverged range and velocity.";
CM_ SG_ 1793 CONST_31_1 "Constant 0 (0x0) in every record observed: reserved/padding or configuration.";
CM_ SG_ 1793 DREL "Longitudinal distance forward of the radar, m. 1/16 m, zero code 160 (exactly -10 m). Camera ground contact at 5-25 m: slope 0.99-1.00 on three drives, zero within 0.2 m (0.7 m on a hilly drive). Settled tracks walk by metres record to record at 40 m+; young tracks can be far off.";
CM_ SG_ 1793 YREL_LEFT "Lateral offset, LEFT positive (openpilot yRel), m. 1/64 m, offset binary around 2048. Cartesian (constant across range), not an angle. Correct side 97.9-99.3% on held-out drives; scale bounded to about +/-10%. |code-2048| >= 2000 is a sentinel.";
CM_ SG_ 1793 UNK_56_7 "Candidate from the carry-chain split, unverified: LSB flips 0.355 per cycle, 84 distinct values 4..96. Strongest correlation: age r=+0.30. Size / class candidate: per-track median follows camera vehicle height (partial rho 0.48-0.61 at fixed range) and truck/bus class (docs/14).";
CM_ SG_ 1793 CONST_63_1 "Constant 0 (0x0) in every record observed: reserved/padding or configuration.";
CM_ SG_ 1793 VLONG_OVER_GROUND "Longitudinal velocity OVER GROUND, m/s. 0.15 m/s/code, zero 510.5. vRel = this - ego speed. Radar-only scale check (own range slope vs GPS ego) gives 0.150/0.149/0.153 on three drives. Beats zero and range differencing against a camera reference, but has unflagged ~1 s excursions at range. Unsettled for age < ~60.";
CM_ SG_ 1793 VLAT_OVER_GROUND_PROV "Lateral velocity over ground, LEFT positive (sign confirmed). Scale NOT pinned: the factor shown (0.15) is a placeholder. Radar-only estimates from its own lateral position change range 0.097-0.147 m/s per code across data sets, and the pre-registered test was unverified. See docs/14.";
CM_ SG_ 1793 ALONG_LIKE_84 "Acceleration-like, zero code 511 at standstill. Follows the VLONG change with a ~0.5 s lag, so it cannot flag or lead a velocity excursion. Radar-only scale about 0.04 m/s^2 per code on most data but drive-dependent (0.03-0.11); centred codes (docs/14).";
CM_ SG_ 1793 CONST_94_2 "Constant 0 (0x0) in every record observed: reserved/padding or configuration.";
CM_ SG_ 1793 UNK_96 "Unnamed 10-bit carry chain centred near 511; no relation to velocity or range error on three drives.";
CM_ SG_ 1793 UNK_106_1 "Candidate from the carry-chain split, unverified: LSB flips 0.003 per cycle, 2 distinct values 0..1. Strongest correlation: v_over_ground r=-0.14.";
CM_ SG_ 1793 UNK_107_1 "Candidate from the carry-chain split, unverified: LSB flips 0.013 per cycle, 2 distinct values 0..1. Strongest correlation: v_over_ground r=-0.24. Coasting-flag candidate: about 0.02 in settled life, 0.5-0.66 just before deletion (docs/14).";
CM_ SG_ 1793 CONST_108_1 "Constant 0 (0x0) in every record observed: reserved/padding or configuration.";
CM_ SG_ 1793 MOVE_STATE "Movement state. 0 = moving away / same direction, 2 = moving toward (oncoming), 1 and 3 = not clearly moving (1 vs 3 unresolved). Pre-registered test on unseen segments: value 0 had over-ground speed > 0.5 m/s on 99.65% of rows, value 2 < -0.5 m/s on 99.88%, values 1/3 |v| < 2 m/s on 89.5% (docs/14).";
CM_ SG_ 1793 UNK_111_4 "Candidate from the carry-chain split, unverified: LSB flips 0.008 per cycle, 10 distinct values 0..9. Strongest correlation: dRel r=-0.53.";
CM_ SG_ 1793 UNK_115_8 "Candidate from the carry-chain split, unverified: LSB flips 0.052 per cycle, 26 distinct values 0..178. Strongest correlation: age r=+0.27.";
CM_ SG_ 1793 CONST_123_5 "Constant 31 (0x1F) in every record observed: reserved/padding or configuration.";
CM_ SG_ 1793 UNK_128_2 "Candidate from the carry-chain split, unverified: LSB flips 0.013 per cycle, 4 distinct values 0..3. Strongest correlation: dRel r=+0.11.";
CM_ SG_ 1793 UNK_130_1 "Candidate from the carry-chain split, unverified: LSB flips 0.019 per cycle, 2 distinct values 0..1. Strongest correlation: abs_yRel r=+0.34.";
CM_ SG_ 1793 UNK_131_4 "Candidate from the carry-chain split, unverified: LSB flips 0.102 per cycle, 9 distinct values 7..15. Strongest correlation: abs_yRel r=+0.09.";
CM_ SG_ 1793 CONST_135_1 "Constant 0 (0x0) in every record observed: reserved/padding or configuration.";
CM_ SG_ 1793 UNK_136_6 "Candidate from the carry-chain split, unverified: LSB flips 0.093 per cycle, 39 distinct values 3..63. Strongest correlation: age r=+0.20.";
CM_ SG_ 1793 UNK_142_1 "Candidate from the carry-chain split, unverified: LSB flips 0.007 per cycle, 2 distinct values 0..1. Strongest correlation: age r=+0.47.";
CM_ SG_ 1793 CONST_143_5 "Constant 30 (0x1E) in every record observed: reserved/padding or configuration.";
CM_ SG_ 1793 UNK_148_8 "Candidate from the carry-chain split, unverified: LSB flips 0.009 per cycle, 27 distinct values 0..240. Strongest correlation: dRel r=-0.12.";
CM_ SG_ 1793 UNK_156_4 "Candidate from the carry-chain split, unverified: LSB flips 0.016 per cycle, 16 distinct values 0..15. Strongest correlation: abs_yRel r=-0.42.";
CM_ SG_ 1793 CONST_160_3 "Constant 0 (0x0) in every record observed: reserved/padding or configuration.";
CM_ SG_ 1793 UNK_163_2 "Candidate from the carry-chain split, unverified: LSB flips 0.006 per cycle, 3 distinct values 1..3. Strongest correlation: age r=+0.30.";
CM_ SG_ 1793 CONST_165_3 "Constant 0 (0x0) in every record observed: reserved/padding or configuration.";
CM_ SG_ 1793 UNK_168_10 "Candidate from the carry-chain split, unverified: LSB flips 0.066 per cycle, 3 distinct values 0..1023. Strongest correlation: abs_yRel r=+0.14.";
CM_ SG_ 1793 CONST_178_3 "Constant 0 (0x0) in every record observed: reserved/padding or configuration.";
CM_ SG_ 1793 UNK_181_1 "Candidate from the carry-chain split, unverified: LSB flips 0.071 per cycle, 2 distinct values 0..1. Strongest correlation: v_over_ground r=+0.34.";
CM_ SG_ 1793 CONST_182_1 "Constant 0 (0x0) in every record observed: reserved/padding or configuration.";
CM_ SG_ 1793 UNK_183_7 "Candidate from the carry-chain split, unverified: LSB flips 0.009 per cycle, 24 distinct values 26..73. Strongest correlation: age r=+0.20.";
CM_ SG_ 1793 CONST_190_10 "Constant 1 (0x1) in every record observed: reserved/padding or configuration.";
CM_ SG_ 1793 UNK_200_7 "Candidate from the carry-chain split, unverified: LSB flips 0.023 per cycle, 16 distinct values 0..127. Strongest correlation: v_over_ground r=-0.45.";
CM_ SG_ 1793 CONST_207_1 "Constant 0 (0x0) in every record observed: reserved/padding or configuration.";
CM_ SG_ 1793 UNK_208_6 "Candidate from the carry-chain split, unverified: LSB flips 0.017 per cycle, 20 distinct values 0..63. Strongest correlation: v_over_ground r=-0.38.";
CM_ SG_ 1793 CONST_214_2 "Constant 0 (0x0) in every record observed: reserved/padding or configuration.";
CM_ SG_ 1793 UNK_216_6 "Candidate from the carry-chain split, unverified: LSB flips 0.150 per cycle, 34 distinct values 3..49. Strongest correlation: age r=+0.23. Size / class candidate: camera vehicle height partial rho 0.44-0.63, truck/bus 0.35-0.42; width on A/C. Compare ARS4-B Length / dZ (6 bits) (docs/14).";
CM_ SG_ 1793 CONST_222_2 "Constant 0 (0x0) in every record observed: reserved/padding or configuration.";
CM_ SG_ 1793 UNK_224_7 "Candidate from the carry-chain split, unverified: LSB flips 0.344 per cycle, 127 distinct values 1..127. Strongest correlation: dRel r=+0.80. Uncertainty candidate: scales with range (r~0.8), falls with age at fixed range (rho -0.29 to -0.36), larger when range steps are noisier, rises before deletion. Weak near-range error indicator; does not single out excursions.";
CM_ SG_ 1793 CONST_231_1 "Constant 0 (0x0) in every record observed: reserved/padding or configuration.";
CM_ SG_ 1793 UNK_232_7 "Candidate from the carry-chain split, unverified: LSB flips 0.096 per cycle, 72 distinct values 0..127. Strongest correlation: abs_yRel r=+0.60. Lateral-uncertainty candidate: scales with |yRel| (r~0.6), falls with age at fixed range (rho -0.50 to -0.59).";
CM_ SG_ 1793 PER_TRACK_239_1 "Constant within a track, differs between tracks (2 values 0..1): object attribute candidate, unverified. Strongest correlation: abs_yRel r=+0.09.";
CM_ SG_ 1793 UNK_240_7 "Candidate from the carry-chain split, unverified: LSB flips 0.364 per cycle, 127 distinct values 1..127. Strongest correlation: dRel r=+0.80. Velocity-uncertainty candidate (like ARS408 VrelLong_rms): scales with range, falls with age, rises before deletion. Higher when native vRel disagrees with the camera by > 2 m/s (stratified AUC ~0.62 on drives A-C); moderate, not a clean excursion flag (docs/14). Decoded as vel_unc_code.";
CM_ SG_ 1793 CONST_247_1 "Constant 0 (0x0) in every record observed: reserved/padding or configuration.";
CM_ SG_ 1793 UNK_248_7 "Candidate from the carry-chain split, unverified: LSB flips 0.116 per cycle, 97 distinct values 0..127. Strongest correlation: abs_yRel r=+0.56. Uncertainty candidate: scales with |yRel| (r~0.56), falls with age at fixed range (rho -0.70 to -0.75).";
CM_ SG_ 1793 CONST_255_1 "Constant 0 (0x0) in every record observed: reserved/padding or configuration.";
CM_ SG_ 1793 UNK_256_5 "Candidate from the carry-chain split, unverified: LSB flips 0.177 per cycle, 30 distinct values 0..30. Strongest correlation: age r=+0.72. Existence / confidence candidate: rises with age at fixed range (rho +0.86 to +0.90), drops about 1.5 codes before deletion. Compare ARS4-B ProbExist (5 bits).";
CM_ SG_ 1793 CONST_261_3 "Constant 0 (0x0) in every record observed: reserved/padding or configuration.";
CM_ SG_ 1793 UNK_264_5 "Candidate from the carry-chain split, unverified: LSB flips 0.100 per cycle, 19 distinct values 0..18. Strongest correlation: age r=-0.81. Uncertainty candidate: falls with age at fixed range (rho -0.61 to -0.68), rises before deletion.";
CM_ SG_ 1793 CONST_269_3 "Constant 0 (0x0) in every record observed: reserved/padding or configuration.";
CM_ SG_ 1793 UNK_272_5 "Candidate from the carry-chain split, unverified: LSB flips 0.095 per cycle, 17 distinct values 2..18. Strongest correlation: age r=+0.30. Size / class candidate: camera vehicle height partial rho 0.41-0.71, width 0.36-0.69, truck/bus 0.24-0.39 (docs/14).";
CM_ SG_ 1793 CONST_277_11 "Constant 0 (0x0) in every record observed: reserved/padding or configuration.";
CM_ BO_ 1794 "Reassembled 0x80 object slot 2 (record bytes 89-124), sent only when occupied. Little-endian bit field: bit 0 = LSB of slot byte 0.";
CM_ SG_ 1794 STATE_CODE "Raw lifecycle state. Measured/predicted semantics not proved; not an accuracy gate.";
CM_ SG_ 1794 SLOT_INDEX_CODE "Physical slot index or 63 in unallocated-form headers; verified against slot positions. Not class or reference point.";
CM_ SG_ 1794 UNK_8_6 "Candidate from the carry-chain split, unverified: LSB flips 0.103 per cycle, 32 distinct values 30..62. Strongest correlation: age r=+0.55. Ramps up with age and saturates at 62; tracks range and scenario, not measured error.";
CM_ SG_ 1794 ONCOMING_FLAG "1 = oncoming now or earlier in the track life (persists after an oncoming object slows). Pre-registered test on unseen segments: over-ground speed < 0 on 100% of flagged rows, 88.5% of objects approaching faster than 2 m/s flagged (docs/14).";
CM_ SG_ 1794 CONST_15_1 "Constant 0 (0x0) in every record observed: reserved/padding or configuration.";
CM_ SG_ 1794 SCORE_CODE "Bounded score-like byte, not calibrated confidence or percent. Value 100 does not guarantee accurate geometry or velocity.";
CM_ SG_ 1794 AGE "Track age in radar cycles (~60 ms): 1 at birth, saturates at 126; 0 = slot being retired (geometry is the previous occupant's). A restart is a new track. Tracks younger than ~60 carry unconverged range and velocity.";
CM_ SG_ 1794 CONST_31_1 "Constant 0 (0x0) in every record observed: reserved/padding or configuration.";
CM_ SG_ 1794 DREL "Longitudinal distance forward of the radar, m. 1/16 m, zero code 160 (exactly -10 m). Camera ground contact at 5-25 m: slope 0.99-1.00 on three drives, zero within 0.2 m (0.7 m on a hilly drive). Settled tracks walk by metres record to record at 40 m+; young tracks can be far off.";
CM_ SG_ 1794 YREL_LEFT "Lateral offset, LEFT positive (openpilot yRel), m. 1/64 m, offset binary around 2048. Cartesian (constant across range), not an angle. Correct side 97.9-99.3% on held-out drives; scale bounded to about +/-10%. |code-2048| >= 2000 is a sentinel.";
CM_ SG_ 1794 UNK_56_7 "Candidate from the carry-chain split, unverified: LSB flips 0.355 per cycle, 84 distinct values 4..96. Strongest correlation: age r=+0.30. Size / class candidate: per-track median follows camera vehicle height (partial rho 0.48-0.61 at fixed range) and truck/bus class (docs/14).";
CM_ SG_ 1794 CONST_63_1 "Constant 0 (0x0) in every record observed: reserved/padding or configuration.";
CM_ SG_ 1794 VLONG_OVER_GROUND "Longitudinal velocity OVER GROUND, m/s. 0.15 m/s/code, zero 510.5. vRel = this - ego speed. Radar-only scale check (own range slope vs GPS ego) gives 0.150/0.149/0.153 on three drives. Beats zero and range differencing against a camera reference, but has unflagged ~1 s excursions at range. Unsettled for age < ~60.";
CM_ SG_ 1794 VLAT_OVER_GROUND_PROV "Lateral velocity over ground, LEFT positive (sign confirmed). Scale NOT pinned: the factor shown (0.15) is a placeholder. Radar-only estimates from its own lateral position change range 0.097-0.147 m/s per code across data sets, and the pre-registered test was unverified. See docs/14.";
CM_ SG_ 1794 ALONG_LIKE_84 "Acceleration-like, zero code 511 at standstill. Follows the VLONG change with a ~0.5 s lag, so it cannot flag or lead a velocity excursion. Radar-only scale about 0.04 m/s^2 per code on most data but drive-dependent (0.03-0.11); centred codes (docs/14).";
CM_ SG_ 1794 CONST_94_2 "Constant 0 (0x0) in every record observed: reserved/padding or configuration.";
CM_ SG_ 1794 UNK_96 "Unnamed 10-bit carry chain centred near 511; no relation to velocity or range error on three drives.";
CM_ SG_ 1794 UNK_106_1 "Candidate from the carry-chain split, unverified: LSB flips 0.003 per cycle, 2 distinct values 0..1. Strongest correlation: v_over_ground r=-0.14.";
CM_ SG_ 1794 UNK_107_1 "Candidate from the carry-chain split, unverified: LSB flips 0.013 per cycle, 2 distinct values 0..1. Strongest correlation: v_over_ground r=-0.24. Coasting-flag candidate: about 0.02 in settled life, 0.5-0.66 just before deletion (docs/14).";
CM_ SG_ 1794 CONST_108_1 "Constant 0 (0x0) in every record observed: reserved/padding or configuration.";
CM_ SG_ 1794 MOVE_STATE "Movement state. 0 = moving away / same direction, 2 = moving toward (oncoming), 1 and 3 = not clearly moving (1 vs 3 unresolved). Pre-registered test on unseen segments: value 0 had over-ground speed > 0.5 m/s on 99.65% of rows, value 2 < -0.5 m/s on 99.88%, values 1/3 |v| < 2 m/s on 89.5% (docs/14).";
CM_ SG_ 1794 UNK_111_4 "Candidate from the carry-chain split, unverified: LSB flips 0.008 per cycle, 10 distinct values 0..9. Strongest correlation: dRel r=-0.53.";
CM_ SG_ 1794 UNK_115_8 "Candidate from the carry-chain split, unverified: LSB flips 0.052 per cycle, 26 distinct values 0..178. Strongest correlation: age r=+0.27.";
CM_ SG_ 1794 CONST_123_5 "Constant 31 (0x1F) in every record observed: reserved/padding or configuration.";
CM_ SG_ 1794 UNK_128_2 "Candidate from the carry-chain split, unverified: LSB flips 0.013 per cycle, 4 distinct values 0..3. Strongest correlation: dRel r=+0.11.";
CM_ SG_ 1794 UNK_130_1 "Candidate from the carry-chain split, unverified: LSB flips 0.019 per cycle, 2 distinct values 0..1. Strongest correlation: abs_yRel r=+0.34.";
CM_ SG_ 1794 UNK_131_4 "Candidate from the carry-chain split, unverified: LSB flips 0.102 per cycle, 9 distinct values 7..15. Strongest correlation: abs_yRel r=+0.09.";
CM_ SG_ 1794 CONST_135_1 "Constant 0 (0x0) in every record observed: reserved/padding or configuration.";
CM_ SG_ 1794 UNK_136_6 "Candidate from the carry-chain split, unverified: LSB flips 0.093 per cycle, 39 distinct values 3..63. Strongest correlation: age r=+0.20.";
CM_ SG_ 1794 UNK_142_1 "Candidate from the carry-chain split, unverified: LSB flips 0.007 per cycle, 2 distinct values 0..1. Strongest correlation: age r=+0.47.";
CM_ SG_ 1794 CONST_143_5 "Constant 30 (0x1E) in every record observed: reserved/padding or configuration.";
CM_ SG_ 1794 UNK_148_8 "Candidate from the carry-chain split, unverified: LSB flips 0.009 per cycle, 27 distinct values 0..240. Strongest correlation: dRel r=-0.12.";
CM_ SG_ 1794 UNK_156_4 "Candidate from the carry-chain split, unverified: LSB flips 0.016 per cycle, 16 distinct values 0..15. Strongest correlation: abs_yRel r=-0.42.";
CM_ SG_ 1794 CONST_160_3 "Constant 0 (0x0) in every record observed: reserved/padding or configuration.";
CM_ SG_ 1794 UNK_163_2 "Candidate from the carry-chain split, unverified: LSB flips 0.006 per cycle, 3 distinct values 1..3. Strongest correlation: age r=+0.30.";
CM_ SG_ 1794 CONST_165_3 "Constant 0 (0x0) in every record observed: reserved/padding or configuration.";
CM_ SG_ 1794 UNK_168_10 "Candidate from the carry-chain split, unverified: LSB flips 0.066 per cycle, 3 distinct values 0..1023. Strongest correlation: abs_yRel r=+0.14.";
CM_ SG_ 1794 CONST_178_3 "Constant 0 (0x0) in every record observed: reserved/padding or configuration.";
CM_ SG_ 1794 UNK_181_1 "Candidate from the carry-chain split, unverified: LSB flips 0.071 per cycle, 2 distinct values 0..1. Strongest correlation: v_over_ground r=+0.34.";
CM_ SG_ 1794 CONST_182_1 "Constant 0 (0x0) in every record observed: reserved/padding or configuration.";
CM_ SG_ 1794 UNK_183_7 "Candidate from the carry-chain split, unverified: LSB flips 0.009 per cycle, 24 distinct values 26..73. Strongest correlation: age r=+0.20.";
CM_ SG_ 1794 CONST_190_10 "Constant 1 (0x1) in every record observed: reserved/padding or configuration.";
CM_ SG_ 1794 UNK_200_7 "Candidate from the carry-chain split, unverified: LSB flips 0.023 per cycle, 16 distinct values 0..127. Strongest correlation: v_over_ground r=-0.45.";
CM_ SG_ 1794 CONST_207_1 "Constant 0 (0x0) in every record observed: reserved/padding or configuration.";
CM_ SG_ 1794 UNK_208_6 "Candidate from the carry-chain split, unverified: LSB flips 0.017 per cycle, 20 distinct values 0..63. Strongest correlation: v_over_ground r=-0.38.";
CM_ SG_ 1794 CONST_214_2 "Constant 0 (0x0) in every record observed: reserved/padding or configuration.";
CM_ SG_ 1794 UNK_216_6 "Candidate from the carry-chain split, unverified: LSB flips 0.150 per cycle, 34 distinct values 3..49. Strongest correlation: age r=+0.23. Size / class candidate: camera vehicle height partial rho 0.44-0.63, truck/bus 0.35-0.42; width on A/C. Compare ARS4-B Length / dZ (6 bits) (docs/14).";
CM_ SG_ 1794 CONST_222_2 "Constant 0 (0x0) in every record observed: reserved/padding or configuration.";
CM_ SG_ 1794 UNK_224_7 "Candidate from the carry-chain split, unverified: LSB flips 0.344 per cycle, 127 distinct values 1..127. Strongest correlation: dRel r=+0.80. Uncertainty candidate: scales with range (r~0.8), falls with age at fixed range (rho -0.29 to -0.36), larger when range steps are noisier, rises before deletion. Weak near-range error indicator; does not single out excursions.";
CM_ SG_ 1794 CONST_231_1 "Constant 0 (0x0) in every record observed: reserved/padding or configuration.";
CM_ SG_ 1794 UNK_232_7 "Candidate from the carry-chain split, unverified: LSB flips 0.096 per cycle, 72 distinct values 0..127. Strongest correlation: abs_yRel r=+0.60. Lateral-uncertainty candidate: scales with |yRel| (r~0.6), falls with age at fixed range (rho -0.50 to -0.59).";
CM_ SG_ 1794 PER_TRACK_239_1 "Constant within a track, differs between tracks (2 values 0..1): object attribute candidate, unverified. Strongest correlation: abs_yRel r=+0.09.";
CM_ SG_ 1794 UNK_240_7 "Candidate from the carry-chain split, unverified: LSB flips 0.364 per cycle, 127 distinct values 1..127. Strongest correlation: dRel r=+0.80. Velocity-uncertainty candidate (like ARS408 VrelLong_rms): scales with range, falls with age, rises before deletion. Higher when native vRel disagrees with the camera by > 2 m/s (stratified AUC ~0.62 on drives A-C); moderate, not a clean excursion flag (docs/14). Decoded as vel_unc_code.";
CM_ SG_ 1794 CONST_247_1 "Constant 0 (0x0) in every record observed: reserved/padding or configuration.";
CM_ SG_ 1794 UNK_248_7 "Candidate from the carry-chain split, unverified: LSB flips 0.116 per cycle, 97 distinct values 0..127. Strongest correlation: abs_yRel r=+0.56. Uncertainty candidate: scales with |yRel| (r~0.56), falls with age at fixed range (rho -0.70 to -0.75).";
CM_ SG_ 1794 CONST_255_1 "Constant 0 (0x0) in every record observed: reserved/padding or configuration.";
CM_ SG_ 1794 UNK_256_5 "Candidate from the carry-chain split, unverified: LSB flips 0.177 per cycle, 30 distinct values 0..30. Strongest correlation: age r=+0.72. Existence / confidence candidate: rises with age at fixed range (rho +0.86 to +0.90), drops about 1.5 codes before deletion. Compare ARS4-B ProbExist (5 bits).";
CM_ SG_ 1794 CONST_261_3 "Constant 0 (0x0) in every record observed: reserved/padding or configuration.";
CM_ SG_ 1794 UNK_264_5 "Candidate from the carry-chain split, unverified: LSB flips 0.100 per cycle, 19 distinct values 0..18. Strongest correlation: age r=-0.81. Uncertainty candidate: falls with age at fixed range (rho -0.61 to -0.68), rises before deletion.";
CM_ SG_ 1794 CONST_269_3 "Constant 0 (0x0) in every record observed: reserved/padding or configuration.";
CM_ SG_ 1794 UNK_272_5 "Candidate from the carry-chain split, unverified: LSB flips 0.095 per cycle, 17 distinct values 2..18. Strongest correlation: age r=+0.30. Size / class candidate: camera vehicle height partial rho 0.41-0.71, width 0.36-0.69, truck/bus 0.24-0.39 (docs/14).";
CM_ SG_ 1794 CONST_277_11 "Constant 0 (0x0) in every record observed: reserved/padding or configuration.";
CM_ BO_ 1795 "Reassembled 0x80 object slot 3 (record bytes 125-160), sent only when occupied. Little-endian bit field: bit 0 = LSB of slot byte 0.";
CM_ SG_ 1795 STATE_CODE "Raw lifecycle state. Measured/predicted semantics not proved; not an accuracy gate.";
CM_ SG_ 1795 SLOT_INDEX_CODE "Physical slot index or 63 in unallocated-form headers; verified against slot positions. Not class or reference point.";
CM_ SG_ 1795 UNK_8_6 "Candidate from the carry-chain split, unverified: LSB flips 0.103 per cycle, 32 distinct values 30..62. Strongest correlation: age r=+0.55. Ramps up with age and saturates at 62; tracks range and scenario, not measured error.";
CM_ SG_ 1795 ONCOMING_FLAG "1 = oncoming now or earlier in the track life (persists after an oncoming object slows). Pre-registered test on unseen segments: over-ground speed < 0 on 100% of flagged rows, 88.5% of objects approaching faster than 2 m/s flagged (docs/14).";
CM_ SG_ 1795 CONST_15_1 "Constant 0 (0x0) in every record observed: reserved/padding or configuration.";
CM_ SG_ 1795 SCORE_CODE "Bounded score-like byte, not calibrated confidence or percent. Value 100 does not guarantee accurate geometry or velocity.";
CM_ SG_ 1795 AGE "Track age in radar cycles (~60 ms): 1 at birth, saturates at 126; 0 = slot being retired (geometry is the previous occupant's). A restart is a new track. Tracks younger than ~60 carry unconverged range and velocity.";
CM_ SG_ 1795 CONST_31_1 "Constant 0 (0x0) in every record observed: reserved/padding or configuration.";
CM_ SG_ 1795 DREL "Longitudinal distance forward of the radar, m. 1/16 m, zero code 160 (exactly -10 m). Camera ground contact at 5-25 m: slope 0.99-1.00 on three drives, zero within 0.2 m (0.7 m on a hilly drive). Settled tracks walk by metres record to record at 40 m+; young tracks can be far off.";
CM_ SG_ 1795 YREL_LEFT "Lateral offset, LEFT positive (openpilot yRel), m. 1/64 m, offset binary around 2048. Cartesian (constant across range), not an angle. Correct side 97.9-99.3% on held-out drives; scale bounded to about +/-10%. |code-2048| >= 2000 is a sentinel.";
CM_ SG_ 1795 UNK_56_7 "Candidate from the carry-chain split, unverified: LSB flips 0.355 per cycle, 84 distinct values 4..96. Strongest correlation: age r=+0.30. Size / class candidate: per-track median follows camera vehicle height (partial rho 0.48-0.61 at fixed range) and truck/bus class (docs/14).";
CM_ SG_ 1795 CONST_63_1 "Constant 0 (0x0) in every record observed: reserved/padding or configuration.";
CM_ SG_ 1795 VLONG_OVER_GROUND "Longitudinal velocity OVER GROUND, m/s. 0.15 m/s/code, zero 510.5. vRel = this - ego speed. Radar-only scale check (own range slope vs GPS ego) gives 0.150/0.149/0.153 on three drives. Beats zero and range differencing against a camera reference, but has unflagged ~1 s excursions at range. Unsettled for age < ~60.";
CM_ SG_ 1795 VLAT_OVER_GROUND_PROV "Lateral velocity over ground, LEFT positive (sign confirmed). Scale NOT pinned: the factor shown (0.15) is a placeholder. Radar-only estimates from its own lateral position change range 0.097-0.147 m/s per code across data sets, and the pre-registered test was unverified. See docs/14.";
CM_ SG_ 1795 ALONG_LIKE_84 "Acceleration-like, zero code 511 at standstill. Follows the VLONG change with a ~0.5 s lag, so it cannot flag or lead a velocity excursion. Radar-only scale about 0.04 m/s^2 per code on most data but drive-dependent (0.03-0.11); centred codes (docs/14).";
CM_ SG_ 1795 CONST_94_2 "Constant 0 (0x0) in every record observed: reserved/padding or configuration.";
CM_ SG_ 1795 UNK_96 "Unnamed 10-bit carry chain centred near 511; no relation to velocity or range error on three drives.";
CM_ SG_ 1795 UNK_106_1 "Candidate from the carry-chain split, unverified: LSB flips 0.003 per cycle, 2 distinct values 0..1. Strongest correlation: v_over_ground r=-0.14.";
CM_ SG_ 1795 UNK_107_1 "Candidate from the carry-chain split, unverified: LSB flips 0.013 per cycle, 2 distinct values 0..1. Strongest correlation: v_over_ground r=-0.24. Coasting-flag candidate: about 0.02 in settled life, 0.5-0.66 just before deletion (docs/14).";
CM_ SG_ 1795 CONST_108_1 "Constant 0 (0x0) in every record observed: reserved/padding or configuration.";
CM_ SG_ 1795 MOVE_STATE "Movement state. 0 = moving away / same direction, 2 = moving toward (oncoming), 1 and 3 = not clearly moving (1 vs 3 unresolved). Pre-registered test on unseen segments: value 0 had over-ground speed > 0.5 m/s on 99.65% of rows, value 2 < -0.5 m/s on 99.88%, values 1/3 |v| < 2 m/s on 89.5% (docs/14).";
CM_ SG_ 1795 UNK_111_4 "Candidate from the carry-chain split, unverified: LSB flips 0.008 per cycle, 10 distinct values 0..9. Strongest correlation: dRel r=-0.53.";
CM_ SG_ 1795 UNK_115_8 "Candidate from the carry-chain split, unverified: LSB flips 0.052 per cycle, 26 distinct values 0..178. Strongest correlation: age r=+0.27.";
CM_ SG_ 1795 CONST_123_5 "Constant 31 (0x1F) in every record observed: reserved/padding or configuration.";
CM_ SG_ 1795 UNK_128_2 "Candidate from the carry-chain split, unverified: LSB flips 0.013 per cycle, 4 distinct values 0..3. Strongest correlation: dRel r=+0.11.";
CM_ SG_ 1795 UNK_130_1 "Candidate from the carry-chain split, unverified: LSB flips 0.019 per cycle, 2 distinct values 0..1. Strongest correlation: abs_yRel r=+0.34.";
CM_ SG_ 1795 UNK_131_4 "Candidate from the carry-chain split, unverified: LSB flips 0.102 per cycle, 9 distinct values 7..15. Strongest correlation: abs_yRel r=+0.09.";
CM_ SG_ 1795 CONST_135_1 "Constant 0 (0x0) in every record observed: reserved/padding or configuration.";
CM_ SG_ 1795 UNK_136_6 "Candidate from the carry-chain split, unverified: LSB flips 0.093 per cycle, 39 distinct values 3..63. Strongest correlation: age r=+0.20.";
CM_ SG_ 1795 UNK_142_1 "Candidate from the carry-chain split, unverified: LSB flips 0.007 per cycle, 2 distinct values 0..1. Strongest correlation: age r=+0.47.";
CM_ SG_ 1795 CONST_143_5 "Constant 30 (0x1E) in every record observed: reserved/padding or configuration.";
CM_ SG_ 1795 UNK_148_8 "Candidate from the carry-chain split, unverified: LSB flips 0.009 per cycle, 27 distinct values 0..240. Strongest correlation: dRel r=-0.12.";
CM_ SG_ 1795 UNK_156_4 "Candidate from the carry-chain split, unverified: LSB flips 0.016 per cycle, 16 distinct values 0..15. Strongest correlation: abs_yRel r=-0.42.";
CM_ SG_ 1795 CONST_160_3 "Constant 0 (0x0) in every record observed: reserved/padding or configuration.";
CM_ SG_ 1795 UNK_163_2 "Candidate from the carry-chain split, unverified: LSB flips 0.006 per cycle, 3 distinct values 1..3. Strongest correlation: age r=+0.30.";
CM_ SG_ 1795 CONST_165_3 "Constant 0 (0x0) in every record observed: reserved/padding or configuration.";
CM_ SG_ 1795 UNK_168_10 "Candidate from the carry-chain split, unverified: LSB flips 0.066 per cycle, 3 distinct values 0..1023. Strongest correlation: abs_yRel r=+0.14.";
CM_ SG_ 1795 CONST_178_3 "Constant 0 (0x0) in every record observed: reserved/padding or configuration.";
CM_ SG_ 1795 UNK_181_1 "Candidate from the carry-chain split, unverified: LSB flips 0.071 per cycle, 2 distinct values 0..1. Strongest correlation: v_over_ground r=+0.34.";
CM_ SG_ 1795 CONST_182_1 "Constant 0 (0x0) in every record observed: reserved/padding or configuration.";
CM_ SG_ 1795 UNK_183_7 "Candidate from the carry-chain split, unverified: LSB flips 0.009 per cycle, 24 distinct values 26..73. Strongest correlation: age r=+0.20.";
CM_ SG_ 1795 CONST_190_10 "Constant 1 (0x1) in every record observed: reserved/padding or configuration.";
CM_ SG_ 1795 UNK_200_7 "Candidate from the carry-chain split, unverified: LSB flips 0.023 per cycle, 16 distinct values 0..127. Strongest correlation: v_over_ground r=-0.45.";
CM_ SG_ 1795 CONST_207_1 "Constant 0 (0x0) in every record observed: reserved/padding or configuration.";
CM_ SG_ 1795 UNK_208_6 "Candidate from the carry-chain split, unverified: LSB flips 0.017 per cycle, 20 distinct values 0..63. Strongest correlation: v_over_ground r=-0.38.";
CM_ SG_ 1795 CONST_214_2 "Constant 0 (0x0) in every record observed: reserved/padding or configuration.";
CM_ SG_ 1795 UNK_216_6 "Candidate from the carry-chain split, unverified: LSB flips 0.150 per cycle, 34 distinct values 3..49. Strongest correlation: age r=+0.23. Size / class candidate: camera vehicle height partial rho 0.44-0.63, truck/bus 0.35-0.42; width on A/C. Compare ARS4-B Length / dZ (6 bits) (docs/14).";
CM_ SG_ 1795 CONST_222_2 "Constant 0 (0x0) in every record observed: reserved/padding or configuration.";
CM_ SG_ 1795 UNK_224_7 "Candidate from the carry-chain split, unverified: LSB flips 0.344 per cycle, 127 distinct values 1..127. Strongest correlation: dRel r=+0.80. Uncertainty candidate: scales with range (r~0.8), falls with age at fixed range (rho -0.29 to -0.36), larger when range steps are noisier, rises before deletion. Weak near-range error indicator; does not single out excursions.";
CM_ SG_ 1795 CONST_231_1 "Constant 0 (0x0) in every record observed: reserved/padding or configuration.";
CM_ SG_ 1795 UNK_232_7 "Candidate from the carry-chain split, unverified: LSB flips 0.096 per cycle, 72 distinct values 0..127. Strongest correlation: abs_yRel r=+0.60. Lateral-uncertainty candidate: scales with |yRel| (r~0.6), falls with age at fixed range (rho -0.50 to -0.59).";
CM_ SG_ 1795 PER_TRACK_239_1 "Constant within a track, differs between tracks (2 values 0..1): object attribute candidate, unverified. Strongest correlation: abs_yRel r=+0.09.";
CM_ SG_ 1795 UNK_240_7 "Candidate from the carry-chain split, unverified: LSB flips 0.364 per cycle, 127 distinct values 1..127. Strongest correlation: dRel r=+0.80. Velocity-uncertainty candidate (like ARS408 VrelLong_rms): scales with range, falls with age, rises before deletion. Higher when native vRel disagrees with the camera by > 2 m/s (stratified AUC ~0.62 on drives A-C); moderate, not a clean excursion flag (docs/14). Decoded as vel_unc_code.";
CM_ SG_ 1795 CONST_247_1 "Constant 0 (0x0) in every record observed: reserved/padding or configuration.";
CM_ SG_ 1795 UNK_248_7 "Candidate from the carry-chain split, unverified: LSB flips 0.116 per cycle, 97 distinct values 0..127. Strongest correlation: abs_yRel r=+0.56. Uncertainty candidate: scales with |yRel| (r~0.56), falls with age at fixed range (rho -0.70 to -0.75).";
CM_ SG_ 1795 CONST_255_1 "Constant 0 (0x0) in every record observed: reserved/padding or configuration.";
CM_ SG_ 1795 UNK_256_5 "Candidate from the carry-chain split, unverified: LSB flips 0.177 per cycle, 30 distinct values 0..30. Strongest correlation: age r=+0.72. Existence / confidence candidate: rises with age at fixed range (rho +0.86 to +0.90), drops about 1.5 codes before deletion. Compare ARS4-B ProbExist (5 bits).";
CM_ SG_ 1795 CONST_261_3 "Constant 0 (0x0) in every record observed: reserved/padding or configuration.";
CM_ SG_ 1795 UNK_264_5 "Candidate from the carry-chain split, unverified: LSB flips 0.100 per cycle, 19 distinct values 0..18. Strongest correlation: age r=-0.81. Uncertainty candidate: falls with age at fixed range (rho -0.61 to -0.68), rises before deletion.";
CM_ SG_ 1795 CONST_269_3 "Constant 0 (0x0) in every record observed: reserved/padding or configuration.";
CM_ SG_ 1795 UNK_272_5 "Candidate from the carry-chain split, unverified: LSB flips 0.095 per cycle, 17 distinct values 2..18. Strongest correlation: age r=+0.30. Size / class candidate: camera vehicle height partial rho 0.41-0.71, width 0.36-0.69, truck/bus 0.24-0.39 (docs/14).";
CM_ SG_ 1795 CONST_277_11 "Constant 0 (0x0) in every record observed: reserved/padding or configuration.";
CM_ BO_ 1796 "Reassembled 0x80 object slot 4 (record bytes 161-196), sent only when occupied. Little-endian bit field: bit 0 = LSB of slot byte 0.";
CM_ SG_ 1796 STATE_CODE "Raw lifecycle state. Measured/predicted semantics not proved; not an accuracy gate.";
CM_ SG_ 1796 SLOT_INDEX_CODE "Physical slot index or 63 in unallocated-form headers; verified against slot positions. Not class or reference point.";
CM_ SG_ 1796 UNK_8_6 "Candidate from the carry-chain split, unverified: LSB flips 0.103 per cycle, 32 distinct values 30..62. Strongest correlation: age r=+0.55. Ramps up with age and saturates at 62; tracks range and scenario, not measured error.";
CM_ SG_ 1796 ONCOMING_FLAG "1 = oncoming now or earlier in the track life (persists after an oncoming object slows). Pre-registered test on unseen segments: over-ground speed < 0 on 100% of flagged rows, 88.5% of objects approaching faster than 2 m/s flagged (docs/14).";
CM_ SG_ 1796 CONST_15_1 "Constant 0 (0x0) in every record observed: reserved/padding or configuration.";
CM_ SG_ 1796 SCORE_CODE "Bounded score-like byte, not calibrated confidence or percent. Value 100 does not guarantee accurate geometry or velocity.";
CM_ SG_ 1796 AGE "Track age in radar cycles (~60 ms): 1 at birth, saturates at 126; 0 = slot being retired (geometry is the previous occupant's). A restart is a new track. Tracks younger than ~60 carry unconverged range and velocity.";
CM_ SG_ 1796 CONST_31_1 "Constant 0 (0x0) in every record observed: reserved/padding or configuration.";
CM_ SG_ 1796 DREL "Longitudinal distance forward of the radar, m. 1/16 m, zero code 160 (exactly -10 m). Camera ground contact at 5-25 m: slope 0.99-1.00 on three drives, zero within 0.2 m (0.7 m on a hilly drive). Settled tracks walk by metres record to record at 40 m+; young tracks can be far off.";
CM_ SG_ 1796 YREL_LEFT "Lateral offset, LEFT positive (openpilot yRel), m. 1/64 m, offset binary around 2048. Cartesian (constant across range), not an angle. Correct side 97.9-99.3% on held-out drives; scale bounded to about +/-10%. |code-2048| >= 2000 is a sentinel.";
CM_ SG_ 1796 UNK_56_7 "Candidate from the carry-chain split, unverified: LSB flips 0.355 per cycle, 84 distinct values 4..96. Strongest correlation: age r=+0.30. Size / class candidate: per-track median follows camera vehicle height (partial rho 0.48-0.61 at fixed range) and truck/bus class (docs/14).";
CM_ SG_ 1796 CONST_63_1 "Constant 0 (0x0) in every record observed: reserved/padding or configuration.";
CM_ SG_ 1796 VLONG_OVER_GROUND "Longitudinal velocity OVER GROUND, m/s. 0.15 m/s/code, zero 510.5. vRel = this - ego speed. Radar-only scale check (own range slope vs GPS ego) gives 0.150/0.149/0.153 on three drives. Beats zero and range differencing against a camera reference, but has unflagged ~1 s excursions at range. Unsettled for age < ~60.";
CM_ SG_ 1796 VLAT_OVER_GROUND_PROV "Lateral velocity over ground, LEFT positive (sign confirmed). Scale NOT pinned: the factor shown (0.15) is a placeholder. Radar-only estimates from its own lateral position change range 0.097-0.147 m/s per code across data sets, and the pre-registered test was unverified. See docs/14.";
CM_ SG_ 1796 ALONG_LIKE_84 "Acceleration-like, zero code 511 at standstill. Follows the VLONG change with a ~0.5 s lag, so it cannot flag or lead a velocity excursion. Radar-only scale about 0.04 m/s^2 per code on most data but drive-dependent (0.03-0.11); centred codes (docs/14).";
CM_ SG_ 1796 CONST_94_2 "Constant 0 (0x0) in every record observed: reserved/padding or configuration.";
CM_ SG_ 1796 UNK_96 "Unnamed 10-bit carry chain centred near 511; no relation to velocity or range error on three drives.";
CM_ SG_ 1796 UNK_106_1 "Candidate from the carry-chain split, unverified: LSB flips 0.003 per cycle, 2 distinct values 0..1. Strongest correlation: v_over_ground r=-0.14.";
CM_ SG_ 1796 UNK_107_1 "Candidate from the carry-chain split, unverified: LSB flips 0.013 per cycle, 2 distinct values 0..1. Strongest correlation: v_over_ground r=-0.24. Coasting-flag candidate: about 0.02 in settled life, 0.5-0.66 just before deletion (docs/14).";
CM_ SG_ 1796 CONST_108_1 "Constant 0 (0x0) in every record observed: reserved/padding or configuration.";
CM_ SG_ 1796 MOVE_STATE "Movement state. 0 = moving away / same direction, 2 = moving toward (oncoming), 1 and 3 = not clearly moving (1 vs 3 unresolved). Pre-registered test on unseen segments: value 0 had over-ground speed > 0.5 m/s on 99.65% of rows, value 2 < -0.5 m/s on 99.88%, values 1/3 |v| < 2 m/s on 89.5% (docs/14).";
CM_ SG_ 1796 UNK_111_4 "Candidate from the carry-chain split, unverified: LSB flips 0.008 per cycle, 10 distinct values 0..9. Strongest correlation: dRel r=-0.53.";
CM_ SG_ 1796 UNK_115_8 "Candidate from the carry-chain split, unverified: LSB flips 0.052 per cycle, 26 distinct values 0..178. Strongest correlation: age r=+0.27.";
CM_ SG_ 1796 CONST_123_5 "Constant 31 (0x1F) in every record observed: reserved/padding or configuration.";
CM_ SG_ 1796 UNK_128_2 "Candidate from the carry-chain split, unverified: LSB flips 0.013 per cycle, 4 distinct values 0..3. Strongest correlation: dRel r=+0.11.";
CM_ SG_ 1796 UNK_130_1 "Candidate from the carry-chain split, unverified: LSB flips 0.019 per cycle, 2 distinct values 0..1. Strongest correlation: abs_yRel r=+0.34.";
CM_ SG_ 1796 UNK_131_4 "Candidate from the carry-chain split, unverified: LSB flips 0.102 per cycle, 9 distinct values 7..15. Strongest correlation: abs_yRel r=+0.09.";
CM_ SG_ 1796 CONST_135_1 "Constant 0 (0x0) in every record observed: reserved/padding or configuration.";
CM_ SG_ 1796 UNK_136_6 "Candidate from the carry-chain split, unverified: LSB flips 0.093 per cycle, 39 distinct values 3..63. Strongest correlation: age r=+0.20.";
CM_ SG_ 1796 UNK_142_1 "Candidate from the carry-chain split, unverified: LSB flips 0.007 per cycle, 2 distinct values 0..1. Strongest correlation: age r=+0.47.";
CM_ SG_ 1796 CONST_143_5 "Constant 30 (0x1E) in every record observed: reserved/padding or configuration.";
CM_ SG_ 1796 UNK_148_8 "Candidate from the carry-chain split, unverified: LSB flips 0.009 per cycle, 27 distinct values 0..240. Strongest correlation: dRel r=-0.12.";
CM_ SG_ 1796 UNK_156_4 "Candidate from the carry-chain split, unverified: LSB flips 0.016 per cycle, 16 distinct values 0..15. Strongest correlation: abs_yRel r=-0.42.";
CM_ SG_ 1796 CONST_160_3 "Constant 0 (0x0) in every record observed: reserved/padding or configuration.";
CM_ SG_ 1796 UNK_163_2 "Candidate from the carry-chain split, unverified: LSB flips 0.006 per cycle, 3 distinct values 1..3. Strongest correlation: age r=+0.30.";
CM_ SG_ 1796 CONST_165_3 "Constant 0 (0x0) in every record observed: reserved/padding or configuration.";
CM_ SG_ 1796 UNK_168_10 "Candidate from the carry-chain split, unverified: LSB flips 0.066 per cycle, 3 distinct values 0..1023. Strongest correlation: abs_yRel r=+0.14.";
CM_ SG_ 1796 CONST_178_3 "Constant 0 (0x0) in every record observed: reserved/padding or configuration.";
CM_ SG_ 1796 UNK_181_1 "Candidate from the carry-chain split, unverified: LSB flips 0.071 per cycle, 2 distinct values 0..1. Strongest correlation: v_over_ground r=+0.34.";
CM_ SG_ 1796 CONST_182_1 "Constant 0 (0x0) in every record observed: reserved/padding or configuration.";
CM_ SG_ 1796 UNK_183_7 "Candidate from the carry-chain split, unverified: LSB flips 0.009 per cycle, 24 distinct values 26..73. Strongest correlation: age r=+0.20.";
CM_ SG_ 1796 CONST_190_10 "Constant 1 (0x1) in every record observed: reserved/padding or configuration.";
CM_ SG_ 1796 UNK_200_7 "Candidate from the carry-chain split, unverified: LSB flips 0.023 per cycle, 16 distinct values 0..127. Strongest correlation: v_over_ground r=-0.45.";
CM_ SG_ 1796 CONST_207_1 "Constant 0 (0x0) in every record observed: reserved/padding or configuration.";
CM_ SG_ 1796 UNK_208_6 "Candidate from the carry-chain split, unverified: LSB flips 0.017 per cycle, 20 distinct values 0..63. Strongest correlation: v_over_ground r=-0.38.";
CM_ SG_ 1796 CONST_214_2 "Constant 0 (0x0) in every record observed: reserved/padding or configuration.";
CM_ SG_ 1796 UNK_216_6 "Candidate from the carry-chain split, unverified: LSB flips 0.150 per cycle, 34 distinct values 3..49. Strongest correlation: age r=+0.23. Size / class candidate: camera vehicle height partial rho 0.44-0.63, truck/bus 0.35-0.42; width on A/C. Compare ARS4-B Length / dZ (6 bits) (docs/14).";
CM_ SG_ 1796 CONST_222_2 "Constant 0 (0x0) in every record observed: reserved/padding or configuration.";
CM_ SG_ 1796 UNK_224_7 "Candidate from the carry-chain split, unverified: LSB flips 0.344 per cycle, 127 distinct values 1..127. Strongest correlation: dRel r=+0.80. Uncertainty candidate: scales with range (r~0.8), falls with age at fixed range (rho -0.29 to -0.36), larger when range steps are noisier, rises before deletion. Weak near-range error indicator; does not single out excursions.";
CM_ SG_ 1796 CONST_231_1 "Constant 0 (0x0) in every record observed: reserved/padding or configuration.";
CM_ SG_ 1796 UNK_232_7 "Candidate from the carry-chain split, unverified: LSB flips 0.096 per cycle, 72 distinct values 0..127. Strongest correlation: abs_yRel r=+0.60. Lateral-uncertainty candidate: scales with |yRel| (r~0.6), falls with age at fixed range (rho -0.50 to -0.59).";
CM_ SG_ 1796 PER_TRACK_239_1 "Constant within a track, differs between tracks (2 values 0..1): object attribute candidate, unverified. Strongest correlation: abs_yRel r=+0.09.";
CM_ SG_ 1796 UNK_240_7 "Candidate from the carry-chain split, unverified: LSB flips 0.364 per cycle, 127 distinct values 1..127. Strongest correlation: dRel r=+0.80. Velocity-uncertainty candidate (like ARS408 VrelLong_rms): scales with range, falls with age, rises before deletion. Higher when native vRel disagrees with the camera by > 2 m/s (stratified AUC ~0.62 on drives A-C); moderate, not a clean excursion flag (docs/14). Decoded as vel_unc_code.";
CM_ SG_ 1796 CONST_247_1 "Constant 0 (0x0) in every record observed: reserved/padding or configuration.";
CM_ SG_ 1796 UNK_248_7 "Candidate from the carry-chain split, unverified: LSB flips 0.116 per cycle, 97 distinct values 0..127. Strongest correlation: abs_yRel r=+0.56. Uncertainty candidate: scales with |yRel| (r~0.56), falls with age at fixed range (rho -0.70 to -0.75).";
CM_ SG_ 1796 CONST_255_1 "Constant 0 (0x0) in every record observed: reserved/padding or configuration.";
CM_ SG_ 1796 UNK_256_5 "Candidate from the carry-chain split, unverified: LSB flips 0.177 per cycle, 30 distinct values 0..30. Strongest correlation: age r=+0.72. Existence / confidence candidate: rises with age at fixed range (rho +0.86 to +0.90), drops about 1.5 codes before deletion. Compare ARS4-B ProbExist (5 bits).";
CM_ SG_ 1796 CONST_261_3 "Constant 0 (0x0) in every record observed: reserved/padding or configuration.";
CM_ SG_ 1796 UNK_264_5 "Candidate from the carry-chain split, unverified: LSB flips 0.100 per cycle, 19 distinct values 0..18. Strongest correlation: age r=-0.81. Uncertainty candidate: falls with age at fixed range (rho -0.61 to -0.68), rises before deletion.";
CM_ SG_ 1796 CONST_269_3 "Constant 0 (0x0) in every record observed: reserved/padding or configuration.";
CM_ SG_ 1796 UNK_272_5 "Candidate from the carry-chain split, unverified: LSB flips 0.095 per cycle, 17 distinct values 2..18. Strongest correlation: age r=+0.30. Size / class candidate: camera vehicle height partial rho 0.41-0.71, width 0.36-0.69, truck/bus 0.24-0.39 (docs/14).";
CM_ SG_ 1796 CONST_277_11 "Constant 0 (0x0) in every record observed: reserved/padding or configuration.";
CM_ BO_ 1797 "Reassembled 0x80 object slot 5 (record bytes 197-232), sent only when occupied. Little-endian bit field: bit 0 = LSB of slot byte 0.";
CM_ SG_ 1797 STATE_CODE "Raw lifecycle state. Measured/predicted semantics not proved; not an accuracy gate.";
CM_ SG_ 1797 SLOT_INDEX_CODE "Physical slot index or 63 in unallocated-form headers; verified against slot positions. Not class or reference point.";
CM_ SG_ 1797 UNK_8_6 "Candidate from the carry-chain split, unverified: LSB flips 0.103 per cycle, 32 distinct values 30..62. Strongest correlation: age r=+0.55. Ramps up with age and saturates at 62; tracks range and scenario, not measured error.";
CM_ SG_ 1797 ONCOMING_FLAG "1 = oncoming now or earlier in the track life (persists after an oncoming object slows). Pre-registered test on unseen segments: over-ground speed < 0 on 100% of flagged rows, 88.5% of objects approaching faster than 2 m/s flagged (docs/14).";
CM_ SG_ 1797 CONST_15_1 "Constant 0 (0x0) in every record observed: reserved/padding or configuration.";
CM_ SG_ 1797 SCORE_CODE "Bounded score-like byte, not calibrated confidence or percent. Value 100 does not guarantee accurate geometry or velocity.";
CM_ SG_ 1797 AGE "Track age in radar cycles (~60 ms): 1 at birth, saturates at 126; 0 = slot being retired (geometry is the previous occupant's). A restart is a new track. Tracks younger than ~60 carry unconverged range and velocity.";
CM_ SG_ 1797 CONST_31_1 "Constant 0 (0x0) in every record observed: reserved/padding or configuration.";
CM_ SG_ 1797 DREL "Longitudinal distance forward of the radar, m. 1/16 m, zero code 160 (exactly -10 m). Camera ground contact at 5-25 m: slope 0.99-1.00 on three drives, zero within 0.2 m (0.7 m on a hilly drive). Settled tracks walk by metres record to record at 40 m+; young tracks can be far off.";
CM_ SG_ 1797 YREL_LEFT "Lateral offset, LEFT positive (openpilot yRel), m. 1/64 m, offset binary around 2048. Cartesian (constant across range), not an angle. Correct side 97.9-99.3% on held-out drives; scale bounded to about +/-10%. |code-2048| >= 2000 is a sentinel.";
CM_ SG_ 1797 UNK_56_7 "Candidate from the carry-chain split, unverified: LSB flips 0.355 per cycle, 84 distinct values 4..96. Strongest correlation: age r=+0.30. Size / class candidate: per-track median follows camera vehicle height (partial rho 0.48-0.61 at fixed range) and truck/bus class (docs/14).";
CM_ SG_ 1797 CONST_63_1 "Constant 0 (0x0) in every record observed: reserved/padding or configuration.";
CM_ SG_ 1797 VLONG_OVER_GROUND "Longitudinal velocity OVER GROUND, m/s. 0.15 m/s/code, zero 510.5. vRel = this - ego speed. Radar-only scale check (own range slope vs GPS ego) gives 0.150/0.149/0.153 on three drives. Beats zero and range differencing against a camera reference, but has unflagged ~1 s excursions at range. Unsettled for age < ~60.";
CM_ SG_ 1797 VLAT_OVER_GROUND_PROV "Lateral velocity over ground, LEFT positive (sign confirmed). Scale NOT pinned: the factor shown (0.15) is a placeholder. Radar-only estimates from its own lateral position change range 0.097-0.147 m/s per code across data sets, and the pre-registered test was unverified. See docs/14.";
CM_ SG_ 1797 ALONG_LIKE_84 "Acceleration-like, zero code 511 at standstill. Follows the VLONG change with a ~0.5 s lag, so it cannot flag or lead a velocity excursion. Radar-only scale about 0.04 m/s^2 per code on most data but drive-dependent (0.03-0.11); centred codes (docs/14).";
CM_ SG_ 1797 CONST_94_2 "Constant 0 (0x0) in every record observed: reserved/padding or configuration.";
CM_ SG_ 1797 UNK_96 "Unnamed 10-bit carry chain centred near 511; no relation to velocity or range error on three drives.";
CM_ SG_ 1797 UNK_106_1 "Candidate from the carry-chain split, unverified: LSB flips 0.003 per cycle, 2 distinct values 0..1. Strongest correlation: v_over_ground r=-0.14.";
CM_ SG_ 1797 UNK_107_1 "Candidate from the carry-chain split, unverified: LSB flips 0.013 per cycle, 2 distinct values 0..1. Strongest correlation: v_over_ground r=-0.24. Coasting-flag candidate: about 0.02 in settled life, 0.5-0.66 just before deletion (docs/14).";
CM_ SG_ 1797 CONST_108_1 "Constant 0 (0x0) in every record observed: reserved/padding or configuration.";
CM_ SG_ 1797 MOVE_STATE "Movement state. 0 = moving away / same direction, 2 = moving toward (oncoming), 1 and 3 = not clearly moving (1 vs 3 unresolved). Pre-registered test on unseen segments: value 0 had over-ground speed > 0.5 m/s on 99.65% of rows, value 2 < -0.5 m/s on 99.88%, values 1/3 |v| < 2 m/s on 89.5% (docs/14).";
CM_ SG_ 1797 UNK_111_4 "Candidate from the carry-chain split, unverified: LSB flips 0.008 per cycle, 10 distinct values 0..9. Strongest correlation: dRel r=-0.53.";
CM_ SG_ 1797 UNK_115_8 "Candidate from the carry-chain split, unverified: LSB flips 0.052 per cycle, 26 distinct values 0..178. Strongest correlation: age r=+0.27.";
CM_ SG_ 1797 CONST_123_5 "Constant 31 (0x1F) in every record observed: reserved/padding or configuration.";
CM_ SG_ 1797 UNK_128_2 "Candidate from the carry-chain split, unverified: LSB flips 0.013 per cycle, 4 distinct values 0..3. Strongest correlation: dRel r=+0.11.";
CM_ SG_ 1797 UNK_130_1 "Candidate from the carry-chain split, unverified: LSB flips 0.019 per cycle, 2 distinct values 0..1. Strongest correlation: abs_yRel r=+0.34.";
CM_ SG_ 1797 UNK_131_4 "Candidate from the carry-chain split, unverified: LSB flips 0.102 per cycle, 9 distinct values 7..15. Strongest correlation: abs_yRel r=+0.09.";
CM_ SG_ 1797 CONST_135_1 "Constant 0 (0x0) in every record observed: reserved/padding or configuration.";
CM_ SG_ 1797 UNK_136_6 "Candidate from the carry-chain split, unverified: LSB flips 0.093 per cycle, 39 distinct values 3..63. Strongest correlation: age r=+0.20.";
CM_ SG_ 1797 UNK_142_1 "Candidate from the carry-chain split, unverified: LSB flips 0.007 per cycle, 2 distinct values 0..1. Strongest correlation: age r=+0.47.";
CM_ SG_ 1797 CONST_143_5 "Constant 30 (0x1E) in every record observed: reserved/padding or configuration.";
CM_ SG_ 1797 UNK_148_8 "Candidate from the carry-chain split, unverified: LSB flips 0.009 per cycle, 27 distinct values 0..240. Strongest correlation: dRel r=-0.12.";
CM_ SG_ 1797 UNK_156_4 "Candidate from the carry-chain split, unverified: LSB flips 0.016 per cycle, 16 distinct values 0..15. Strongest correlation: abs_yRel r=-0.42.";
CM_ SG_ 1797 CONST_160_3 "Constant 0 (0x0) in every record observed: reserved/padding or configuration.";
CM_ SG_ 1797 UNK_163_2 "Candidate from the carry-chain split, unverified: LSB flips 0.006 per cycle, 3 distinct values 1..3. Strongest correlation: age r=+0.30.";
CM_ SG_ 1797 CONST_165_3 "Constant 0 (0x0) in every record observed: reserved/padding or configuration.";
CM_ SG_ 1797 UNK_168_10 "Candidate from the carry-chain split, unverified: LSB flips 0.066 per cycle, 3 distinct values 0..1023. Strongest correlation: abs_yRel r=+0.14.";
CM_ SG_ 1797 CONST_178_3 "Constant 0 (0x0) in every record observed: reserved/padding or configuration.";
CM_ SG_ 1797 UNK_181_1 "Candidate from the carry-chain split, unverified: LSB flips 0.071 per cycle, 2 distinct values 0..1. Strongest correlation: v_over_ground r=+0.34.";
CM_ SG_ 1797 CONST_182_1 "Constant 0 (0x0) in every record observed: reserved/padding or configuration.";
CM_ SG_ 1797 UNK_183_7 "Candidate from the carry-chain split, unverified: LSB flips 0.009 per cycle, 24 distinct values 26..73. Strongest correlation: age r=+0.20.";
CM_ SG_ 1797 CONST_190_10 "Constant 1 (0x1) in every record observed: reserved/padding or configuration.";
CM_ SG_ 1797 UNK_200_7 "Candidate from the carry-chain split, unverified: LSB flips 0.023 per cycle, 16 distinct values 0..127. Strongest correlation: v_over_ground r=-0.45.";
CM_ SG_ 1797 CONST_207_1 "Constant 0 (0x0) in every record observed: reserved/padding or configuration.";
CM_ SG_ 1797 UNK_208_6 "Candidate from the carry-chain split, unverified: LSB flips 0.017 per cycle, 20 distinct values 0..63. Strongest correlation: v_over_ground r=-0.38.";
CM_ SG_ 1797 CONST_214_2 "Constant 0 (0x0) in every record observed: reserved/padding or configuration.";
CM_ SG_ 1797 UNK_216_6 "Candidate from the carry-chain split, unverified: LSB flips 0.150 per cycle, 34 distinct values 3..49. Strongest correlation: age r=+0.23. Size / class candidate: camera vehicle height partial rho 0.44-0.63, truck/bus 0.35-0.42; width on A/C. Compare ARS4-B Length / dZ (6 bits) (docs/14).";
CM_ SG_ 1797 CONST_222_2 "Constant 0 (0x0) in every record observed: reserved/padding or configuration.";
CM_ SG_ 1797 UNK_224_7 "Candidate from the carry-chain split, unverified: LSB flips 0.344 per cycle, 127 distinct values 1..127. Strongest correlation: dRel r=+0.80. Uncertainty candidate: scales with range (r~0.8), falls with age at fixed range (rho -0.29 to -0.36), larger when range steps are noisier, rises before deletion. Weak near-range error indicator; does not single out excursions.";
CM_ SG_ 1797 CONST_231_1 "Constant 0 (0x0) in every record observed: reserved/padding or configuration.";
CM_ SG_ 1797 UNK_232_7 "Candidate from the carry-chain split, unverified: LSB flips 0.096 per cycle, 72 distinct values 0..127. Strongest correlation: abs_yRel r=+0.60. Lateral-uncertainty candidate: scales with |yRel| (r~0.6), falls with age at fixed range (rho -0.50 to -0.59).";
CM_ SG_ 1797 PER_TRACK_239_1 "Constant within a track, differs between tracks (2 values 0..1): object attribute candidate, unverified. Strongest correlation: abs_yRel r=+0.09.";
CM_ SG_ 1797 UNK_240_7 "Candidate from the carry-chain split, unverified: LSB flips 0.364 per cycle, 127 distinct values 1..127. Strongest correlation: dRel r=+0.80. Velocity-uncertainty candidate (like ARS408 VrelLong_rms): scales with range, falls with age, rises before deletion. Higher when native vRel disagrees with the camera by > 2 m/s (stratified AUC ~0.62 on drives A-C); moderate, not a clean excursion flag (docs/14). Decoded as vel_unc_code.";
CM_ SG_ 1797 CONST_247_1 "Constant 0 (0x0) in every record observed: reserved/padding or configuration.";
CM_ SG_ 1797 UNK_248_7 "Candidate from the carry-chain split, unverified: LSB flips 0.116 per cycle, 97 distinct values 0..127. Strongest correlation: abs_yRel r=+0.56. Uncertainty candidate: scales with |yRel| (r~0.56), falls with age at fixed range (rho -0.70 to -0.75).";
CM_ SG_ 1797 CONST_255_1 "Constant 0 (0x0) in every record observed: reserved/padding or configuration.";
CM_ SG_ 1797 UNK_256_5 "Candidate from the carry-chain split, unverified: LSB flips 0.177 per cycle, 30 distinct values 0..30. Strongest correlation: age r=+0.72. Existence / confidence candidate: rises with age at fixed range (rho +0.86 to +0.90), drops about 1.5 codes before deletion. Compare ARS4-B ProbExist (5 bits).";
CM_ SG_ 1797 CONST_261_3 "Constant 0 (0x0) in every record observed: reserved/padding or configuration.";
CM_ SG_ 1797 UNK_264_5 "Candidate from the carry-chain split, unverified: LSB flips 0.100 per cycle, 19 distinct values 0..18. Strongest correlation: age r=-0.81. Uncertainty candidate: falls with age at fixed range (rho -0.61 to -0.68), rises before deletion.";
CM_ SG_ 1797 CONST_269_3 "Constant 0 (0x0) in every record observed: reserved/padding or configuration.";
CM_ SG_ 1797 UNK_272_5 "Candidate from the carry-chain split, unverified: LSB flips 0.095 per cycle, 17 distinct values 2..18. Strongest correlation: age r=+0.30. Size / class candidate: camera vehicle height partial rho 0.41-0.71, width 0.36-0.69, truck/bus 0.24-0.39 (docs/14).";
CM_ SG_ 1797 CONST_277_11 "Constant 0 (0x0) in every record observed: reserved/padding or configuration.";
CM_ BO_ 1798 "Reassembled 0x80 object slot 6 (record bytes 233-268), sent only when occupied. Little-endian bit field: bit 0 = LSB of slot byte 0.";
CM_ SG_ 1798 STATE_CODE "Raw lifecycle state. Measured/predicted semantics not proved; not an accuracy gate.";
CM_ SG_ 1798 SLOT_INDEX_CODE "Physical slot index or 63 in unallocated-form headers; verified against slot positions. Not class or reference point.";
CM_ SG_ 1798 UNK_8_6 "Candidate from the carry-chain split, unverified: LSB flips 0.103 per cycle, 32 distinct values 30..62. Strongest correlation: age r=+0.55. Ramps up with age and saturates at 62; tracks range and scenario, not measured error.";
CM_ SG_ 1798 ONCOMING_FLAG "1 = oncoming now or earlier in the track life (persists after an oncoming object slows). Pre-registered test on unseen segments: over-ground speed < 0 on 100% of flagged rows, 88.5% of objects approaching faster than 2 m/s flagged (docs/14).";
CM_ SG_ 1798 CONST_15_1 "Constant 0 (0x0) in every record observed: reserved/padding or configuration.";
CM_ SG_ 1798 SCORE_CODE "Bounded score-like byte, not calibrated confidence or percent. Value 100 does not guarantee accurate geometry or velocity.";
CM_ SG_ 1798 AGE "Track age in radar cycles (~60 ms): 1 at birth, saturates at 126; 0 = slot being retired (geometry is the previous occupant's). A restart is a new track. Tracks younger than ~60 carry unconverged range and velocity.";
CM_ SG_ 1798 CONST_31_1 "Constant 0 (0x0) in every record observed: reserved/padding or configuration.";
CM_ SG_ 1798 DREL "Longitudinal distance forward of the radar, m. 1/16 m, zero code 160 (exactly -10 m). Camera ground contact at 5-25 m: slope 0.99-1.00 on three drives, zero within 0.2 m (0.7 m on a hilly drive). Settled tracks walk by metres record to record at 40 m+; young tracks can be far off.";
CM_ SG_ 1798 YREL_LEFT "Lateral offset, LEFT positive (openpilot yRel), m. 1/64 m, offset binary around 2048. Cartesian (constant across range), not an angle. Correct side 97.9-99.3% on held-out drives; scale bounded to about +/-10%. |code-2048| >= 2000 is a sentinel.";
CM_ SG_ 1798 UNK_56_7 "Candidate from the carry-chain split, unverified: LSB flips 0.355 per cycle, 84 distinct values 4..96. Strongest correlation: age r=+0.30. Size / class candidate: per-track median follows camera vehicle height (partial rho 0.48-0.61 at fixed range) and truck/bus class (docs/14).";
CM_ SG_ 1798 CONST_63_1 "Constant 0 (0x0) in every record observed: reserved/padding or configuration.";
CM_ SG_ 1798 VLONG_OVER_GROUND "Longitudinal velocity OVER GROUND, m/s. 0.15 m/s/code, zero 510.5. vRel = this - ego speed. Radar-only scale check (own range slope vs GPS ego) gives 0.150/0.149/0.153 on three drives. Beats zero and range differencing against a camera reference, but has unflagged ~1 s excursions at range. Unsettled for age < ~60.";
CM_ SG_ 1798 VLAT_OVER_GROUND_PROV "Lateral velocity over ground, LEFT positive (sign confirmed). Scale NOT pinned: the factor shown (0.15) is a placeholder. Radar-only estimates from its own lateral position change range 0.097-0.147 m/s per code across data sets, and the pre-registered test was unverified. See docs/14.";
CM_ SG_ 1798 ALONG_LIKE_84 "Acceleration-like, zero code 511 at standstill. Follows the VLONG change with a ~0.5 s lag, so it cannot flag or lead a velocity excursion. Radar-only scale about 0.04 m/s^2 per code on most data but drive-dependent (0.03-0.11); centred codes (docs/14).";
CM_ SG_ 1798 CONST_94_2 "Constant 0 (0x0) in every record observed: reserved/padding or configuration.";
CM_ SG_ 1798 UNK_96 "Unnamed 10-bit carry chain centred near 511; no relation to velocity or range error on three drives.";
CM_ SG_ 1798 UNK_106_1 "Candidate from the carry-chain split, unverified: LSB flips 0.003 per cycle, 2 distinct values 0..1. Strongest correlation: v_over_ground r=-0.14.";
CM_ SG_ 1798 UNK_107_1 "Candidate from the carry-chain split, unverified: LSB flips 0.013 per cycle, 2 distinct values 0..1. Strongest correlation: v_over_ground r=-0.24. Coasting-flag candidate: about 0.02 in settled life, 0.5-0.66 just before deletion (docs/14).";
CM_ SG_ 1798 CONST_108_1 "Constant 0 (0x0) in every record observed: reserved/padding or configuration.";
CM_ SG_ 1798 MOVE_STATE "Movement state. 0 = moving away / same direction, 2 = moving toward (oncoming), 1 and 3 = not clearly moving (1 vs 3 unresolved). Pre-registered test on unseen segments: value 0 had over-ground speed > 0.5 m/s on 99.65% of rows, value 2 < -0.5 m/s on 99.88%, values 1/3 |v| < 2 m/s on 89.5% (docs/14).";
CM_ SG_ 1798 UNK_111_4 "Candidate from the carry-chain split, unverified: LSB flips 0.008 per cycle, 10 distinct values 0..9. Strongest correlation: dRel r=-0.53.";
CM_ SG_ 1798 UNK_115_8 "Candidate from the carry-chain split, unverified: LSB flips 0.052 per cycle, 26 distinct values 0..178. Strongest correlation: age r=+0.27.";
CM_ SG_ 1798 CONST_123_5 "Constant 31 (0x1F) in every record observed: reserved/padding or configuration.";
CM_ SG_ 1798 UNK_128_2 "Candidate from the carry-chain split, unverified: LSB flips 0.013 per cycle, 4 distinct values 0..3. Strongest correlation: dRel r=+0.11.";
CM_ SG_ 1798 UNK_130_1 "Candidate from the carry-chain split, unverified: LSB flips 0.019 per cycle, 2 distinct values 0..1. Strongest correlation: abs_yRel r=+0.34.";
CM_ SG_ 1798 UNK_131_4 "Candidate from the carry-chain split, unverified: LSB flips 0.102 per cycle, 9 distinct values 7..15. Strongest correlation: abs_yRel r=+0.09.";
CM_ SG_ 1798 CONST_135_1 "Constant 0 (0x0) in every record observed: reserved/padding or configuration.";
CM_ SG_ 1798 UNK_136_6 "Candidate from the carry-chain split, unverified: LSB flips 0.093 per cycle, 39 distinct values 3..63. Strongest correlation: age r=+0.20.";
CM_ SG_ 1798 UNK_142_1 "Candidate from the carry-chain split, unverified: LSB flips 0.007 per cycle, 2 distinct values 0..1. Strongest correlation: age r=+0.47.";
CM_ SG_ 1798 CONST_143_5 "Constant 30 (0x1E) in every record observed: reserved/padding or configuration.";
CM_ SG_ 1798 UNK_148_8 "Candidate from the carry-chain split, unverified: LSB flips 0.009 per cycle, 27 distinct values 0..240. Strongest correlation: dRel r=-0.12.";
CM_ SG_ 1798 UNK_156_4 "Candidate from the carry-chain split, unverified: LSB flips 0.016 per cycle, 16 distinct values 0..15. Strongest correlation: abs_yRel r=-0.42.";
CM_ SG_ 1798 CONST_160_3 "Constant 0 (0x0) in every record observed: reserved/padding or configuration.";
CM_ SG_ 1798 UNK_163_2 "Candidate from the carry-chain split, unverified: LSB flips 0.006 per cycle, 3 distinct values 1..3. Strongest correlation: age r=+0.30.";
CM_ SG_ 1798 CONST_165_3 "Constant 0 (0x0) in every record observed: reserved/padding or configuration.";
CM_ SG_ 1798 UNK_168_10 "Candidate from the carry-chain split, unverified: LSB flips 0.066 per cycle, 3 distinct values 0..1023. Strongest correlation: abs_yRel r=+0.14.";
CM_ SG_ 1798 CONST_178_3 "Constant 0 (0x0) in every record observed: reserved/padding or configuration.";
CM_ SG_ 1798 UNK_181_1 "Candidate from the carry-chain split, unverified: LSB flips 0.071 per cycle, 2 distinct values 0..1. Strongest correlation: v_over_ground r=+0.34.";
CM_ SG_ 1798 CONST_182_1 "Constant 0 (0x0) in every record observed: reserved/padding or configuration.";
CM_ SG_ 1798 UNK_183_7 "Candidate from the carry-chain split, unverified: LSB flips 0.009 per cycle, 24 distinct values 26..73. Strongest correlation: age r=+0.20.";
CM_ SG_ 1798 CONST_190_10 "Constant 1 (0x1) in every record observed: reserved/padding or configuration.";
CM_ SG_ 1798 UNK_200_7 "Candidate from the carry-chain split, unverified: LSB flips 0.023 per cycle, 16 distinct values 0..127. Strongest correlation: v_over_ground r=-0.45.";
CM_ SG_ 1798 CONST_207_1 "Constant 0 (0x0) in every record observed: reserved/padding or configuration.";
CM_ SG_ 1798 UNK_208_6 "Candidate from the carry-chain split, unverified: LSB flips 0.017 per cycle, 20 distinct values 0..63. Strongest correlation: v_over_ground r=-0.38.";
CM_ SG_ 1798 CONST_214_2 "Constant 0 (0x0) in every record observed: reserved/padding or configuration.";
CM_ SG_ 1798 UNK_216_6 "Candidate from the carry-chain split, unverified: LSB flips 0.150 per cycle, 34 distinct values 3..49. Strongest correlation: age r=+0.23. Size / class candidate: camera vehicle height partial rho 0.44-0.63, truck/bus 0.35-0.42; width on A/C. Compare ARS4-B Length / dZ (6 bits) (docs/14).";
CM_ SG_ 1798 CONST_222_2 "Constant 0 (0x0) in every record observed: reserved/padding or configuration.";
CM_ SG_ 1798 UNK_224_7 "Candidate from the carry-chain split, unverified: LSB flips 0.344 per cycle, 127 distinct values 1..127. Strongest correlation: dRel r=+0.80. Uncertainty candidate: scales with range (r~0.8), falls with age at fixed range (rho -0.29 to -0.36), larger when range steps are noisier, rises before deletion. Weak near-range error indicator; does not single out excursions.";
CM_ SG_ 1798 CONST_231_1 "Constant 0 (0x0) in every record observed: reserved/padding or configuration.";
CM_ SG_ 1798 UNK_232_7 "Candidate from the carry-chain split, unverified: LSB flips 0.096 per cycle, 72 distinct values 0..127. Strongest correlation: abs_yRel r=+0.60. Lateral-uncertainty candidate: scales with |yRel| (r~0.6), falls with age at fixed range (rho -0.50 to -0.59).";
CM_ SG_ 1798 PER_TRACK_239_1 "Constant within a track, differs between tracks (2 values 0..1): object attribute candidate, unverified. Strongest correlation: abs_yRel r=+0.09.";
CM_ SG_ 1798 UNK_240_7 "Candidate from the carry-chain split, unverified: LSB flips 0.364 per cycle, 127 distinct values 1..127. Strongest correlation: dRel r=+0.80. Velocity-uncertainty candidate (like ARS408 VrelLong_rms): scales with range, falls with age, rises before deletion. Higher when native vRel disagrees with the camera by > 2 m/s (stratified AUC ~0.62 on drives A-C); moderate, not a clean excursion flag (docs/14). Decoded as vel_unc_code.";
CM_ SG_ 1798 CONST_247_1 "Constant 0 (0x0) in every record observed: reserved/padding or configuration.";
CM_ SG_ 1798 UNK_248_7 "Candidate from the carry-chain split, unverified: LSB flips 0.116 per cycle, 97 distinct values 0..127. Strongest correlation: abs_yRel r=+0.56. Uncertainty candidate: scales with |yRel| (r~0.56), falls with age at fixed range (rho -0.70 to -0.75).";
CM_ SG_ 1798 CONST_255_1 "Constant 0 (0x0) in every record observed: reserved/padding or configuration.";
CM_ SG_ 1798 UNK_256_5 "Candidate from the carry-chain split, unverified: LSB flips 0.177 per cycle, 30 distinct values 0..30. Strongest correlation: age r=+0.72. Existence / confidence candidate: rises with age at fixed range (rho +0.86 to +0.90), drops about 1.5 codes before deletion. Compare ARS4-B ProbExist (5 bits).";
CM_ SG_ 1798 CONST_261_3 "Constant 0 (0x0) in every record observed: reserved/padding or configuration.";
CM_ SG_ 1798 UNK_264_5 "Candidate from the carry-chain split, unverified: LSB flips 0.100 per cycle, 19 distinct values 0..18. Strongest correlation: age r=-0.81. Uncertainty candidate: falls with age at fixed range (rho -0.61 to -0.68), rises before deletion.";
CM_ SG_ 1798 CONST_269_3 "Constant 0 (0x0) in every record observed: reserved/padding or configuration.";
CM_ SG_ 1798 UNK_272_5 "Candidate from the carry-chain split, unverified: LSB flips 0.095 per cycle, 17 distinct values 2..18. Strongest correlation: age r=+0.30. Size / class candidate: camera vehicle height partial rho 0.41-0.71, width 0.36-0.69, truck/bus 0.24-0.39 (docs/14).";
CM_ SG_ 1798 CONST_277_11 "Constant 0 (0x0) in every record observed: reserved/padding or configuration.";
CM_ BO_ 1799 "Reassembled 0x80 object slot 7 (record bytes 269-304), sent only when occupied. Little-endian bit field: bit 0 = LSB of slot byte 0.";
CM_ SG_ 1799 STATE_CODE "Raw lifecycle state. Measured/predicted semantics not proved; not an accuracy gate.";
CM_ SG_ 1799 SLOT_INDEX_CODE "Physical slot index or 63 in unallocated-form headers; verified against slot positions. Not class or reference point.";
CM_ SG_ 1799 UNK_8_6 "Candidate from the carry-chain split, unverified: LSB flips 0.103 per cycle, 32 distinct values 30..62. Strongest correlation: age r=+0.55. Ramps up with age and saturates at 62; tracks range and scenario, not measured error.";
CM_ SG_ 1799 ONCOMING_FLAG "1 = oncoming now or earlier in the track life (persists after an oncoming object slows). Pre-registered test on unseen segments: over-ground speed < 0 on 100% of flagged rows, 88.5% of objects approaching faster than 2 m/s flagged (docs/14).";
CM_ SG_ 1799 CONST_15_1 "Constant 0 (0x0) in every record observed: reserved/padding or configuration.";
CM_ SG_ 1799 SCORE_CODE "Bounded score-like byte, not calibrated confidence or percent. Value 100 does not guarantee accurate geometry or velocity.";
CM_ SG_ 1799 AGE "Track age in radar cycles (~60 ms): 1 at birth, saturates at 126; 0 = slot being retired (geometry is the previous occupant's). A restart is a new track. Tracks younger than ~60 carry unconverged range and velocity.";
CM_ SG_ 1799 CONST_31_1 "Constant 0 (0x0) in every record observed: reserved/padding or configuration.";
CM_ SG_ 1799 DREL "Longitudinal distance forward of the radar, m. 1/16 m, zero code 160 (exactly -10 m). Camera ground contact at 5-25 m: slope 0.99-1.00 on three drives, zero within 0.2 m (0.7 m on a hilly drive). Settled tracks walk by metres record to record at 40 m+; young tracks can be far off.";
CM_ SG_ 1799 YREL_LEFT "Lateral offset, LEFT positive (openpilot yRel), m. 1/64 m, offset binary around 2048. Cartesian (constant across range), not an angle. Correct side 97.9-99.3% on held-out drives; scale bounded to about +/-10%. |code-2048| >= 2000 is a sentinel.";
CM_ SG_ 1799 UNK_56_7 "Candidate from the carry-chain split, unverified: LSB flips 0.355 per cycle, 84 distinct values 4..96. Strongest correlation: age r=+0.30. Size / class candidate: per-track median follows camera vehicle height (partial rho 0.48-0.61 at fixed range) and truck/bus class (docs/14).";
CM_ SG_ 1799 CONST_63_1 "Constant 0 (0x0) in every record observed: reserved/padding or configuration.";
CM_ SG_ 1799 VLONG_OVER_GROUND "Longitudinal velocity OVER GROUND, m/s. 0.15 m/s/code, zero 510.5. vRel = this - ego speed. Radar-only scale check (own range slope vs GPS ego) gives 0.150/0.149/0.153 on three drives. Beats zero and range differencing against a camera reference, but has unflagged ~1 s excursions at range. Unsettled for age < ~60.";
CM_ SG_ 1799 VLAT_OVER_GROUND_PROV "Lateral velocity over ground, LEFT positive (sign confirmed). Scale NOT pinned: the factor shown (0.15) is a placeholder. Radar-only estimates from its own lateral position change range 0.097-0.147 m/s per code across data sets, and the pre-registered test was unverified. See docs/14.";
CM_ SG_ 1799 ALONG_LIKE_84 "Acceleration-like, zero code 511 at standstill. Follows the VLONG change with a ~0.5 s lag, so it cannot flag or lead a velocity excursion. Radar-only scale about 0.04 m/s^2 per code on most data but drive-dependent (0.03-0.11); centred codes (docs/14).";
CM_ SG_ 1799 CONST_94_2 "Constant 0 (0x0) in every record observed: reserved/padding or configuration.";
CM_ SG_ 1799 UNK_96 "Unnamed 10-bit carry chain centred near 511; no relation to velocity or range error on three drives.";
CM_ SG_ 1799 UNK_106_1 "Candidate from the carry-chain split, unverified: LSB flips 0.003 per cycle, 2 distinct values 0..1. Strongest correlation: v_over_ground r=-0.14.";
CM_ SG_ 1799 UNK_107_1 "Candidate from the carry-chain split, unverified: LSB flips 0.013 per cycle, 2 distinct values 0..1. Strongest correlation: v_over_ground r=-0.24. Coasting-flag candidate: about 0.02 in settled life, 0.5-0.66 just before deletion (docs/14).";
CM_ SG_ 1799 CONST_108_1 "Constant 0 (0x0) in every record observed: reserved/padding or configuration.";
CM_ SG_ 1799 MOVE_STATE "Movement state. 0 = moving away / same direction, 2 = moving toward (oncoming), 1 and 3 = not clearly moving (1 vs 3 unresolved). Pre-registered test on unseen segments: value 0 had over-ground speed > 0.5 m/s on 99.65% of rows, value 2 < -0.5 m/s on 99.88%, values 1/3 |v| < 2 m/s on 89.5% (docs/14).";
CM_ SG_ 1799 UNK_111_4 "Candidate from the carry-chain split, unverified: LSB flips 0.008 per cycle, 10 distinct values 0..9. Strongest correlation: dRel r=-0.53.";
CM_ SG_ 1799 UNK_115_8 "Candidate from the carry-chain split, unverified: LSB flips 0.052 per cycle, 26 distinct values 0..178. Strongest correlation: age r=+0.27.";
CM_ SG_ 1799 CONST_123_5 "Constant 31 (0x1F) in every record observed: reserved/padding or configuration.";
CM_ SG_ 1799 UNK_128_2 "Candidate from the carry-chain split, unverified: LSB flips 0.013 per cycle, 4 distinct values 0..3. Strongest correlation: dRel r=+0.11.";
CM_ SG_ 1799 UNK_130_1 "Candidate from the carry-chain split, unverified: LSB flips 0.019 per cycle, 2 distinct values 0..1. Strongest correlation: abs_yRel r=+0.34.";
CM_ SG_ 1799 UNK_131_4 "Candidate from the carry-chain split, unverified: LSB flips 0.102 per cycle, 9 distinct values 7..15. Strongest correlation: abs_yRel r=+0.09.";
CM_ SG_ 1799 CONST_135_1 "Constant 0 (0x0) in every record observed: reserved/padding or configuration.";
CM_ SG_ 1799 UNK_136_6 "Candidate from the carry-chain split, unverified: LSB flips 0.093 per cycle, 39 distinct values 3..63. Strongest correlation: age r=+0.20.";
CM_ SG_ 1799 UNK_142_1 "Candidate from the carry-chain split, unverified: LSB flips 0.007 per cycle, 2 distinct values 0..1. Strongest correlation: age r=+0.47.";
CM_ SG_ 1799 CONST_143_5 "Constant 30 (0x1E) in every record observed: reserved/padding or configuration.";
CM_ SG_ 1799 UNK_148_8 "Candidate from the carry-chain split, unverified: LSB flips 0.009 per cycle, 27 distinct values 0..240. Strongest correlation: dRel r=-0.12.";
CM_ SG_ 1799 UNK_156_4 "Candidate from the carry-chain split, unverified: LSB flips 0.016 per cycle, 16 distinct values 0..15. Strongest correlation: abs_yRel r=-0.42.";
CM_ SG_ 1799 CONST_160_3 "Constant 0 (0x0) in every record observed: reserved/padding or configuration.";
CM_ SG_ 1799 UNK_163_2 "Candidate from the carry-chain split, unverified: LSB flips 0.006 per cycle, 3 distinct values 1..3. Strongest correlation: age r=+0.30.";
CM_ SG_ 1799 CONST_165_3 "Constant 0 (0x0) in every record observed: reserved/padding or configuration.";
CM_ SG_ 1799 UNK_168_10 "Candidate from the carry-chain split, unverified: LSB flips 0.066 per cycle, 3 distinct values 0..1023. Strongest correlation: abs_yRel r=+0.14.";
CM_ SG_ 1799 CONST_178_3 "Constant 0 (0x0) in every record observed: reserved/padding or configuration.";
CM_ SG_ 1799 UNK_181_1 "Candidate from the carry-chain split, unverified: LSB flips 0.071 per cycle, 2 distinct values 0..1. Strongest correlation: v_over_ground r=+0.34.";
CM_ SG_ 1799 CONST_182_1 "Constant 0 (0x0) in every record observed: reserved/padding or configuration.";
CM_ SG_ 1799 UNK_183_7 "Candidate from the carry-chain split, unverified: LSB flips 0.009 per cycle, 24 distinct values 26..73. Strongest correlation: age r=+0.20.";
CM_ SG_ 1799 CONST_190_10 "Constant 1 (0x1) in every record observed: reserved/padding or configuration.";
CM_ SG_ 1799 UNK_200_7 "Candidate from the carry-chain split, unverified: LSB flips 0.023 per cycle, 16 distinct values 0..127. Strongest correlation: v_over_ground r=-0.45.";
CM_ SG_ 1799 CONST_207_1 "Constant 0 (0x0) in every record observed: reserved/padding or configuration.";
CM_ SG_ 1799 UNK_208_6 "Candidate from the carry-chain split, unverified: LSB flips 0.017 per cycle, 20 distinct values 0..63. Strongest correlation: v_over_ground r=-0.38.";
CM_ SG_ 1799 CONST_214_2 "Constant 0 (0x0) in every record observed: reserved/padding or configuration.";
CM_ SG_ 1799 UNK_216_6 "Candidate from the carry-chain split, unverified: LSB flips 0.150 per cycle, 34 distinct values 3..49. Strongest correlation: age r=+0.23. Size / class candidate: camera vehicle height partial rho 0.44-0.63, truck/bus 0.35-0.42; width on A/C. Compare ARS4-B Length / dZ (6 bits) (docs/14).";
CM_ SG_ 1799 CONST_222_2 "Constant 0 (0x0) in every record observed: reserved/padding or configuration.";
CM_ SG_ 1799 UNK_224_7 "Candidate from the carry-chain split, unverified: LSB flips 0.344 per cycle, 127 distinct values 1..127. Strongest correlation: dRel r=+0.80. Uncertainty candidate: scales with range (r~0.8), falls with age at fixed range (rho -0.29 to -0.36), larger when range steps are noisier, rises before deletion. Weak near-range error indicator; does not single out excursions.";
CM_ SG_ 1799 CONST_231_1 "Constant 0 (0x0) in every record observed: reserved/padding or configuration.";
CM_ SG_ 1799 UNK_232_7 "Candidate from the carry-chain split, unverified: LSB flips 0.096 per cycle, 72 distinct values 0..127. Strongest correlation: abs_yRel r=+0.60. Lateral-uncertainty candidate: scales with |yRel| (r~0.6), falls with age at fixed range (rho -0.50 to -0.59).";
CM_ SG_ 1799 PER_TRACK_239_1 "Constant within a track, differs between tracks (2 values 0..1): object attribute candidate, unverified. Strongest correlation: abs_yRel r=+0.09.";
CM_ SG_ 1799 UNK_240_7 "Candidate from the carry-chain split, unverified: LSB flips 0.364 per cycle, 127 distinct values 1..127. Strongest correlation: dRel r=+0.80. Velocity-uncertainty candidate (like ARS408 VrelLong_rms): scales with range, falls with age, rises before deletion. Higher when native vRel disagrees with the camera by > 2 m/s (stratified AUC ~0.62 on drives A-C); moderate, not a clean excursion flag (docs/14). Decoded as vel_unc_code.";
CM_ SG_ 1799 CONST_247_1 "Constant 0 (0x0) in every record observed: reserved/padding or configuration.";
CM_ SG_ 1799 UNK_248_7 "Candidate from the carry-chain split, unverified: LSB flips 0.116 per cycle, 97 distinct values 0..127. Strongest correlation: abs_yRel r=+0.56. Uncertainty candidate: scales with |yRel| (r~0.56), falls with age at fixed range (rho -0.70 to -0.75).";
CM_ SG_ 1799 CONST_255_1 "Constant 0 (0x0) in every record observed: reserved/padding or configuration.";
CM_ SG_ 1799 UNK_256_5 "Candidate from the carry-chain split, unverified: LSB flips 0.177 per cycle, 30 distinct values 0..30. Strongest correlation: age r=+0.72. Existence / confidence candidate: rises with age at fixed range (rho +0.86 to +0.90), drops about 1.5 codes before deletion. Compare ARS4-B ProbExist (5 bits).";
CM_ SG_ 1799 CONST_261_3 "Constant 0 (0x0) in every record observed: reserved/padding or configuration.";
CM_ SG_ 1799 UNK_264_5 "Candidate from the carry-chain split, unverified: LSB flips 0.100 per cycle, 19 distinct values 0..18. Strongest correlation: age r=-0.81. Uncertainty candidate: falls with age at fixed range (rho -0.61 to -0.68), rises before deletion.";
CM_ SG_ 1799 CONST_269_3 "Constant 0 (0x0) in every record observed: reserved/padding or configuration.";
CM_ SG_ 1799 UNK_272_5 "Candidate from the carry-chain split, unverified: LSB flips 0.095 per cycle, 17 distinct values 2..18. Strongest correlation: age r=+0.30. Size / class candidate: camera vehicle height partial rho 0.41-0.71, width 0.36-0.69, truck/bus 0.24-0.39 (docs/14).";
CM_ SG_ 1799 CONST_277_11 "Constant 0 (0x0) in every record observed: reserved/padding or configuration.";
CM_ BO_ 1800 "Reassembled 0x80 object slot 8 (record bytes 305-340), sent only when occupied. Little-endian bit field: bit 0 = LSB of slot byte 0.";
CM_ SG_ 1800 STATE_CODE "Raw lifecycle state. Measured/predicted semantics not proved; not an accuracy gate.";
CM_ SG_ 1800 SLOT_INDEX_CODE "Physical slot index or 63 in unallocated-form headers; verified against slot positions. Not class or reference point.";
CM_ SG_ 1800 UNK_8_6 "Candidate from the carry-chain split, unverified: LSB flips 0.103 per cycle, 32 distinct values 30..62. Strongest correlation: age r=+0.55. Ramps up with age and saturates at 62; tracks range and scenario, not measured error.";
CM_ SG_ 1800 ONCOMING_FLAG "1 = oncoming now or earlier in the track life (persists after an oncoming object slows). Pre-registered test on unseen segments: over-ground speed < 0 on 100% of flagged rows, 88.5% of objects approaching faster than 2 m/s flagged (docs/14).";
CM_ SG_ 1800 CONST_15_1 "Constant 0 (0x0) in every record observed: reserved/padding or configuration.";
CM_ SG_ 1800 SCORE_CODE "Bounded score-like byte, not calibrated confidence or percent. Value 100 does not guarantee accurate geometry or velocity.";
CM_ SG_ 1800 AGE "Track age in radar cycles (~60 ms): 1 at birth, saturates at 126; 0 = slot being retired (geometry is the previous occupant's). A restart is a new track. Tracks younger than ~60 carry unconverged range and velocity.";
CM_ SG_ 1800 CONST_31_1 "Constant 0 (0x0) in every record observed: reserved/padding or configuration.";
CM_ SG_ 1800 DREL "Longitudinal distance forward of the radar, m. 1/16 m, zero code 160 (exactly -10 m). Camera ground contact at 5-25 m: slope 0.99-1.00 on three drives, zero within 0.2 m (0.7 m on a hilly drive). Settled tracks walk by metres record to record at 40 m+; young tracks can be far off.";
CM_ SG_ 1800 YREL_LEFT "Lateral offset, LEFT positive (openpilot yRel), m. 1/64 m, offset binary around 2048. Cartesian (constant across range), not an angle. Correct side 97.9-99.3% on held-out drives; scale bounded to about +/-10%. |code-2048| >= 2000 is a sentinel.";
CM_ SG_ 1800 UNK_56_7 "Candidate from the carry-chain split, unverified: LSB flips 0.355 per cycle, 84 distinct values 4..96. Strongest correlation: age r=+0.30. Size / class candidate: per-track median follows camera vehicle height (partial rho 0.48-0.61 at fixed range) and truck/bus class (docs/14).";
CM_ SG_ 1800 CONST_63_1 "Constant 0 (0x0) in every record observed: reserved/padding or configuration.";
CM_ SG_ 1800 VLONG_OVER_GROUND "Longitudinal velocity OVER GROUND, m/s. 0.15 m/s/code, zero 510.5. vRel = this - ego speed. Radar-only scale check (own range slope vs GPS ego) gives 0.150/0.149/0.153 on three drives. Beats zero and range differencing against a camera reference, but has unflagged ~1 s excursions at range. Unsettled for age < ~60.";
CM_ SG_ 1800 VLAT_OVER_GROUND_PROV "Lateral velocity over ground, LEFT positive (sign confirmed). Scale NOT pinned: the factor shown (0.15) is a placeholder. Radar-only estimates from its own lateral position change range 0.097-0.147 m/s per code across data sets, and the pre-registered test was unverified. See docs/14.";
CM_ SG_ 1800 ALONG_LIKE_84 "Acceleration-like, zero code 511 at standstill. Follows the VLONG change with a ~0.5 s lag, so it cannot flag or lead a velocity excursion. Radar-only scale about 0.04 m/s^2 per code on most data but drive-dependent (0.03-0.11); centred codes (docs/14).";
CM_ SG_ 1800 CONST_94_2 "Constant 0 (0x0) in every record observed: reserved/padding or configuration.";
CM_ SG_ 1800 UNK_96 "Unnamed 10-bit carry chain centred near 511; no relation to velocity or range error on three drives.";
CM_ SG_ 1800 UNK_106_1 "Candidate from the carry-chain split, unverified: LSB flips 0.003 per cycle, 2 distinct values 0..1. Strongest correlation: v_over_ground r=-0.14.";
CM_ SG_ 1800 UNK_107_1 "Candidate from the carry-chain split, unverified: LSB flips 0.013 per cycle, 2 distinct values 0..1. Strongest correlation: v_over_ground r=-0.24. Coasting-flag candidate: about 0.02 in settled life, 0.5-0.66 just before deletion (docs/14).";
CM_ SG_ 1800 CONST_108_1 "Constant 0 (0x0) in every record observed: reserved/padding or configuration.";
CM_ SG_ 1800 MOVE_STATE "Movement state. 0 = moving away / same direction, 2 = moving toward (oncoming), 1 and 3 = not clearly moving (1 vs 3 unresolved). Pre-registered test on unseen segments: value 0 had over-ground speed > 0.5 m/s on 99.65% of rows, value 2 < -0.5 m/s on 99.88%, values 1/3 |v| < 2 m/s on 89.5% (docs/14).";
CM_ SG_ 1800 UNK_111_4 "Candidate from the carry-chain split, unverified: LSB flips 0.008 per cycle, 10 distinct values 0..9. Strongest correlation: dRel r=-0.53.";
CM_ SG_ 1800 UNK_115_8 "Candidate from the carry-chain split, unverified: LSB flips 0.052 per cycle, 26 distinct values 0..178. Strongest correlation: age r=+0.27.";
CM_ SG_ 1800 CONST_123_5 "Constant 31 (0x1F) in every record observed: reserved/padding or configuration.";
CM_ SG_ 1800 UNK_128_2 "Candidate from the carry-chain split, unverified: LSB flips 0.013 per cycle, 4 distinct values 0..3. Strongest correlation: dRel r=+0.11.";
CM_ SG_ 1800 UNK_130_1 "Candidate from the carry-chain split, unverified: LSB flips 0.019 per cycle, 2 distinct values 0..1. Strongest correlation: abs_yRel r=+0.34.";
CM_ SG_ 1800 UNK_131_4 "Candidate from the carry-chain split, unverified: LSB flips 0.102 per cycle, 9 distinct values 7..15. Strongest correlation: abs_yRel r=+0.09.";
CM_ SG_ 1800 CONST_135_1 "Constant 0 (0x0) in every record observed: reserved/padding or configuration.";
CM_ SG_ 1800 UNK_136_6 "Candidate from the carry-chain split, unverified: LSB flips 0.093 per cycle, 39 distinct values 3..63. Strongest correlation: age r=+0.20.";
CM_ SG_ 1800 UNK_142_1 "Candidate from the carry-chain split, unverified: LSB flips 0.007 per cycle, 2 distinct values 0..1. Strongest correlation: age r=+0.47.";
CM_ SG_ 1800 CONST_143_5 "Constant 30 (0x1E) in every record observed: reserved/padding or configuration.";
CM_ SG_ 1800 UNK_148_8 "Candidate from the carry-chain split, unverified: LSB flips 0.009 per cycle, 27 distinct values 0..240. Strongest correlation: dRel r=-0.12.";
CM_ SG_ 1800 UNK_156_4 "Candidate from the carry-chain split, unverified: LSB flips 0.016 per cycle, 16 distinct values 0..15. Strongest correlation: abs_yRel r=-0.42.";
CM_ SG_ 1800 CONST_160_3 "Constant 0 (0x0) in every record observed: reserved/padding or configuration.";
CM_ SG_ 1800 UNK_163_2 "Candidate from the carry-chain split, unverified: LSB flips 0.006 per cycle, 3 distinct values 1..3. Strongest correlation: age r=+0.30.";
CM_ SG_ 1800 CONST_165_3 "Constant 0 (0x0) in every record observed: reserved/padding or configuration.";
CM_ SG_ 1800 UNK_168_10 "Candidate from the carry-chain split, unverified: LSB flips 0.066 per cycle, 3 distinct values 0..1023. Strongest correlation: abs_yRel r=+0.14.";
CM_ SG_ 1800 CONST_178_3 "Constant 0 (0x0) in every record observed: reserved/padding or configuration.";
CM_ SG_ 1800 UNK_181_1 "Candidate from the carry-chain split, unverified: LSB flips 0.071 per cycle, 2 distinct values 0..1. Strongest correlation: v_over_ground r=+0.34.";
CM_ SG_ 1800 CONST_182_1 "Constant 0 (0x0) in every record observed: reserved/padding or configuration.";
CM_ SG_ 1800 UNK_183_7 "Candidate from the carry-chain split, unverified: LSB flips 0.009 per cycle, 24 distinct values 26..73. Strongest correlation: age r=+0.20.";
CM_ SG_ 1800 CONST_190_10 "Constant 1 (0x1) in every record observed: reserved/padding or configuration.";
CM_ SG_ 1800 UNK_200_7 "Candidate from the carry-chain split, unverified: LSB flips 0.023 per cycle, 16 distinct values 0..127. Strongest correlation: v_over_ground r=-0.45.";
CM_ SG_ 1800 CONST_207_1 "Constant 0 (0x0) in every record observed: reserved/padding or configuration.";
CM_ SG_ 1800 UNK_208_6 "Candidate from the carry-chain split, unverified: LSB flips 0.017 per cycle, 20 distinct values 0..63. Strongest correlation: v_over_ground r=-0.38.";
CM_ SG_ 1800 CONST_214_2 "Constant 0 (0x0) in every record observed: reserved/padding or configuration.";
CM_ SG_ 1800 UNK_216_6 "Candidate from the carry-chain split, unverified: LSB flips 0.150 per cycle, 34 distinct values 3..49. Strongest correlation: age r=+0.23. Size / class candidate: camera vehicle height partial rho 0.44-0.63, truck/bus 0.35-0.42; width on A/C. Compare ARS4-B Length / dZ (6 bits) (docs/14).";
CM_ SG_ 1800 CONST_222_2 "Constant 0 (0x0) in every record observed: reserved/padding or configuration.";
CM_ SG_ 1800 UNK_224_7 "Candidate from the carry-chain split, unverified: LSB flips 0.344 per cycle, 127 distinct values 1..127. Strongest correlation: dRel r=+0.80. Uncertainty candidate: scales with range (r~0.8), falls with age at fixed range (rho -0.29 to -0.36), larger when range steps are noisier, rises before deletion. Weak near-range error indicator; does not single out excursions.";
CM_ SG_ 1800 CONST_231_1 "Constant 0 (0x0) in every record observed: reserved/padding or configuration.";
CM_ SG_ 1800 UNK_232_7 "Candidate from the carry-chain split, unverified: LSB flips 0.096 per cycle, 72 distinct values 0..127. Strongest correlation: abs_yRel r=+0.60. Lateral-uncertainty candidate: scales with |yRel| (r~0.6), falls with age at fixed range (rho -0.50 to -0.59).";
CM_ SG_ 1800 PER_TRACK_239_1 "Constant within a track, differs between tracks (2 values 0..1): object attribute candidate, unverified. Strongest correlation: abs_yRel r=+0.09.";
CM_ SG_ 1800 UNK_240_7 "Candidate from the carry-chain split, unverified: LSB flips 0.364 per cycle, 127 distinct values 1..127. Strongest correlation: dRel r=+0.80. Velocity-uncertainty candidate (like ARS408 VrelLong_rms): scales with range, falls with age, rises before deletion. Higher when native vRel disagrees with the camera by > 2 m/s (stratified AUC ~0.62 on drives A-C); moderate, not a clean excursion flag (docs/14). Decoded as vel_unc_code.";
CM_ SG_ 1800 CONST_247_1 "Constant 0 (0x0) in every record observed: reserved/padding or configuration.";
CM_ SG_ 1800 UNK_248_7 "Candidate from the carry-chain split, unverified: LSB flips 0.116 per cycle, 97 distinct values 0..127. Strongest correlation: abs_yRel r=+0.56. Uncertainty candidate: scales with |yRel| (r~0.56), falls with age at fixed range (rho -0.70 to -0.75).";
CM_ SG_ 1800 CONST_255_1 "Constant 0 (0x0) in every record observed: reserved/padding or configuration.";
CM_ SG_ 1800 UNK_256_5 "Candidate from the carry-chain split, unverified: LSB flips 0.177 per cycle, 30 distinct values 0..30. Strongest correlation: age r=+0.72. Existence / confidence candidate: rises with age at fixed range (rho +0.86 to +0.90), drops about 1.5 codes before deletion. Compare ARS4-B ProbExist (5 bits).";
CM_ SG_ 1800 CONST_261_3 "Constant 0 (0x0) in every record observed: reserved/padding or configuration.";
CM_ SG_ 1800 UNK_264_5 "Candidate from the carry-chain split, unverified: LSB flips 0.100 per cycle, 19 distinct values 0..18. Strongest correlation: age r=-0.81. Uncertainty candidate: falls with age at fixed range (rho -0.61 to -0.68), rises before deletion.";
CM_ SG_ 1800 CONST_269_3 "Constant 0 (0x0) in every record observed: reserved/padding or configuration.";
CM_ SG_ 1800 UNK_272_5 "Candidate from the carry-chain split, unverified: LSB flips 0.095 per cycle, 17 distinct values 2..18. Strongest correlation: age r=+0.30. Size / class candidate: camera vehicle height partial rho 0.41-0.71, width 0.36-0.69, truck/bus 0.24-0.39 (docs/14).";
CM_ SG_ 1800 CONST_277_11 "Constant 0 (0x0) in every record observed: reserved/padding or configuration.";
CM_ BO_ 1801 "Reassembled 0x80 object slot 9 (record bytes 341-376), sent only when occupied. Little-endian bit field: bit 0 = LSB of slot byte 0.";
CM_ SG_ 1801 STATE_CODE "Raw lifecycle state. Measured/predicted semantics not proved; not an accuracy gate.";
CM_ SG_ 1801 SLOT_INDEX_CODE "Physical slot index or 63 in unallocated-form headers; verified against slot positions. Not class or reference point.";
CM_ SG_ 1801 UNK_8_6 "Candidate from the carry-chain split, unverified: LSB flips 0.103 per cycle, 32 distinct values 30..62. Strongest correlation: age r=+0.55. Ramps up with age and saturates at 62; tracks range and scenario, not measured error.";
CM_ SG_ 1801 ONCOMING_FLAG "1 = oncoming now or earlier in the track life (persists after an oncoming object slows). Pre-registered test on unseen segments: over-ground speed < 0 on 100% of flagged rows, 88.5% of objects approaching faster than 2 m/s flagged (docs/14).";
CM_ SG_ 1801 CONST_15_1 "Constant 0 (0x0) in every record observed: reserved/padding or configuration.";
CM_ SG_ 1801 SCORE_CODE "Bounded score-like byte, not calibrated confidence or percent. Value 100 does not guarantee accurate geometry or velocity.";
CM_ SG_ 1801 AGE "Track age in radar cycles (~60 ms): 1 at birth, saturates at 126; 0 = slot being retired (geometry is the previous occupant's). A restart is a new track. Tracks younger than ~60 carry unconverged range and velocity.";
CM_ SG_ 1801 CONST_31_1 "Constant 0 (0x0) in every record observed: reserved/padding or configuration.";
CM_ SG_ 1801 DREL "Longitudinal distance forward of the radar, m. 1/16 m, zero code 160 (exactly -10 m). Camera ground contact at 5-25 m: slope 0.99-1.00 on three drives, zero within 0.2 m (0.7 m on a hilly drive). Settled tracks walk by metres record to record at 40 m+; young tracks can be far off.";
CM_ SG_ 1801 YREL_LEFT "Lateral offset, LEFT positive (openpilot yRel), m. 1/64 m, offset binary around 2048. Cartesian (constant across range), not an angle. Correct side 97.9-99.3% on held-out drives; scale bounded to about +/-10%. |code-2048| >= 2000 is a sentinel.";
CM_ SG_ 1801 UNK_56_7 "Candidate from the carry-chain split, unverified: LSB flips 0.355 per cycle, 84 distinct values 4..96. Strongest correlation: age r=+0.30. Size / class candidate: per-track median follows camera vehicle height (partial rho 0.48-0.61 at fixed range) and truck/bus class (docs/14).";
CM_ SG_ 1801 CONST_63_1 "Constant 0 (0x0) in every record observed: reserved/padding or configuration.";
CM_ SG_ 1801 VLONG_OVER_GROUND "Longitudinal velocity OVER GROUND, m/s. 0.15 m/s/code, zero 510.5. vRel = this - ego speed. Radar-only scale check (own range slope vs GPS ego) gives 0.150/0.149/0.153 on three drives. Beats zero and range differencing against a camera reference, but has unflagged ~1 s excursions at range. Unsettled for age < ~60.";
CM_ SG_ 1801 VLAT_OVER_GROUND_PROV "Lateral velocity over ground, LEFT positive (sign confirmed). Scale NOT pinned: the factor shown (0.15) is a placeholder. Radar-only estimates from its own lateral position change range 0.097-0.147 m/s per code across data sets, and the pre-registered test was unverified. See docs/14.";
CM_ SG_ 1801 ALONG_LIKE_84 "Acceleration-like, zero code 511 at standstill. Follows the VLONG change with a ~0.5 s lag, so it cannot flag or lead a velocity excursion. Radar-only scale about 0.04 m/s^2 per code on most data but drive-dependent (0.03-0.11); centred codes (docs/14).";
CM_ SG_ 1801 CONST_94_2 "Constant 0 (0x0) in every record observed: reserved/padding or configuration.";
CM_ SG_ 1801 UNK_96 "Unnamed 10-bit carry chain centred near 511; no relation to velocity or range error on three drives.";
CM_ SG_ 1801 UNK_106_1 "Candidate from the carry-chain split, unverified: LSB flips 0.003 per cycle, 2 distinct values 0..1. Strongest correlation: v_over_ground r=-0.14.";
CM_ SG_ 1801 UNK_107_1 "Candidate from the carry-chain split, unverified: LSB flips 0.013 per cycle, 2 distinct values 0..1. Strongest correlation: v_over_ground r=-0.24. Coasting-flag candidate: about 0.02 in settled life, 0.5-0.66 just before deletion (docs/14).";
CM_ SG_ 1801 CONST_108_1 "Constant 0 (0x0) in every record observed: reserved/padding or configuration.";
CM_ SG_ 1801 MOVE_STATE "Movement state. 0 = moving away / same direction, 2 = moving toward (oncoming), 1 and 3 = not clearly moving (1 vs 3 unresolved). Pre-registered test on unseen segments: value 0 had over-ground speed > 0.5 m/s on 99.65% of rows, value 2 < -0.5 m/s on 99.88%, values 1/3 |v| < 2 m/s on 89.5% (docs/14).";
CM_ SG_ 1801 UNK_111_4 "Candidate from the carry-chain split, unverified: LSB flips 0.008 per cycle, 10 distinct values 0..9. Strongest correlation: dRel r=-0.53.";
CM_ SG_ 1801 UNK_115_8 "Candidate from the carry-chain split, unverified: LSB flips 0.052 per cycle, 26 distinct values 0..178. Strongest correlation: age r=+0.27.";
CM_ SG_ 1801 CONST_123_5 "Constant 31 (0x1F) in every record observed: reserved/padding or configuration.";
CM_ SG_ 1801 UNK_128_2 "Candidate from the carry-chain split, unverified: LSB flips 0.013 per cycle, 4 distinct values 0..3. Strongest correlation: dRel r=+0.11.";
CM_ SG_ 1801 UNK_130_1 "Candidate from the carry-chain split, unverified: LSB flips 0.019 per cycle, 2 distinct values 0..1. Strongest correlation: abs_yRel r=+0.34.";
CM_ SG_ 1801 UNK_131_4 "Candidate from the carry-chain split, unverified: LSB flips 0.102 per cycle, 9 distinct values 7..15. Strongest correlation: abs_yRel r=+0.09.";
CM_ SG_ 1801 CONST_135_1 "Constant 0 (0x0) in every record observed: reserved/padding or configuration.";
CM_ SG_ 1801 UNK_136_6 "Candidate from the carry-chain split, unverified: LSB flips 0.093 per cycle, 39 distinct values 3..63. Strongest correlation: age r=+0.20.";
CM_ SG_ 1801 UNK_142_1 "Candidate from the carry-chain split, unverified: LSB flips 0.007 per cycle, 2 distinct values 0..1. Strongest correlation: age r=+0.47.";
CM_ SG_ 1801 CONST_143_5 "Constant 30 (0x1E) in every record observed: reserved/padding or configuration.";
CM_ SG_ 1801 UNK_148_8 "Candidate from the carry-chain split, unverified: LSB flips 0.009 per cycle, 27 distinct values 0..240. Strongest correlation: dRel r=-0.12.";
CM_ SG_ 1801 UNK_156_4 "Candidate from the carry-chain split, unverified: LSB flips 0.016 per cycle, 16 distinct values 0..15. Strongest correlation: abs_yRel r=-0.42.";
CM_ SG_ 1801 CONST_160_3 "Constant 0 (0x0) in every record observed: reserved/padding or configuration.";
CM_ SG_ 1801 UNK_163_2 "Candidate from the carry-chain split, unverified: LSB flips 0.006 per cycle, 3 distinct values 1..3. Strongest correlation: age r=+0.30.";
CM_ SG_ 1801 CONST_165_3 "Constant 0 (0x0) in every record observed: reserved/padding or configuration.";
CM_ SG_ 1801 UNK_168_10 "Candidate from the carry-chain split, unverified: LSB flips 0.066 per cycle, 3 distinct values 0..1023. Strongest correlation: abs_yRel r=+0.14.";
CM_ SG_ 1801 CONST_178_3 "Constant 0 (0x0) in every record observed: reserved/padding or configuration.";
CM_ SG_ 1801 UNK_181_1 "Candidate from the carry-chain split, unverified: LSB flips 0.071 per cycle, 2 distinct values 0..1. Strongest correlation: v_over_ground r=+0.34.";
CM_ SG_ 1801 CONST_182_1 "Constant 0 (0x0) in every record observed: reserved/padding or configuration.";
CM_ SG_ 1801 UNK_183_7 "Candidate from the carry-chain split, unverified: LSB flips 0.009 per cycle, 24 distinct values 26..73. Strongest correlation: age r=+0.20.";
CM_ SG_ 1801 CONST_190_10 "Constant 1 (0x1) in every record observed: reserved/padding or configuration.";
CM_ SG_ 1801 UNK_200_7 "Candidate from the carry-chain split, unverified: LSB flips 0.023 per cycle, 16 distinct values 0..127. Strongest correlation: v_over_ground r=-0.45.";
CM_ SG_ 1801 CONST_207_1 "Constant 0 (0x0) in every record observed: reserved/padding or configuration.";
CM_ SG_ 1801 UNK_208_6 "Candidate from the carry-chain split, unverified: LSB flips 0.017 per cycle, 20 distinct values 0..63. Strongest correlation: v_over_ground r=-0.38.";
CM_ SG_ 1801 CONST_214_2 "Constant 0 (0x0) in every record observed: reserved/padding or configuration.";
CM_ SG_ 1801 UNK_216_6 "Candidate from the carry-chain split, unverified: LSB flips 0.150 per cycle, 34 distinct values 3..49. Strongest correlation: age r=+0.23. Size / class candidate: camera vehicle height partial rho 0.44-0.63, truck/bus 0.35-0.42; width on A/C. Compare ARS4-B Length / dZ (6 bits) (docs/14).";
CM_ SG_ 1801 CONST_222_2 "Constant 0 (0x0) in every record observed: reserved/padding or configuration.";
CM_ SG_ 1801 UNK_224_7 "Candidate from the carry-chain split, unverified: LSB flips 0.344 per cycle, 127 distinct values 1..127. Strongest correlation: dRel r=+0.80. Uncertainty candidate: scales with range (r~0.8), falls with age at fixed range (rho -0.29 to -0.36), larger when range steps are noisier, rises before deletion. Weak near-range error indicator; does not single out excursions.";
CM_ SG_ 1801 CONST_231_1 "Constant 0 (0x0) in every record observed: reserved/padding or configuration.";
CM_ SG_ 1801 UNK_232_7 "Candidate from the carry-chain split, unverified: LSB flips 0.096 per cycle, 72 distinct values 0..127. Strongest correlation: abs_yRel r=+0.60. Lateral-uncertainty candidate: scales with |yRel| (r~0.6), falls with age at fixed range (rho -0.50 to -0.59).";
CM_ SG_ 1801 PER_TRACK_239_1 "Constant within a track, differs between tracks (2 values 0..1): object attribute candidate, unverified. Strongest correlation: abs_yRel r=+0.09.";
CM_ SG_ 1801 UNK_240_7 "Candidate from the carry-chain split, unverified: LSB flips 0.364 per cycle, 127 distinct values 1..127. Strongest correlation: dRel r=+0.80. Velocity-uncertainty candidate (like ARS408 VrelLong_rms): scales with range, falls with age, rises before deletion. Higher when native vRel disagrees with the camera by > 2 m/s (stratified AUC ~0.62 on drives A-C); moderate, not a clean excursion flag (docs/14). Decoded as vel_unc_code.";
CM_ SG_ 1801 CONST_247_1 "Constant 0 (0x0) in every record observed: reserved/padding or configuration.";
CM_ SG_ 1801 UNK_248_7 "Candidate from the carry-chain split, unverified: LSB flips 0.116 per cycle, 97 distinct values 0..127. Strongest correlation: abs_yRel r=+0.56. Uncertainty candidate: scales with |yRel| (r~0.56), falls with age at fixed range (rho -0.70 to -0.75).";
CM_ SG_ 1801 CONST_255_1 "Constant 0 (0x0) in every record observed: reserved/padding or configuration.";
CM_ SG_ 1801 UNK_256_5 "Candidate from the carry-chain split, unverified: LSB flips 0.177 per cycle, 30 distinct values 0..30. Strongest correlation: age r=+0.72. Existence / confidence candidate: rises with age at fixed range (rho +0.86 to +0.90), drops about 1.5 codes before deletion. Compare ARS4-B ProbExist (5 bits).";
CM_ SG_ 1801 CONST_261_3 "Constant 0 (0x0) in every record observed: reserved/padding or configuration.";
CM_ SG_ 1801 UNK_264_5 "Candidate from the carry-chain split, unverified: LSB flips 0.100 per cycle, 19 distinct values 0..18. Strongest correlation: age r=-0.81. Uncertainty candidate: falls with age at fixed range (rho -0.61 to -0.68), rises before deletion.";
CM_ SG_ 1801 CONST_269_3 "Constant 0 (0x0) in every record observed: reserved/padding or configuration.";
CM_ SG_ 1801 UNK_272_5 "Candidate from the carry-chain split, unverified: LSB flips 0.095 per cycle, 17 distinct values 2..18. Strongest correlation: age r=+0.30. Size / class candidate: camera vehicle height partial rho 0.41-0.71, width 0.36-0.69, truck/bus 0.24-0.39 (docs/14).";
CM_ SG_ 1801 CONST_277_11 "Constant 0 (0x0) in every record observed: reserved/padding or configuration.";
CM_ BO_ 1802 "Reassembled 0x80 object slot 10 (record bytes 377-412), sent only when occupied. Little-endian bit field: bit 0 = LSB of slot byte 0.";
CM_ SG_ 1802 STATE_CODE "Raw lifecycle state. Measured/predicted semantics not proved; not an accuracy gate.";
CM_ SG_ 1802 SLOT_INDEX_CODE "Physical slot index or 63 in unallocated-form headers; verified against slot positions. Not class or reference point.";
CM_ SG_ 1802 UNK_8_6 "Candidate from the carry-chain split, unverified: LSB flips 0.103 per cycle, 32 distinct values 30..62. Strongest correlation: age r=+0.55. Ramps up with age and saturates at 62; tracks range and scenario, not measured error.";
CM_ SG_ 1802 ONCOMING_FLAG "1 = oncoming now or earlier in the track life (persists after an oncoming object slows). Pre-registered test on unseen segments: over-ground speed < 0 on 100% of flagged rows, 88.5% of objects approaching faster than 2 m/s flagged (docs/14).";
CM_ SG_ 1802 CONST_15_1 "Constant 0 (0x0) in every record observed: reserved/padding or configuration.";
CM_ SG_ 1802 SCORE_CODE "Bounded score-like byte, not calibrated confidence or percent. Value 100 does not guarantee accurate geometry or velocity.";
CM_ SG_ 1802 AGE "Track age in radar cycles (~60 ms): 1 at birth, saturates at 126; 0 = slot being retired (geometry is the previous occupant's). A restart is a new track. Tracks younger than ~60 carry unconverged range and velocity.";
CM_ SG_ 1802 CONST_31_1 "Constant 0 (0x0) in every record observed: reserved/padding or configuration.";
CM_ SG_ 1802 DREL "Longitudinal distance forward of the radar, m. 1/16 m, zero code 160 (exactly -10 m). Camera ground contact at 5-25 m: slope 0.99-1.00 on three drives, zero within 0.2 m (0.7 m on a hilly drive). Settled tracks walk by metres record to record at 40 m+; young tracks can be far off.";
CM_ SG_ 1802 YREL_LEFT "Lateral offset, LEFT positive (openpilot yRel), m. 1/64 m, offset binary around 2048. Cartesian (constant across range), not an angle. Correct side 97.9-99.3% on held-out drives; scale bounded to about +/-10%. |code-2048| >= 2000 is a sentinel.";
CM_ SG_ 1802 UNK_56_7 "Candidate from the carry-chain split, unverified: LSB flips 0.355 per cycle, 84 distinct values 4..96. Strongest correlation: age r=+0.30. Size / class candidate: per-track median follows camera vehicle height (partial rho 0.48-0.61 at fixed range) and truck/bus class (docs/14).";
CM_ SG_ 1802 CONST_63_1 "Constant 0 (0x0) in every record observed: reserved/padding or configuration.";
CM_ SG_ 1802 VLONG_OVER_GROUND "Longitudinal velocity OVER GROUND, m/s. 0.15 m/s/code, zero 510.5. vRel = this - ego speed. Radar-only scale check (own range slope vs GPS ego) gives 0.150/0.149/0.153 on three drives. Beats zero and range differencing against a camera reference, but has unflagged ~1 s excursions at range. Unsettled for age < ~60.";
CM_ SG_ 1802 VLAT_OVER_GROUND_PROV "Lateral velocity over ground, LEFT positive (sign confirmed). Scale NOT pinned: the factor shown (0.15) is a placeholder. Radar-only estimates from its own lateral position change range 0.097-0.147 m/s per code across data sets, and the pre-registered test was unverified. See docs/14.";
CM_ SG_ 1802 ALONG_LIKE_84 "Acceleration-like, zero code 511 at standstill. Follows the VLONG change with a ~0.5 s lag, so it cannot flag or lead a velocity excursion. Radar-only scale about 0.04 m/s^2 per code on most data but drive-dependent (0.03-0.11); centred codes (docs/14).";
CM_ SG_ 1802 CONST_94_2 "Constant 0 (0x0) in every record observed: reserved/padding or configuration.";
CM_ SG_ 1802 UNK_96 "Unnamed 10-bit carry chain centred near 511; no relation to velocity or range error on three drives.";
CM_ SG_ 1802 UNK_106_1 "Candidate from the carry-chain split, unverified: LSB flips 0.003 per cycle, 2 distinct values 0..1. Strongest correlation: v_over_ground r=-0.14.";
CM_ SG_ 1802 UNK_107_1 "Candidate from the carry-chain split, unverified: LSB flips 0.013 per cycle, 2 distinct values 0..1. Strongest correlation: v_over_ground r=-0.24. Coasting-flag candidate: about 0.02 in settled life, 0.5-0.66 just before deletion (docs/14).";
CM_ SG_ 1802 CONST_108_1 "Constant 0 (0x0) in every record observed: reserved/padding or configuration.";
CM_ SG_ 1802 MOVE_STATE "Movement state. 0 = moving away / same direction, 2 = moving toward (oncoming), 1 and 3 = not clearly moving (1 vs 3 unresolved). Pre-registered test on unseen segments: value 0 had over-ground speed > 0.5 m/s on 99.65% of rows, value 2 < -0.5 m/s on 99.88%, values 1/3 |v| < 2 m/s on 89.5% (docs/14).";
CM_ SG_ 1802 UNK_111_4 "Candidate from the carry-chain split, unverified: LSB flips 0.008 per cycle, 10 distinct values 0..9. Strongest correlation: dRel r=-0.53.";
CM_ SG_ 1802 UNK_115_8 "Candidate from the carry-chain split, unverified: LSB flips 0.052 per cycle, 26 distinct values 0..178. Strongest correlation: age r=+0.27.";
CM_ SG_ 1802 CONST_123_5 "Constant 31 (0x1F) in every record observed: reserved/padding or configuration.";
CM_ SG_ 1802 UNK_128_2 "Candidate from the carry-chain split, unverified: LSB flips 0.013 per cycle, 4 distinct values 0..3. Strongest correlation: dRel r=+0.11.";
CM_ SG_ 1802 UNK_130_1 "Candidate from the carry-chain split, unverified: LSB flips 0.019 per cycle, 2 distinct values 0..1. Strongest correlation: abs_yRel r=+0.34.";
CM_ SG_ 1802 UNK_131_4 "Candidate from the carry-chain split, unverified: LSB flips 0.102 per cycle, 9 distinct values 7..15. Strongest correlation: abs_yRel r=+0.09.";
CM_ SG_ 1802 CONST_135_1 "Constant 0 (0x0) in every record observed: reserved/padding or configuration.";
CM_ SG_ 1802 UNK_136_6 "Candidate from the carry-chain split, unverified: LSB flips 0.093 per cycle, 39 distinct values 3..63. Strongest correlation: age r=+0.20.";
CM_ SG_ 1802 UNK_142_1 "Candidate from the carry-chain split, unverified: LSB flips 0.007 per cycle, 2 distinct values 0..1. Strongest correlation: age r=+0.47.";
CM_ SG_ 1802 CONST_143_5 "Constant 30 (0x1E) in every record observed: reserved/padding or configuration.";
CM_ SG_ 1802 UNK_148_8 "Candidate from the carry-chain split, unverified: LSB flips 0.009 per cycle, 27 distinct values 0..240. Strongest correlation: dRel r=-0.12.";
CM_ SG_ 1802 UNK_156_4 "Candidate from the carry-chain split, unverified: LSB flips 0.016 per cycle, 16 distinct values 0..15. Strongest correlation: abs_yRel r=-0.42.";
CM_ SG_ 1802 CONST_160_3 "Constant 0 (0x0) in every record observed: reserved/padding or configuration.";
CM_ SG_ 1802 UNK_163_2 "Candidate from the carry-chain split, unverified: LSB flips 0.006 per cycle, 3 distinct values 1..3. Strongest correlation: age r=+0.30.";
CM_ SG_ 1802 CONST_165_3 "Constant 0 (0x0) in every record observed: reserved/padding or configuration.";
CM_ SG_ 1802 UNK_168_10 "Candidate from the carry-chain split, unverified: LSB flips 0.066 per cycle, 3 distinct values 0..1023. Strongest correlation: abs_yRel r=+0.14.";
CM_ SG_ 1802 CONST_178_3 "Constant 0 (0x0) in every record observed: reserved/padding or configuration.";
CM_ SG_ 1802 UNK_181_1 "Candidate from the carry-chain split, unverified: LSB flips 0.071 per cycle, 2 distinct values 0..1. Strongest correlation: v_over_ground r=+0.34.";
CM_ SG_ 1802 CONST_182_1 "Constant 0 (0x0) in every record observed: reserved/padding or configuration.";
CM_ SG_ 1802 UNK_183_7 "Candidate from the carry-chain split, unverified: LSB flips 0.009 per cycle, 24 distinct values 26..73. Strongest correlation: age r=+0.20.";
CM_ SG_ 1802 CONST_190_10 "Constant 1 (0x1) in every record observed: reserved/padding or configuration.";
CM_ SG_ 1802 UNK_200_7 "Candidate from the carry-chain split, unverified: LSB flips 0.023 per cycle, 16 distinct values 0..127. Strongest correlation: v_over_ground r=-0.45.";
CM_ SG_ 1802 CONST_207_1 "Constant 0 (0x0) in every record observed: reserved/padding or configuration.";
CM_ SG_ 1802 UNK_208_6 "Candidate from the carry-chain split, unverified: LSB flips 0.017 per cycle, 20 distinct values 0..63. Strongest correlation: v_over_ground r=-0.38.";
CM_ SG_ 1802 CONST_214_2 "Constant 0 (0x0) in every record observed: reserved/padding or configuration.";
CM_ SG_ 1802 UNK_216_6 "Candidate from the carry-chain split, unverified: LSB flips 0.150 per cycle, 34 distinct values 3..49. Strongest correlation: age r=+0.23. Size / class candidate: camera vehicle height partial rho 0.44-0.63, truck/bus 0.35-0.42; width on A/C. Compare ARS4-B Length / dZ (6 bits) (docs/14).";
CM_ SG_ 1802 CONST_222_2 "Constant 0 (0x0) in every record observed: reserved/padding or configuration.";
CM_ SG_ 1802 UNK_224_7 "Candidate from the carry-chain split, unverified: LSB flips 0.344 per cycle, 127 distinct values 1..127. Strongest correlation: dRel r=+0.80. Uncertainty candidate: scales with range (r~0.8), falls with age at fixed range (rho -0.29 to -0.36), larger when range steps are noisier, rises before deletion. Weak near-range error indicator; does not single out excursions.";
CM_ SG_ 1802 CONST_231_1 "Constant 0 (0x0) in every record observed: reserved/padding or configuration.";
CM_ SG_ 1802 UNK_232_7 "Candidate from the carry-chain split, unverified: LSB flips 0.096 per cycle, 72 distinct values 0..127. Strongest correlation: abs_yRel r=+0.60. Lateral-uncertainty candidate: scales with |yRel| (r~0.6), falls with age at fixed range (rho -0.50 to -0.59).";
CM_ SG_ 1802 PER_TRACK_239_1 "Constant within a track, differs between tracks (2 values 0..1): object attribute candidate, unverified. Strongest correlation: abs_yRel r=+0.09.";
CM_ SG_ 1802 UNK_240_7 "Candidate from the carry-chain split, unverified: LSB flips 0.364 per cycle, 127 distinct values 1..127. Strongest correlation: dRel r=+0.80. Velocity-uncertainty candidate (like ARS408 VrelLong_rms): scales with range, falls with age, rises before deletion. Higher when native vRel disagrees with the camera by > 2 m/s (stratified AUC ~0.62 on drives A-C); moderate, not a clean excursion flag (docs/14). Decoded as vel_unc_code.";
CM_ SG_ 1802 CONST_247_1 "Constant 0 (0x0) in every record observed: reserved/padding or configuration.";
CM_ SG_ 1802 UNK_248_7 "Candidate from the carry-chain split, unverified: LSB flips 0.116 per cycle, 97 distinct values 0..127. Strongest correlation: abs_yRel r=+0.56. Uncertainty candidate: scales with |yRel| (r~0.56), falls with age at fixed range (rho -0.70 to -0.75).";
CM_ SG_ 1802 CONST_255_1 "Constant 0 (0x0) in every record observed: reserved/padding or configuration.";
CM_ SG_ 1802 UNK_256_5 "Candidate from the carry-chain split, unverified: LSB flips 0.177 per cycle, 30 distinct values 0..30. Strongest correlation: age r=+0.72. Existence / confidence candidate: rises with age at fixed range (rho +0.86 to +0.90), drops about 1.5 codes before deletion. Compare ARS4-B ProbExist (5 bits).";
CM_ SG_ 1802 CONST_261_3 "Constant 0 (0x0) in every record observed: reserved/padding or configuration.";
CM_ SG_ 1802 UNK_264_5 "Candidate from the carry-chain split, unverified: LSB flips 0.100 per cycle, 19 distinct values 0..18. Strongest correlation: age r=-0.81. Uncertainty candidate: falls with age at fixed range (rho -0.61 to -0.68), rises before deletion.";
CM_ SG_ 1802 CONST_269_3 "Constant 0 (0x0) in every record observed: reserved/padding or configuration.";
CM_ SG_ 1802 UNK_272_5 "Candidate from the carry-chain split, unverified: LSB flips 0.095 per cycle, 17 distinct values 2..18. Strongest correlation: age r=+0.30. Size / class candidate: camera vehicle height partial rho 0.41-0.71, width 0.36-0.69, truck/bus 0.24-0.39 (docs/14).";
CM_ SG_ 1802 CONST_277_11 "Constant 0 (0x0) in every record observed: reserved/padding or configuration.";
CM_ BO_ 1803 "Reassembled 0x80 object slot 11 (record bytes 413-448), sent only when occupied. Little-endian bit field: bit 0 = LSB of slot byte 0.";
CM_ SG_ 1803 STATE_CODE "Raw lifecycle state. Measured/predicted semantics not proved; not an accuracy gate.";
CM_ SG_ 1803 SLOT_INDEX_CODE "Physical slot index or 63 in unallocated-form headers; verified against slot positions. Not class or reference point.";
CM_ SG_ 1803 UNK_8_6 "Candidate from the carry-chain split, unverified: LSB flips 0.103 per cycle, 32 distinct values 30..62. Strongest correlation: age r=+0.55. Ramps up with age and saturates at 62; tracks range and scenario, not measured error.";
CM_ SG_ 1803 ONCOMING_FLAG "1 = oncoming now or earlier in the track life (persists after an oncoming object slows). Pre-registered test on unseen segments: over-ground speed < 0 on 100% of flagged rows, 88.5% of objects approaching faster than 2 m/s flagged (docs/14).";
CM_ SG_ 1803 CONST_15_1 "Constant 0 (0x0) in every record observed: reserved/padding or configuration.";
CM_ SG_ 1803 SCORE_CODE "Bounded score-like byte, not calibrated confidence or percent. Value 100 does not guarantee accurate geometry or velocity.";
CM_ SG_ 1803 AGE "Track age in radar cycles (~60 ms): 1 at birth, saturates at 126; 0 = slot being retired (geometry is the previous occupant's). A restart is a new track. Tracks younger than ~60 carry unconverged range and velocity.";
CM_ SG_ 1803 CONST_31_1 "Constant 0 (0x0) in every record observed: reserved/padding or configuration.";
CM_ SG_ 1803 DREL "Longitudinal distance forward of the radar, m. 1/16 m, zero code 160 (exactly -10 m). Camera ground contact at 5-25 m: slope 0.99-1.00 on three drives, zero within 0.2 m (0.7 m on a hilly drive). Settled tracks walk by metres record to record at 40 m+; young tracks can be far off.";
CM_ SG_ 1803 YREL_LEFT "Lateral offset, LEFT positive (openpilot yRel), m. 1/64 m, offset binary around 2048. Cartesian (constant across range), not an angle. Correct side 97.9-99.3% on held-out drives; scale bounded to about +/-10%. |code-2048| >= 2000 is a sentinel.";
CM_ SG_ 1803 UNK_56_7 "Candidate from the carry-chain split, unverified: LSB flips 0.355 per cycle, 84 distinct values 4..96. Strongest correlation: age r=+0.30. Size / class candidate: per-track median follows camera vehicle height (partial rho 0.48-0.61 at fixed range) and truck/bus class (docs/14).";
CM_ SG_ 1803 CONST_63_1 "Constant 0 (0x0) in every record observed: reserved/padding or configuration.";
CM_ SG_ 1803 VLONG_OVER_GROUND "Longitudinal velocity OVER GROUND, m/s. 0.15 m/s/code, zero 510.5. vRel = this - ego speed. Radar-only scale check (own range slope vs GPS ego) gives 0.150/0.149/0.153 on three drives. Beats zero and range differencing against a camera reference, but has unflagged ~1 s excursions at range. Unsettled for age < ~60.";
CM_ SG_ 1803 VLAT_OVER_GROUND_PROV "Lateral velocity over ground, LEFT positive (sign confirmed). Scale NOT pinned: the factor shown (0.15) is a placeholder. Radar-only estimates from its own lateral position change range 0.097-0.147 m/s per code across data sets, and the pre-registered test was unverified. See docs/14.";
CM_ SG_ 1803 ALONG_LIKE_84 "Acceleration-like, zero code 511 at standstill. Follows the VLONG change with a ~0.5 s lag, so it cannot flag or lead a velocity excursion. Radar-only scale about 0.04 m/s^2 per code on most data but drive-dependent (0.03-0.11); centred codes (docs/14).";
CM_ SG_ 1803 CONST_94_2 "Constant 0 (0x0) in every record observed: reserved/padding or configuration.";
CM_ SG_ 1803 UNK_96 "Unnamed 10-bit carry chain centred near 511; no relation to velocity or range error on three drives.";
CM_ SG_ 1803 UNK_106_1 "Candidate from the carry-chain split, unverified: LSB flips 0.003 per cycle, 2 distinct values 0..1. Strongest correlation: v_over_ground r=-0.14.";
CM_ SG_ 1803 UNK_107_1 "Candidate from the carry-chain split, unverified: LSB flips 0.013 per cycle, 2 distinct values 0..1. Strongest correlation: v_over_ground r=-0.24. Coasting-flag candidate: about 0.02 in settled life, 0.5-0.66 just before deletion (docs/14).";
CM_ SG_ 1803 CONST_108_1 "Constant 0 (0x0) in every record observed: reserved/padding or configuration.";
CM_ SG_ 1803 MOVE_STATE "Movement state. 0 = moving away / same direction, 2 = moving toward (oncoming), 1 and 3 = not clearly moving (1 vs 3 unresolved). Pre-registered test on unseen segments: value 0 had over-ground speed > 0.5 m/s on 99.65% of rows, value 2 < -0.5 m/s on 99.88%, values 1/3 |v| < 2 m/s on 89.5% (docs/14).";
CM_ SG_ 1803 UNK_111_4 "Candidate from the carry-chain split, unverified: LSB flips 0.008 per cycle, 10 distinct values 0..9. Strongest correlation: dRel r=-0.53.";
CM_ SG_ 1803 UNK_115_8 "Candidate from the carry-chain split, unverified: LSB flips 0.052 per cycle, 26 distinct values 0..178. Strongest correlation: age r=+0.27.";
CM_ SG_ 1803 CONST_123_5 "Constant 31 (0x1F) in every record observed: reserved/padding or configuration.";
CM_ SG_ 1803 UNK_128_2 "Candidate from the carry-chain split, unverified: LSB flips 0.013 per cycle, 4 distinct values 0..3. Strongest correlation: dRel r=+0.11.";
CM_ SG_ 1803 UNK_130_1 "Candidate from the carry-chain split, unverified: LSB flips 0.019 per cycle, 2 distinct values 0..1. Strongest correlation: abs_yRel r=+0.34.";
CM_ SG_ 1803 UNK_131_4 "Candidate from the carry-chain split, unverified: LSB flips 0.102 per cycle, 9 distinct values 7..15. Strongest correlation: abs_yRel r=+0.09.";
CM_ SG_ 1803 CONST_135_1 "Constant 0 (0x0) in every record observed: reserved/padding or configuration.";
CM_ SG_ 1803 UNK_136_6 "Candidate from the carry-chain split, unverified: LSB flips 0.093 per cycle, 39 distinct values 3..63. Strongest correlation: age r=+0.20.";
CM_ SG_ 1803 UNK_142_1 "Candidate from the carry-chain split, unverified: LSB flips 0.007 per cycle, 2 distinct values 0..1. Strongest correlation: age r=+0.47.";
CM_ SG_ 1803 CONST_143_5 "Constant 30 (0x1E) in every record observed: reserved/padding or configuration.";
CM_ SG_ 1803 UNK_148_8 "Candidate from the carry-chain split, unverified: LSB flips 0.009 per cycle, 27 distinct values 0..240. Strongest correlation: dRel r=-0.12.";
CM_ SG_ 1803 UNK_156_4 "Candidate from the carry-chain split, unverified: LSB flips 0.016 per cycle, 16 distinct values 0..15. Strongest correlation: abs_yRel r=-0.42.";
CM_ SG_ 1803 CONST_160_3 "Constant 0 (0x0) in every record observed: reserved/padding or configuration.";
CM_ SG_ 1803 UNK_163_2 "Candidate from the carry-chain split, unverified: LSB flips 0.006 per cycle, 3 distinct values 1..3. Strongest correlation: age r=+0.30.";
CM_ SG_ 1803 CONST_165_3 "Constant 0 (0x0) in every record observed: reserved/padding or configuration.";
CM_ SG_ 1803 UNK_168_10 "Candidate from the carry-chain split, unverified: LSB flips 0.066 per cycle, 3 distinct values 0..1023. Strongest correlation: abs_yRel r=+0.14.";
CM_ SG_ 1803 CONST_178_3 "Constant 0 (0x0) in every record observed: reserved/padding or configuration.";
CM_ SG_ 1803 UNK_181_1 "Candidate from the carry-chain split, unverified: LSB flips 0.071 per cycle, 2 distinct values 0..1. Strongest correlation: v_over_ground r=+0.34.";
CM_ SG_ 1803 CONST_182_1 "Constant 0 (0x0) in every record observed: reserved/padding or configuration.";
CM_ SG_ 1803 UNK_183_7 "Candidate from the carry-chain split, unverified: LSB flips 0.009 per cycle, 24 distinct values 26..73. Strongest correlation: age r=+0.20.";
CM_ SG_ 1803 CONST_190_10 "Constant 1 (0x1) in every record observed: reserved/padding or configuration.";
CM_ SG_ 1803 UNK_200_7 "Candidate from the carry-chain split, unverified: LSB flips 0.023 per cycle, 16 distinct values 0..127. Strongest correlation: v_over_ground r=-0.45.";
CM_ SG_ 1803 CONST_207_1 "Constant 0 (0x0) in every record observed: reserved/padding or configuration.";
CM_ SG_ 1803 UNK_208_6 "Candidate from the carry-chain split, unverified: LSB flips 0.017 per cycle, 20 distinct values 0..63. Strongest correlation: v_over_ground r=-0.38.";
CM_ SG_ 1803 CONST_214_2 "Constant 0 (0x0) in every record observed: reserved/padding or configuration.";
CM_ SG_ 1803 UNK_216_6 "Candidate from the carry-chain split, unverified: LSB flips 0.150 per cycle, 34 distinct values 3..49. Strongest correlation: age r=+0.23. Size / class candidate: camera vehicle height partial rho 0.44-0.63, truck/bus 0.35-0.42; width on A/C. Compare ARS4-B Length / dZ (6 bits) (docs/14).";
CM_ SG_ 1803 CONST_222_2 "Constant 0 (0x0) in every record observed: reserved/padding or configuration.";
CM_ SG_ 1803 UNK_224_7 "Candidate from the carry-chain split, unverified: LSB flips 0.344 per cycle, 127 distinct values 1..127. Strongest correlation: dRel r=+0.80. Uncertainty candidate: scales with range (r~0.8), falls with age at fixed range (rho -0.29 to -0.36), larger when range steps are noisier, rises before deletion. Weak near-range error indicator; does not single out excursions.";
CM_ SG_ 1803 CONST_231_1 "Constant 0 (0x0) in every record observed: reserved/padding or configuration.";
CM_ SG_ 1803 UNK_232_7 "Candidate from the carry-chain split, unverified: LSB flips 0.096 per cycle, 72 distinct values 0..127. Strongest correlation: abs_yRel r=+0.60. Lateral-uncertainty candidate: scales with |yRel| (r~0.6), falls with age at fixed range (rho -0.50 to -0.59).";
CM_ SG_ 1803 PER_TRACK_239_1 "Constant within a track, differs between tracks (2 values 0..1): object attribute candidate, unverified. Strongest correlation: abs_yRel r=+0.09.";
CM_ SG_ 1803 UNK_240_7 "Candidate from the carry-chain split, unverified: LSB flips 0.364 per cycle, 127 distinct values 1..127. Strongest correlation: dRel r=+0.80. Velocity-uncertainty candidate (like ARS408 VrelLong_rms): scales with range, falls with age, rises before deletion. Higher when native vRel disagrees with the camera by > 2 m/s (stratified AUC ~0.62 on drives A-C); moderate, not a clean excursion flag (docs/14). Decoded as vel_unc_code.";
CM_ SG_ 1803 CONST_247_1 "Constant 0 (0x0) in every record observed: reserved/padding or configuration.";
CM_ SG_ 1803 UNK_248_7 "Candidate from the carry-chain split, unverified: LSB flips 0.116 per cycle, 97 distinct values 0..127. Strongest correlation: abs_yRel r=+0.56. Uncertainty candidate: scales with |yRel| (r~0.56), falls with age at fixed range (rho -0.70 to -0.75).";
CM_ SG_ 1803 CONST_255_1 "Constant 0 (0x0) in every record observed: reserved/padding or configuration.";
CM_ SG_ 1803 UNK_256_5 "Candidate from the carry-chain split, unverified: LSB flips 0.177 per cycle, 30 distinct values 0..30. Strongest correlation: age r=+0.72. Existence / confidence candidate: rises with age at fixed range (rho +0.86 to +0.90), drops about 1.5 codes before deletion. Compare ARS4-B ProbExist (5 bits).";
CM_ SG_ 1803 CONST_261_3 "Constant 0 (0x0) in every record observed: reserved/padding or configuration.";
CM_ SG_ 1803 UNK_264_5 "Candidate from the carry-chain split, unverified: LSB flips 0.100 per cycle, 19 distinct values 0..18. Strongest correlation: age r=-0.81. Uncertainty candidate: falls with age at fixed range (rho -0.61 to -0.68), rises before deletion.";
CM_ SG_ 1803 CONST_269_3 "Constant 0 (0x0) in every record observed: reserved/padding or configuration.";
CM_ SG_ 1803 UNK_272_5 "Candidate from the carry-chain split, unverified: LSB flips 0.095 per cycle, 17 distinct values 2..18. Strongest correlation: age r=+0.30. Size / class candidate: camera vehicle height partial rho 0.41-0.71, width 0.36-0.69, truck/bus 0.24-0.39 (docs/14).";
CM_ SG_ 1803 CONST_277_11 "Constant 0 (0x0) in every record observed: reserved/padding or configuration.";
VAL_ 1792 ONCOMING_FLAG 0 "not oncoming" 1 "oncoming (now or earlier)" ;
VAL_ 1792 MOVE_STATE 0 "moving away" 1 "not clearly moving" 2 "moving toward" 3 "not clearly moving (3)" ;
VAL_ 1793 ONCOMING_FLAG 0 "not oncoming" 1 "oncoming (now or earlier)" ;
VAL_ 1793 MOVE_STATE 0 "moving away" 1 "not clearly moving" 2 "moving toward" 3 "not clearly moving (3)" ;
VAL_ 1794 ONCOMING_FLAG 0 "not oncoming" 1 "oncoming (now or earlier)" ;
VAL_ 1794 MOVE_STATE 0 "moving away" 1 "not clearly moving" 2 "moving toward" 3 "not clearly moving (3)" ;
VAL_ 1795 ONCOMING_FLAG 0 "not oncoming" 1 "oncoming (now or earlier)" ;
VAL_ 1795 MOVE_STATE 0 "moving away" 1 "not clearly moving" 2 "moving toward" 3 "not clearly moving (3)" ;
VAL_ 1796 ONCOMING_FLAG 0 "not oncoming" 1 "oncoming (now or earlier)" ;
VAL_ 1796 MOVE_STATE 0 "moving away" 1 "not clearly moving" 2 "moving toward" 3 "not clearly moving (3)" ;
VAL_ 1797 ONCOMING_FLAG 0 "not oncoming" 1 "oncoming (now or earlier)" ;
VAL_ 1797 MOVE_STATE 0 "moving away" 1 "not clearly moving" 2 "moving toward" 3 "not clearly moving (3)" ;
VAL_ 1798 ONCOMING_FLAG 0 "not oncoming" 1 "oncoming (now or earlier)" ;
VAL_ 1798 MOVE_STATE 0 "moving away" 1 "not clearly moving" 2 "moving toward" 3 "not clearly moving (3)" ;
VAL_ 1799 ONCOMING_FLAG 0 "not oncoming" 1 "oncoming (now or earlier)" ;
VAL_ 1799 MOVE_STATE 0 "moving away" 1 "not clearly moving" 2 "moving toward" 3 "not clearly moving (3)" ;
VAL_ 1800 ONCOMING_FLAG 0 "not oncoming" 1 "oncoming (now or earlier)" ;
VAL_ 1800 MOVE_STATE 0 "moving away" 1 "not clearly moving" 2 "moving toward" 3 "not clearly moving (3)" ;
VAL_ 1801 ONCOMING_FLAG 0 "not oncoming" 1 "oncoming (now or earlier)" ;
VAL_ 1801 MOVE_STATE 0 "moving away" 1 "not clearly moving" 2 "moving toward" 3 "not clearly moving (3)" ;
VAL_ 1802 ONCOMING_FLAG 0 "not oncoming" 1 "oncoming (now or earlier)" ;
VAL_ 1802 MOVE_STATE 0 "moving away" 1 "not clearly moving" 2 "moving toward" 3 "not clearly moving (3)" ;
VAL_ 1803 ONCOMING_FLAG 0 "not oncoming" 1 "oncoming (now or earlier)" ;
VAL_ 1803 MOVE_STATE 0 "moving away" 1 "not clearly moving" 2 "moving toward" 3 "not clearly moving (3)" ;
