VERSION "ARS510 reassembled object / shell records on a virtual bus (generated by tools/build_cabana_route.py)"

NS_ :

BS_:

BU_: RADAR XXX

BO_ 1792 ARS510_OBJ_00: 48 RADAR
 SG_ STATE_CODE : 0|2@1+ (1,0) [0|3] "raw" XXX
 SG_ SLOT_INDEX_CODE : 2|6@1+ (1,0) [0|63] "raw" XXX
 SG_ UNK_8_6 : 8|6@1+ (1,0) [0|63] "raw" XXX
 SG_ ONCOMING_FLAG : 14|1@1+ (1,0) [0|1] "" XXX
 SG_ UNK_15_1 : 15|1@1+ (1,0) [0|1] "raw" XXX
 SG_ SCORE_CODE : 16|8@1+ (1,0) [0|255] "raw" XXX
 SG_ AGE : 24|7@1+ (1,0) [0|126] "cycles" XXX
 SG_ CONST_31_1 : 31|1@1+ (1,0) [0|1] "raw" XXX
 SG_ DREL : 32|12@1+ (0.0625,-10) [-10|245.9375] "m" XXX
 SG_ YREL_LEFT : 44|12@1+ (0.015,-30.72) [-30.72|30.705] "m" XXX
 SG_ UNK_56_7 : 56|7@1+ (1,0) [0|127] "raw" XXX
 SG_ UNK_63_1 : 63|1@1+ (1,0) [0|1] "raw" XXX
 SG_ VLONG_OVER_GROUND : 64|10@1+ (0.15,-76.575) [-76.575|76.875] "m/s" XXX
 SG_ VLAT_OVER_GROUND_PROV : 74|10@1+ (0.15,-76.575) [-76.575|76.875] "m/s" XXX
 SG_ ALONG_LIKE_84 : 84|10@1+ (1,-511) [-511|512] "code" XXX
 SG_ CONST_94_2 : 94|2@1+ (1,0) [0|3] "raw" XXX
 SG_ UNK_96 : 96|10@1+ (1,0) [0|1023] "raw" XXX
 SG_ UNK_106_1 : 106|1@1+ (1,0) [0|1] "raw" XXX
 SG_ UNK_107_1 : 107|1@1+ (1,0) [0|1] "raw" XXX
 SG_ CONST_108_1 : 108|1@1+ (1,0) [0|1] "raw" XXX
 SG_ MOVE_STATE : 109|2@1+ (1,0) [0|3] "" XXX
 SG_ UNK_111_1 : 111|1@1+ (1,0) [0|1] "raw" XXX
 SG_ UNK_112_3 : 112|3@1+ (1,0) [0|7] "raw" XXX
 SG_ UNK_115_5 : 115|5@1+ (1,0) [0|31] "raw" XXX
 SG_ UNK_120_3 : 120|3@1+ (1,0) [0|7] "raw" XXX
 SG_ CONST_123_5 : 123|5@1+ (1,0) [0|31] "raw" XXX
 SG_ UNK_128_2 : 128|2@1+ (1,0) [0|3] "raw" XXX
 SG_ UNK_130_1 : 130|1@1+ (1,0) [0|1] "raw" XXX
 SG_ UNK_131_4 : 131|4@1+ (1,0) [0|15] "raw" XXX
 SG_ CONST_135_1 : 135|1@1+ (1,0) [0|1] "raw" XXX
 SG_ UNK_136_4 : 136|4@1+ (1,0) [0|15] "raw" XXX
 SG_ UNK_140_3 : 140|3@1+ (1,0) [0|7] "raw" XXX
 SG_ CONST_143_5 : 143|5@1+ (1,0) [0|31] "raw" XXX
 SG_ UNK_148_8 : 148|8@1+ (1,0) [0|255] "raw" XXX
 SG_ UNK_156_4 : 156|4@1+ (1,0) [0|15] "raw" XXX
 SG_ CONST_160_3 : 160|3@1+ (1,0) [0|7] "raw" XXX
 SG_ UNK_163_3 : 163|3@1+ (1,0) [0|7] "raw" XXX
 SG_ UNK_166_2 : 166|2@1+ (1,0) [0|3] "raw" XXX
 SG_ UNK_168_10 : 168|10@1+ (1,0) [0|1023] "raw" XXX
 SG_ CONST_178_3 : 178|3@1+ (1,0) [0|7] "raw" XXX
 SG_ UNK_181_1 : 181|1@1+ (1,0) [0|1] "raw" XXX
 SG_ UNK_182_1 : 182|1@1+ (1,0) [0|1] "raw" XXX
 SG_ UNK_183_7 : 183|7@1+ (1,0) [0|127] "raw" XXX
 SG_ UNK_190_10 : 190|10@1+ (1,0) [0|1023] "raw" XXX
 SG_ UNK_200_7 : 200|7@1+ (1,0) [0|127] "raw" XXX
 SG_ CONST_207_1 : 207|1@1+ (1,0) [0|1] "raw" XXX
 SG_ UNK_208_6 : 208|6@1+ (1,0) [0|63] "raw" XXX
 SG_ CONST_214_2 : 214|2@1+ (1,0) [0|3] "raw" XXX
 SG_ UNK_216_6 : 216|6@1+ (1,0) [0|63] "raw" XXX
 SG_ CONST_222_2 : 222|2@1+ (1,0) [0|3] "raw" XXX
 SG_ UNK_224_7 : 224|7@1+ (1,0) [0|127] "raw" XXX
 SG_ CONST_231_1 : 231|1@1+ (1,0) [0|1] "raw" XXX
 SG_ UNK_232_8 : 232|8@1+ (1,0) [0|255] "raw" XXX
 SG_ UNK_240_7 : 240|7@1+ (1,0) [0|127] "raw" XXX
 SG_ CONST_247_1 : 247|1@1+ (1,0) [0|1] "raw" XXX
 SG_ UNK_248_7 : 248|7@1+ (1,0) [0|127] "raw" XXX
 SG_ CONST_255_1 : 255|1@1+ (1,0) [0|1] "raw" XXX
 SG_ UNK_256_8 : 256|8@1+ (1,0) [0|255] "raw" XXX
 SG_ UNK_264_8 : 264|8@1+ (1,0) [0|255] "raw" XXX
 SG_ UNK_272_5 : 272|5@1+ (1,0) [0|31] "raw" XXX
 SG_ UNK_277_11 : 277|11@1+ (1,0) [0|2047] "raw" XXX

BO_ 1793 ARS510_OBJ_01: 48 RADAR
 SG_ STATE_CODE : 0|2@1+ (1,0) [0|3] "raw" XXX
 SG_ SLOT_INDEX_CODE : 2|6@1+ (1,0) [0|63] "raw" XXX
 SG_ UNK_8_6 : 8|6@1+ (1,0) [0|63] "raw" XXX
 SG_ ONCOMING_FLAG : 14|1@1+ (1,0) [0|1] "" XXX
 SG_ UNK_15_1 : 15|1@1+ (1,0) [0|1] "raw" XXX
 SG_ SCORE_CODE : 16|8@1+ (1,0) [0|255] "raw" XXX
 SG_ AGE : 24|7@1+ (1,0) [0|126] "cycles" XXX
 SG_ CONST_31_1 : 31|1@1+ (1,0) [0|1] "raw" XXX
 SG_ DREL : 32|12@1+ (0.0625,-10) [-10|245.9375] "m" XXX
 SG_ YREL_LEFT : 44|12@1+ (0.015,-30.72) [-30.72|30.705] "m" XXX
 SG_ UNK_56_7 : 56|7@1+ (1,0) [0|127] "raw" XXX
 SG_ UNK_63_1 : 63|1@1+ (1,0) [0|1] "raw" XXX
 SG_ VLONG_OVER_GROUND : 64|10@1+ (0.15,-76.575) [-76.575|76.875] "m/s" XXX
 SG_ VLAT_OVER_GROUND_PROV : 74|10@1+ (0.15,-76.575) [-76.575|76.875] "m/s" XXX
 SG_ ALONG_LIKE_84 : 84|10@1+ (1,-511) [-511|512] "code" XXX
 SG_ CONST_94_2 : 94|2@1+ (1,0) [0|3] "raw" XXX
 SG_ UNK_96 : 96|10@1+ (1,0) [0|1023] "raw" XXX
 SG_ UNK_106_1 : 106|1@1+ (1,0) [0|1] "raw" XXX
 SG_ UNK_107_1 : 107|1@1+ (1,0) [0|1] "raw" XXX
 SG_ CONST_108_1 : 108|1@1+ (1,0) [0|1] "raw" XXX
 SG_ MOVE_STATE : 109|2@1+ (1,0) [0|3] "" XXX
 SG_ UNK_111_1 : 111|1@1+ (1,0) [0|1] "raw" XXX
 SG_ UNK_112_3 : 112|3@1+ (1,0) [0|7] "raw" XXX
 SG_ UNK_115_5 : 115|5@1+ (1,0) [0|31] "raw" XXX
 SG_ UNK_120_3 : 120|3@1+ (1,0) [0|7] "raw" XXX
 SG_ CONST_123_5 : 123|5@1+ (1,0) [0|31] "raw" XXX
 SG_ UNK_128_2 : 128|2@1+ (1,0) [0|3] "raw" XXX
 SG_ UNK_130_1 : 130|1@1+ (1,0) [0|1] "raw" XXX
 SG_ UNK_131_4 : 131|4@1+ (1,0) [0|15] "raw" XXX
 SG_ CONST_135_1 : 135|1@1+ (1,0) [0|1] "raw" XXX
 SG_ UNK_136_4 : 136|4@1+ (1,0) [0|15] "raw" XXX
 SG_ UNK_140_3 : 140|3@1+ (1,0) [0|7] "raw" XXX
 SG_ CONST_143_5 : 143|5@1+ (1,0) [0|31] "raw" XXX
 SG_ UNK_148_8 : 148|8@1+ (1,0) [0|255] "raw" XXX
 SG_ UNK_156_4 : 156|4@1+ (1,0) [0|15] "raw" XXX
 SG_ CONST_160_3 : 160|3@1+ (1,0) [0|7] "raw" XXX
 SG_ UNK_163_3 : 163|3@1+ (1,0) [0|7] "raw" XXX
 SG_ UNK_166_2 : 166|2@1+ (1,0) [0|3] "raw" XXX
 SG_ UNK_168_10 : 168|10@1+ (1,0) [0|1023] "raw" XXX
 SG_ CONST_178_3 : 178|3@1+ (1,0) [0|7] "raw" XXX
 SG_ UNK_181_1 : 181|1@1+ (1,0) [0|1] "raw" XXX
 SG_ UNK_182_1 : 182|1@1+ (1,0) [0|1] "raw" XXX
 SG_ UNK_183_7 : 183|7@1+ (1,0) [0|127] "raw" XXX
 SG_ UNK_190_10 : 190|10@1+ (1,0) [0|1023] "raw" XXX
 SG_ UNK_200_7 : 200|7@1+ (1,0) [0|127] "raw" XXX
 SG_ CONST_207_1 : 207|1@1+ (1,0) [0|1] "raw" XXX
 SG_ UNK_208_6 : 208|6@1+ (1,0) [0|63] "raw" XXX
 SG_ CONST_214_2 : 214|2@1+ (1,0) [0|3] "raw" XXX
 SG_ UNK_216_6 : 216|6@1+ (1,0) [0|63] "raw" XXX
 SG_ CONST_222_2 : 222|2@1+ (1,0) [0|3] "raw" XXX
 SG_ UNK_224_7 : 224|7@1+ (1,0) [0|127] "raw" XXX
 SG_ CONST_231_1 : 231|1@1+ (1,0) [0|1] "raw" XXX
 SG_ UNK_232_8 : 232|8@1+ (1,0) [0|255] "raw" XXX
 SG_ UNK_240_7 : 240|7@1+ (1,0) [0|127] "raw" XXX
 SG_ CONST_247_1 : 247|1@1+ (1,0) [0|1] "raw" XXX
 SG_ UNK_248_7 : 248|7@1+ (1,0) [0|127] "raw" XXX
 SG_ CONST_255_1 : 255|1@1+ (1,0) [0|1] "raw" XXX
 SG_ UNK_256_8 : 256|8@1+ (1,0) [0|255] "raw" XXX
 SG_ UNK_264_8 : 264|8@1+ (1,0) [0|255] "raw" XXX
 SG_ UNK_272_5 : 272|5@1+ (1,0) [0|31] "raw" XXX
 SG_ UNK_277_11 : 277|11@1+ (1,0) [0|2047] "raw" XXX

BO_ 1794 ARS510_OBJ_02: 48 RADAR
 SG_ STATE_CODE : 0|2@1+ (1,0) [0|3] "raw" XXX
 SG_ SLOT_INDEX_CODE : 2|6@1+ (1,0) [0|63] "raw" XXX
 SG_ UNK_8_6 : 8|6@1+ (1,0) [0|63] "raw" XXX
 SG_ ONCOMING_FLAG : 14|1@1+ (1,0) [0|1] "" XXX
 SG_ UNK_15_1 : 15|1@1+ (1,0) [0|1] "raw" XXX
 SG_ SCORE_CODE : 16|8@1+ (1,0) [0|255] "raw" XXX
 SG_ AGE : 24|7@1+ (1,0) [0|126] "cycles" XXX
 SG_ CONST_31_1 : 31|1@1+ (1,0) [0|1] "raw" XXX
 SG_ DREL : 32|12@1+ (0.0625,-10) [-10|245.9375] "m" XXX
 SG_ YREL_LEFT : 44|12@1+ (0.015,-30.72) [-30.72|30.705] "m" XXX
 SG_ UNK_56_7 : 56|7@1+ (1,0) [0|127] "raw" XXX
 SG_ UNK_63_1 : 63|1@1+ (1,0) [0|1] "raw" XXX
 SG_ VLONG_OVER_GROUND : 64|10@1+ (0.15,-76.575) [-76.575|76.875] "m/s" XXX
 SG_ VLAT_OVER_GROUND_PROV : 74|10@1+ (0.15,-76.575) [-76.575|76.875] "m/s" XXX
 SG_ ALONG_LIKE_84 : 84|10@1+ (1,-511) [-511|512] "code" XXX
 SG_ CONST_94_2 : 94|2@1+ (1,0) [0|3] "raw" XXX
 SG_ UNK_96 : 96|10@1+ (1,0) [0|1023] "raw" XXX
 SG_ UNK_106_1 : 106|1@1+ (1,0) [0|1] "raw" XXX
 SG_ UNK_107_1 : 107|1@1+ (1,0) [0|1] "raw" XXX
 SG_ CONST_108_1 : 108|1@1+ (1,0) [0|1] "raw" XXX
 SG_ MOVE_STATE : 109|2@1+ (1,0) [0|3] "" XXX
 SG_ UNK_111_1 : 111|1@1+ (1,0) [0|1] "raw" XXX
 SG_ UNK_112_3 : 112|3@1+ (1,0) [0|7] "raw" XXX
 SG_ UNK_115_5 : 115|5@1+ (1,0) [0|31] "raw" XXX
 SG_ UNK_120_3 : 120|3@1+ (1,0) [0|7] "raw" XXX
 SG_ CONST_123_5 : 123|5@1+ (1,0) [0|31] "raw" XXX
 SG_ UNK_128_2 : 128|2@1+ (1,0) [0|3] "raw" XXX
 SG_ UNK_130_1 : 130|1@1+ (1,0) [0|1] "raw" XXX
 SG_ UNK_131_4 : 131|4@1+ (1,0) [0|15] "raw" XXX
 SG_ CONST_135_1 : 135|1@1+ (1,0) [0|1] "raw" XXX
 SG_ UNK_136_4 : 136|4@1+ (1,0) [0|15] "raw" XXX
 SG_ UNK_140_3 : 140|3@1+ (1,0) [0|7] "raw" XXX
 SG_ CONST_143_5 : 143|5@1+ (1,0) [0|31] "raw" XXX
 SG_ UNK_148_8 : 148|8@1+ (1,0) [0|255] "raw" XXX
 SG_ UNK_156_4 : 156|4@1+ (1,0) [0|15] "raw" XXX
 SG_ CONST_160_3 : 160|3@1+ (1,0) [0|7] "raw" XXX
 SG_ UNK_163_3 : 163|3@1+ (1,0) [0|7] "raw" XXX
 SG_ UNK_166_2 : 166|2@1+ (1,0) [0|3] "raw" XXX
 SG_ UNK_168_10 : 168|10@1+ (1,0) [0|1023] "raw" XXX
 SG_ CONST_178_3 : 178|3@1+ (1,0) [0|7] "raw" XXX
 SG_ UNK_181_1 : 181|1@1+ (1,0) [0|1] "raw" XXX
 SG_ UNK_182_1 : 182|1@1+ (1,0) [0|1] "raw" XXX
 SG_ UNK_183_7 : 183|7@1+ (1,0) [0|127] "raw" XXX
 SG_ UNK_190_10 : 190|10@1+ (1,0) [0|1023] "raw" XXX
 SG_ UNK_200_7 : 200|7@1+ (1,0) [0|127] "raw" XXX
 SG_ CONST_207_1 : 207|1@1+ (1,0) [0|1] "raw" XXX
 SG_ UNK_208_6 : 208|6@1+ (1,0) [0|63] "raw" XXX
 SG_ CONST_214_2 : 214|2@1+ (1,0) [0|3] "raw" XXX
 SG_ UNK_216_6 : 216|6@1+ (1,0) [0|63] "raw" XXX
 SG_ CONST_222_2 : 222|2@1+ (1,0) [0|3] "raw" XXX
 SG_ UNK_224_7 : 224|7@1+ (1,0) [0|127] "raw" XXX
 SG_ CONST_231_1 : 231|1@1+ (1,0) [0|1] "raw" XXX
 SG_ UNK_232_8 : 232|8@1+ (1,0) [0|255] "raw" XXX
 SG_ UNK_240_7 : 240|7@1+ (1,0) [0|127] "raw" XXX
 SG_ CONST_247_1 : 247|1@1+ (1,0) [0|1] "raw" XXX
 SG_ UNK_248_7 : 248|7@1+ (1,0) [0|127] "raw" XXX
 SG_ CONST_255_1 : 255|1@1+ (1,0) [0|1] "raw" XXX
 SG_ UNK_256_8 : 256|8@1+ (1,0) [0|255] "raw" XXX
 SG_ UNK_264_8 : 264|8@1+ (1,0) [0|255] "raw" XXX
 SG_ UNK_272_5 : 272|5@1+ (1,0) [0|31] "raw" XXX
 SG_ UNK_277_11 : 277|11@1+ (1,0) [0|2047] "raw" XXX

BO_ 1795 ARS510_OBJ_03: 48 RADAR
 SG_ STATE_CODE : 0|2@1+ (1,0) [0|3] "raw" XXX
 SG_ SLOT_INDEX_CODE : 2|6@1+ (1,0) [0|63] "raw" XXX
 SG_ UNK_8_6 : 8|6@1+ (1,0) [0|63] "raw" XXX
 SG_ ONCOMING_FLAG : 14|1@1+ (1,0) [0|1] "" XXX
 SG_ UNK_15_1 : 15|1@1+ (1,0) [0|1] "raw" XXX
 SG_ SCORE_CODE : 16|8@1+ (1,0) [0|255] "raw" XXX
 SG_ AGE : 24|7@1+ (1,0) [0|126] "cycles" XXX
 SG_ CONST_31_1 : 31|1@1+ (1,0) [0|1] "raw" XXX
 SG_ DREL : 32|12@1+ (0.0625,-10) [-10|245.9375] "m" XXX
 SG_ YREL_LEFT : 44|12@1+ (0.015,-30.72) [-30.72|30.705] "m" XXX
 SG_ UNK_56_7 : 56|7@1+ (1,0) [0|127] "raw" XXX
 SG_ UNK_63_1 : 63|1@1+ (1,0) [0|1] "raw" XXX
 SG_ VLONG_OVER_GROUND : 64|10@1+ (0.15,-76.575) [-76.575|76.875] "m/s" XXX
 SG_ VLAT_OVER_GROUND_PROV : 74|10@1+ (0.15,-76.575) [-76.575|76.875] "m/s" XXX
 SG_ ALONG_LIKE_84 : 84|10@1+ (1,-511) [-511|512] "code" XXX
 SG_ CONST_94_2 : 94|2@1+ (1,0) [0|3] "raw" XXX
 SG_ UNK_96 : 96|10@1+ (1,0) [0|1023] "raw" XXX
 SG_ UNK_106_1 : 106|1@1+ (1,0) [0|1] "raw" XXX
 SG_ UNK_107_1 : 107|1@1+ (1,0) [0|1] "raw" XXX
 SG_ CONST_108_1 : 108|1@1+ (1,0) [0|1] "raw" XXX
 SG_ MOVE_STATE : 109|2@1+ (1,0) [0|3] "" XXX
 SG_ UNK_111_1 : 111|1@1+ (1,0) [0|1] "raw" XXX
 SG_ UNK_112_3 : 112|3@1+ (1,0) [0|7] "raw" XXX
 SG_ UNK_115_5 : 115|5@1+ (1,0) [0|31] "raw" XXX
 SG_ UNK_120_3 : 120|3@1+ (1,0) [0|7] "raw" XXX
 SG_ CONST_123_5 : 123|5@1+ (1,0) [0|31] "raw" XXX
 SG_ UNK_128_2 : 128|2@1+ (1,0) [0|3] "raw" XXX
 SG_ UNK_130_1 : 130|1@1+ (1,0) [0|1] "raw" XXX
 SG_ UNK_131_4 : 131|4@1+ (1,0) [0|15] "raw" XXX
 SG_ CONST_135_1 : 135|1@1+ (1,0) [0|1] "raw" XXX
 SG_ UNK_136_4 : 136|4@1+ (1,0) [0|15] "raw" XXX
 SG_ UNK_140_3 : 140|3@1+ (1,0) [0|7] "raw" XXX
 SG_ CONST_143_5 : 143|5@1+ (1,0) [0|31] "raw" XXX
 SG_ UNK_148_8 : 148|8@1+ (1,0) [0|255] "raw" XXX
 SG_ UNK_156_4 : 156|4@1+ (1,0) [0|15] "raw" XXX
 SG_ CONST_160_3 : 160|3@1+ (1,0) [0|7] "raw" XXX
 SG_ UNK_163_3 : 163|3@1+ (1,0) [0|7] "raw" XXX
 SG_ UNK_166_2 : 166|2@1+ (1,0) [0|3] "raw" XXX
 SG_ UNK_168_10 : 168|10@1+ (1,0) [0|1023] "raw" XXX
 SG_ CONST_178_3 : 178|3@1+ (1,0) [0|7] "raw" XXX
 SG_ UNK_181_1 : 181|1@1+ (1,0) [0|1] "raw" XXX
 SG_ UNK_182_1 : 182|1@1+ (1,0) [0|1] "raw" XXX
 SG_ UNK_183_7 : 183|7@1+ (1,0) [0|127] "raw" XXX
 SG_ UNK_190_10 : 190|10@1+ (1,0) [0|1023] "raw" XXX
 SG_ UNK_200_7 : 200|7@1+ (1,0) [0|127] "raw" XXX
 SG_ CONST_207_1 : 207|1@1+ (1,0) [0|1] "raw" XXX
 SG_ UNK_208_6 : 208|6@1+ (1,0) [0|63] "raw" XXX
 SG_ CONST_214_2 : 214|2@1+ (1,0) [0|3] "raw" XXX
 SG_ UNK_216_6 : 216|6@1+ (1,0) [0|63] "raw" XXX
 SG_ CONST_222_2 : 222|2@1+ (1,0) [0|3] "raw" XXX
 SG_ UNK_224_7 : 224|7@1+ (1,0) [0|127] "raw" XXX
 SG_ CONST_231_1 : 231|1@1+ (1,0) [0|1] "raw" XXX
 SG_ UNK_232_8 : 232|8@1+ (1,0) [0|255] "raw" XXX
 SG_ UNK_240_7 : 240|7@1+ (1,0) [0|127] "raw" XXX
 SG_ CONST_247_1 : 247|1@1+ (1,0) [0|1] "raw" XXX
 SG_ UNK_248_7 : 248|7@1+ (1,0) [0|127] "raw" XXX
 SG_ CONST_255_1 : 255|1@1+ (1,0) [0|1] "raw" XXX
 SG_ UNK_256_8 : 256|8@1+ (1,0) [0|255] "raw" XXX
 SG_ UNK_264_8 : 264|8@1+ (1,0) [0|255] "raw" XXX
 SG_ UNK_272_5 : 272|5@1+ (1,0) [0|31] "raw" XXX
 SG_ UNK_277_11 : 277|11@1+ (1,0) [0|2047] "raw" XXX

BO_ 1796 ARS510_OBJ_04: 48 RADAR
 SG_ STATE_CODE : 0|2@1+ (1,0) [0|3] "raw" XXX
 SG_ SLOT_INDEX_CODE : 2|6@1+ (1,0) [0|63] "raw" XXX
 SG_ UNK_8_6 : 8|6@1+ (1,0) [0|63] "raw" XXX
 SG_ ONCOMING_FLAG : 14|1@1+ (1,0) [0|1] "" XXX
 SG_ UNK_15_1 : 15|1@1+ (1,0) [0|1] "raw" XXX
 SG_ SCORE_CODE : 16|8@1+ (1,0) [0|255] "raw" XXX
 SG_ AGE : 24|7@1+ (1,0) [0|126] "cycles" XXX
 SG_ CONST_31_1 : 31|1@1+ (1,0) [0|1] "raw" XXX
 SG_ DREL : 32|12@1+ (0.0625,-10) [-10|245.9375] "m" XXX
 SG_ YREL_LEFT : 44|12@1+ (0.015,-30.72) [-30.72|30.705] "m" XXX
 SG_ UNK_56_7 : 56|7@1+ (1,0) [0|127] "raw" XXX
 SG_ UNK_63_1 : 63|1@1+ (1,0) [0|1] "raw" XXX
 SG_ VLONG_OVER_GROUND : 64|10@1+ (0.15,-76.575) [-76.575|76.875] "m/s" XXX
 SG_ VLAT_OVER_GROUND_PROV : 74|10@1+ (0.15,-76.575) [-76.575|76.875] "m/s" XXX
 SG_ ALONG_LIKE_84 : 84|10@1+ (1,-511) [-511|512] "code" XXX
 SG_ CONST_94_2 : 94|2@1+ (1,0) [0|3] "raw" XXX
 SG_ UNK_96 : 96|10@1+ (1,0) [0|1023] "raw" XXX
 SG_ UNK_106_1 : 106|1@1+ (1,0) [0|1] "raw" XXX
 SG_ UNK_107_1 : 107|1@1+ (1,0) [0|1] "raw" XXX
 SG_ CONST_108_1 : 108|1@1+ (1,0) [0|1] "raw" XXX
 SG_ MOVE_STATE : 109|2@1+ (1,0) [0|3] "" XXX
 SG_ UNK_111_1 : 111|1@1+ (1,0) [0|1] "raw" XXX
 SG_ UNK_112_3 : 112|3@1+ (1,0) [0|7] "raw" XXX
 SG_ UNK_115_5 : 115|5@1+ (1,0) [0|31] "raw" XXX
 SG_ UNK_120_3 : 120|3@1+ (1,0) [0|7] "raw" XXX
 SG_ CONST_123_5 : 123|5@1+ (1,0) [0|31] "raw" XXX
 SG_ UNK_128_2 : 128|2@1+ (1,0) [0|3] "raw" XXX
 SG_ UNK_130_1 : 130|1@1+ (1,0) [0|1] "raw" XXX
 SG_ UNK_131_4 : 131|4@1+ (1,0) [0|15] "raw" XXX
 SG_ CONST_135_1 : 135|1@1+ (1,0) [0|1] "raw" XXX
 SG_ UNK_136_4 : 136|4@1+ (1,0) [0|15] "raw" XXX
 SG_ UNK_140_3 : 140|3@1+ (1,0) [0|7] "raw" XXX
 SG_ CONST_143_5 : 143|5@1+ (1,0) [0|31] "raw" XXX
 SG_ UNK_148_8 : 148|8@1+ (1,0) [0|255] "raw" XXX
 SG_ UNK_156_4 : 156|4@1+ (1,0) [0|15] "raw" XXX
 SG_ CONST_160_3 : 160|3@1+ (1,0) [0|7] "raw" XXX
 SG_ UNK_163_3 : 163|3@1+ (1,0) [0|7] "raw" XXX
 SG_ UNK_166_2 : 166|2@1+ (1,0) [0|3] "raw" XXX
 SG_ UNK_168_10 : 168|10@1+ (1,0) [0|1023] "raw" XXX
 SG_ CONST_178_3 : 178|3@1+ (1,0) [0|7] "raw" XXX
 SG_ UNK_181_1 : 181|1@1+ (1,0) [0|1] "raw" XXX
 SG_ UNK_182_1 : 182|1@1+ (1,0) [0|1] "raw" XXX
 SG_ UNK_183_7 : 183|7@1+ (1,0) [0|127] "raw" XXX
 SG_ UNK_190_10 : 190|10@1+ (1,0) [0|1023] "raw" XXX
 SG_ UNK_200_7 : 200|7@1+ (1,0) [0|127] "raw" XXX
 SG_ CONST_207_1 : 207|1@1+ (1,0) [0|1] "raw" XXX
 SG_ UNK_208_6 : 208|6@1+ (1,0) [0|63] "raw" XXX
 SG_ CONST_214_2 : 214|2@1+ (1,0) [0|3] "raw" XXX
 SG_ UNK_216_6 : 216|6@1+ (1,0) [0|63] "raw" XXX
 SG_ CONST_222_2 : 222|2@1+ (1,0) [0|3] "raw" XXX
 SG_ UNK_224_7 : 224|7@1+ (1,0) [0|127] "raw" XXX
 SG_ CONST_231_1 : 231|1@1+ (1,0) [0|1] "raw" XXX
 SG_ UNK_232_8 : 232|8@1+ (1,0) [0|255] "raw" XXX
 SG_ UNK_240_7 : 240|7@1+ (1,0) [0|127] "raw" XXX
 SG_ CONST_247_1 : 247|1@1+ (1,0) [0|1] "raw" XXX
 SG_ UNK_248_7 : 248|7@1+ (1,0) [0|127] "raw" XXX
 SG_ CONST_255_1 : 255|1@1+ (1,0) [0|1] "raw" XXX
 SG_ UNK_256_8 : 256|8@1+ (1,0) [0|255] "raw" XXX
 SG_ UNK_264_8 : 264|8@1+ (1,0) [0|255] "raw" XXX
 SG_ UNK_272_5 : 272|5@1+ (1,0) [0|31] "raw" XXX
 SG_ UNK_277_11 : 277|11@1+ (1,0) [0|2047] "raw" XXX

BO_ 1797 ARS510_OBJ_05: 48 RADAR
 SG_ STATE_CODE : 0|2@1+ (1,0) [0|3] "raw" XXX
 SG_ SLOT_INDEX_CODE : 2|6@1+ (1,0) [0|63] "raw" XXX
 SG_ UNK_8_6 : 8|6@1+ (1,0) [0|63] "raw" XXX
 SG_ ONCOMING_FLAG : 14|1@1+ (1,0) [0|1] "" XXX
 SG_ UNK_15_1 : 15|1@1+ (1,0) [0|1] "raw" XXX
 SG_ SCORE_CODE : 16|8@1+ (1,0) [0|255] "raw" XXX
 SG_ AGE : 24|7@1+ (1,0) [0|126] "cycles" XXX
 SG_ CONST_31_1 : 31|1@1+ (1,0) [0|1] "raw" XXX
 SG_ DREL : 32|12@1+ (0.0625,-10) [-10|245.9375] "m" XXX
 SG_ YREL_LEFT : 44|12@1+ (0.015,-30.72) [-30.72|30.705] "m" XXX
 SG_ UNK_56_7 : 56|7@1+ (1,0) [0|127] "raw" XXX
 SG_ UNK_63_1 : 63|1@1+ (1,0) [0|1] "raw" XXX
 SG_ VLONG_OVER_GROUND : 64|10@1+ (0.15,-76.575) [-76.575|76.875] "m/s" XXX
 SG_ VLAT_OVER_GROUND_PROV : 74|10@1+ (0.15,-76.575) [-76.575|76.875] "m/s" XXX
 SG_ ALONG_LIKE_84 : 84|10@1+ (1,-511) [-511|512] "code" XXX
 SG_ CONST_94_2 : 94|2@1+ (1,0) [0|3] "raw" XXX
 SG_ UNK_96 : 96|10@1+ (1,0) [0|1023] "raw" XXX
 SG_ UNK_106_1 : 106|1@1+ (1,0) [0|1] "raw" XXX
 SG_ UNK_107_1 : 107|1@1+ (1,0) [0|1] "raw" XXX
 SG_ CONST_108_1 : 108|1@1+ (1,0) [0|1] "raw" XXX
 SG_ MOVE_STATE : 109|2@1+ (1,0) [0|3] "" XXX
 SG_ UNK_111_1 : 111|1@1+ (1,0) [0|1] "raw" XXX
 SG_ UNK_112_3 : 112|3@1+ (1,0) [0|7] "raw" XXX
 SG_ UNK_115_5 : 115|5@1+ (1,0) [0|31] "raw" XXX
 SG_ UNK_120_3 : 120|3@1+ (1,0) [0|7] "raw" XXX
 SG_ CONST_123_5 : 123|5@1+ (1,0) [0|31] "raw" XXX
 SG_ UNK_128_2 : 128|2@1+ (1,0) [0|3] "raw" XXX
 SG_ UNK_130_1 : 130|1@1+ (1,0) [0|1] "raw" XXX
 SG_ UNK_131_4 : 131|4@1+ (1,0) [0|15] "raw" XXX
 SG_ CONST_135_1 : 135|1@1+ (1,0) [0|1] "raw" XXX
 SG_ UNK_136_4 : 136|4@1+ (1,0) [0|15] "raw" XXX
 SG_ UNK_140_3 : 140|3@1+ (1,0) [0|7] "raw" XXX
 SG_ CONST_143_5 : 143|5@1+ (1,0) [0|31] "raw" XXX
 SG_ UNK_148_8 : 148|8@1+ (1,0) [0|255] "raw" XXX
 SG_ UNK_156_4 : 156|4@1+ (1,0) [0|15] "raw" XXX
 SG_ CONST_160_3 : 160|3@1+ (1,0) [0|7] "raw" XXX
 SG_ UNK_163_3 : 163|3@1+ (1,0) [0|7] "raw" XXX
 SG_ UNK_166_2 : 166|2@1+ (1,0) [0|3] "raw" XXX
 SG_ UNK_168_10 : 168|10@1+ (1,0) [0|1023] "raw" XXX
 SG_ CONST_178_3 : 178|3@1+ (1,0) [0|7] "raw" XXX
 SG_ UNK_181_1 : 181|1@1+ (1,0) [0|1] "raw" XXX
 SG_ UNK_182_1 : 182|1@1+ (1,0) [0|1] "raw" XXX
 SG_ UNK_183_7 : 183|7@1+ (1,0) [0|127] "raw" XXX
 SG_ UNK_190_10 : 190|10@1+ (1,0) [0|1023] "raw" XXX
 SG_ UNK_200_7 : 200|7@1+ (1,0) [0|127] "raw" XXX
 SG_ CONST_207_1 : 207|1@1+ (1,0) [0|1] "raw" XXX
 SG_ UNK_208_6 : 208|6@1+ (1,0) [0|63] "raw" XXX
 SG_ CONST_214_2 : 214|2@1+ (1,0) [0|3] "raw" XXX
 SG_ UNK_216_6 : 216|6@1+ (1,0) [0|63] "raw" XXX
 SG_ CONST_222_2 : 222|2@1+ (1,0) [0|3] "raw" XXX
 SG_ UNK_224_7 : 224|7@1+ (1,0) [0|127] "raw" XXX
 SG_ CONST_231_1 : 231|1@1+ (1,0) [0|1] "raw" XXX
 SG_ UNK_232_8 : 232|8@1+ (1,0) [0|255] "raw" XXX
 SG_ UNK_240_7 : 240|7@1+ (1,0) [0|127] "raw" XXX
 SG_ CONST_247_1 : 247|1@1+ (1,0) [0|1] "raw" XXX
 SG_ UNK_248_7 : 248|7@1+ (1,0) [0|127] "raw" XXX
 SG_ CONST_255_1 : 255|1@1+ (1,0) [0|1] "raw" XXX
 SG_ UNK_256_8 : 256|8@1+ (1,0) [0|255] "raw" XXX
 SG_ UNK_264_8 : 264|8@1+ (1,0) [0|255] "raw" XXX
 SG_ UNK_272_5 : 272|5@1+ (1,0) [0|31] "raw" XXX
 SG_ UNK_277_11 : 277|11@1+ (1,0) [0|2047] "raw" XXX

BO_ 1798 ARS510_OBJ_06: 48 RADAR
 SG_ STATE_CODE : 0|2@1+ (1,0) [0|3] "raw" XXX
 SG_ SLOT_INDEX_CODE : 2|6@1+ (1,0) [0|63] "raw" XXX
 SG_ UNK_8_6 : 8|6@1+ (1,0) [0|63] "raw" XXX
 SG_ ONCOMING_FLAG : 14|1@1+ (1,0) [0|1] "" XXX
 SG_ UNK_15_1 : 15|1@1+ (1,0) [0|1] "raw" XXX
 SG_ SCORE_CODE : 16|8@1+ (1,0) [0|255] "raw" XXX
 SG_ AGE : 24|7@1+ (1,0) [0|126] "cycles" XXX
 SG_ CONST_31_1 : 31|1@1+ (1,0) [0|1] "raw" XXX
 SG_ DREL : 32|12@1+ (0.0625,-10) [-10|245.9375] "m" XXX
 SG_ YREL_LEFT : 44|12@1+ (0.015,-30.72) [-30.72|30.705] "m" XXX
 SG_ UNK_56_7 : 56|7@1+ (1,0) [0|127] "raw" XXX
 SG_ UNK_63_1 : 63|1@1+ (1,0) [0|1] "raw" XXX
 SG_ VLONG_OVER_GROUND : 64|10@1+ (0.15,-76.575) [-76.575|76.875] "m/s" XXX
 SG_ VLAT_OVER_GROUND_PROV : 74|10@1+ (0.15,-76.575) [-76.575|76.875] "m/s" XXX
 SG_ ALONG_LIKE_84 : 84|10@1+ (1,-511) [-511|512] "code" XXX
 SG_ CONST_94_2 : 94|2@1+ (1,0) [0|3] "raw" XXX
 SG_ UNK_96 : 96|10@1+ (1,0) [0|1023] "raw" XXX
 SG_ UNK_106_1 : 106|1@1+ (1,0) [0|1] "raw" XXX
 SG_ UNK_107_1 : 107|1@1+ (1,0) [0|1] "raw" XXX
 SG_ CONST_108_1 : 108|1@1+ (1,0) [0|1] "raw" XXX
 SG_ MOVE_STATE : 109|2@1+ (1,0) [0|3] "" XXX
 SG_ UNK_111_1 : 111|1@1+ (1,0) [0|1] "raw" XXX
 SG_ UNK_112_3 : 112|3@1+ (1,0) [0|7] "raw" XXX
 SG_ UNK_115_5 : 115|5@1+ (1,0) [0|31] "raw" XXX
 SG_ UNK_120_3 : 120|3@1+ (1,0) [0|7] "raw" XXX
 SG_ CONST_123_5 : 123|5@1+ (1,0) [0|31] "raw" XXX
 SG_ UNK_128_2 : 128|2@1+ (1,0) [0|3] "raw" XXX
 SG_ UNK_130_1 : 130|1@1+ (1,0) [0|1] "raw" XXX
 SG_ UNK_131_4 : 131|4@1+ (1,0) [0|15] "raw" XXX
 SG_ CONST_135_1 : 135|1@1+ (1,0) [0|1] "raw" XXX
 SG_ UNK_136_4 : 136|4@1+ (1,0) [0|15] "raw" XXX
 SG_ UNK_140_3 : 140|3@1+ (1,0) [0|7] "raw" XXX
 SG_ CONST_143_5 : 143|5@1+ (1,0) [0|31] "raw" XXX
 SG_ UNK_148_8 : 148|8@1+ (1,0) [0|255] "raw" XXX
 SG_ UNK_156_4 : 156|4@1+ (1,0) [0|15] "raw" XXX
 SG_ CONST_160_3 : 160|3@1+ (1,0) [0|7] "raw" XXX
 SG_ UNK_163_3 : 163|3@1+ (1,0) [0|7] "raw" XXX
 SG_ UNK_166_2 : 166|2@1+ (1,0) [0|3] "raw" XXX
 SG_ UNK_168_10 : 168|10@1+ (1,0) [0|1023] "raw" XXX
 SG_ CONST_178_3 : 178|3@1+ (1,0) [0|7] "raw" XXX
 SG_ UNK_181_1 : 181|1@1+ (1,0) [0|1] "raw" XXX
 SG_ UNK_182_1 : 182|1@1+ (1,0) [0|1] "raw" XXX
 SG_ UNK_183_7 : 183|7@1+ (1,0) [0|127] "raw" XXX
 SG_ UNK_190_10 : 190|10@1+ (1,0) [0|1023] "raw" XXX
 SG_ UNK_200_7 : 200|7@1+ (1,0) [0|127] "raw" XXX
 SG_ CONST_207_1 : 207|1@1+ (1,0) [0|1] "raw" XXX
 SG_ UNK_208_6 : 208|6@1+ (1,0) [0|63] "raw" XXX
 SG_ CONST_214_2 : 214|2@1+ (1,0) [0|3] "raw" XXX
 SG_ UNK_216_6 : 216|6@1+ (1,0) [0|63] "raw" XXX
 SG_ CONST_222_2 : 222|2@1+ (1,0) [0|3] "raw" XXX
 SG_ UNK_224_7 : 224|7@1+ (1,0) [0|127] "raw" XXX
 SG_ CONST_231_1 : 231|1@1+ (1,0) [0|1] "raw" XXX
 SG_ UNK_232_8 : 232|8@1+ (1,0) [0|255] "raw" XXX
 SG_ UNK_240_7 : 240|7@1+ (1,0) [0|127] "raw" XXX
 SG_ CONST_247_1 : 247|1@1+ (1,0) [0|1] "raw" XXX
 SG_ UNK_248_7 : 248|7@1+ (1,0) [0|127] "raw" XXX
 SG_ CONST_255_1 : 255|1@1+ (1,0) [0|1] "raw" XXX
 SG_ UNK_256_8 : 256|8@1+ (1,0) [0|255] "raw" XXX
 SG_ UNK_264_8 : 264|8@1+ (1,0) [0|255] "raw" XXX
 SG_ UNK_272_5 : 272|5@1+ (1,0) [0|31] "raw" XXX
 SG_ UNK_277_11 : 277|11@1+ (1,0) [0|2047] "raw" XXX

BO_ 1799 ARS510_OBJ_07: 48 RADAR
 SG_ STATE_CODE : 0|2@1+ (1,0) [0|3] "raw" XXX
 SG_ SLOT_INDEX_CODE : 2|6@1+ (1,0) [0|63] "raw" XXX
 SG_ UNK_8_6 : 8|6@1+ (1,0) [0|63] "raw" XXX
 SG_ ONCOMING_FLAG : 14|1@1+ (1,0) [0|1] "" XXX
 SG_ UNK_15_1 : 15|1@1+ (1,0) [0|1] "raw" XXX
 SG_ SCORE_CODE : 16|8@1+ (1,0) [0|255] "raw" XXX
 SG_ AGE : 24|7@1+ (1,0) [0|126] "cycles" XXX
 SG_ CONST_31_1 : 31|1@1+ (1,0) [0|1] "raw" XXX
 SG_ DREL : 32|12@1+ (0.0625,-10) [-10|245.9375] "m" XXX
 SG_ YREL_LEFT : 44|12@1+ (0.015,-30.72) [-30.72|30.705] "m" XXX
 SG_ UNK_56_7 : 56|7@1+ (1,0) [0|127] "raw" XXX
 SG_ UNK_63_1 : 63|1@1+ (1,0) [0|1] "raw" XXX
 SG_ VLONG_OVER_GROUND : 64|10@1+ (0.15,-76.575) [-76.575|76.875] "m/s" XXX
 SG_ VLAT_OVER_GROUND_PROV : 74|10@1+ (0.15,-76.575) [-76.575|76.875] "m/s" XXX
 SG_ ALONG_LIKE_84 : 84|10@1+ (1,-511) [-511|512] "code" XXX
 SG_ CONST_94_2 : 94|2@1+ (1,0) [0|3] "raw" XXX
 SG_ UNK_96 : 96|10@1+ (1,0) [0|1023] "raw" XXX
 SG_ UNK_106_1 : 106|1@1+ (1,0) [0|1] "raw" XXX
 SG_ UNK_107_1 : 107|1@1+ (1,0) [0|1] "raw" XXX
 SG_ CONST_108_1 : 108|1@1+ (1,0) [0|1] "raw" XXX
 SG_ MOVE_STATE : 109|2@1+ (1,0) [0|3] "" XXX
 SG_ UNK_111_1 : 111|1@1+ (1,0) [0|1] "raw" XXX
 SG_ UNK_112_3 : 112|3@1+ (1,0) [0|7] "raw" XXX
 SG_ UNK_115_5 : 115|5@1+ (1,0) [0|31] "raw" XXX
 SG_ UNK_120_3 : 120|3@1+ (1,0) [0|7] "raw" XXX
 SG_ CONST_123_5 : 123|5@1+ (1,0) [0|31] "raw" XXX
 SG_ UNK_128_2 : 128|2@1+ (1,0) [0|3] "raw" XXX
 SG_ UNK_130_1 : 130|1@1+ (1,0) [0|1] "raw" XXX
 SG_ UNK_131_4 : 131|4@1+ (1,0) [0|15] "raw" XXX
 SG_ CONST_135_1 : 135|1@1+ (1,0) [0|1] "raw" XXX
 SG_ UNK_136_4 : 136|4@1+ (1,0) [0|15] "raw" XXX
 SG_ UNK_140_3 : 140|3@1+ (1,0) [0|7] "raw" XXX
 SG_ CONST_143_5 : 143|5@1+ (1,0) [0|31] "raw" XXX
 SG_ UNK_148_8 : 148|8@1+ (1,0) [0|255] "raw" XXX
 SG_ UNK_156_4 : 156|4@1+ (1,0) [0|15] "raw" XXX
 SG_ CONST_160_3 : 160|3@1+ (1,0) [0|7] "raw" XXX
 SG_ UNK_163_3 : 163|3@1+ (1,0) [0|7] "raw" XXX
 SG_ UNK_166_2 : 166|2@1+ (1,0) [0|3] "raw" XXX
 SG_ UNK_168_10 : 168|10@1+ (1,0) [0|1023] "raw" XXX
 SG_ CONST_178_3 : 178|3@1+ (1,0) [0|7] "raw" XXX
 SG_ UNK_181_1 : 181|1@1+ (1,0) [0|1] "raw" XXX
 SG_ UNK_182_1 : 182|1@1+ (1,0) [0|1] "raw" XXX
 SG_ UNK_183_7 : 183|7@1+ (1,0) [0|127] "raw" XXX
 SG_ UNK_190_10 : 190|10@1+ (1,0) [0|1023] "raw" XXX
 SG_ UNK_200_7 : 200|7@1+ (1,0) [0|127] "raw" XXX
 SG_ CONST_207_1 : 207|1@1+ (1,0) [0|1] "raw" XXX
 SG_ UNK_208_6 : 208|6@1+ (1,0) [0|63] "raw" XXX
 SG_ CONST_214_2 : 214|2@1+ (1,0) [0|3] "raw" XXX
 SG_ UNK_216_6 : 216|6@1+ (1,0) [0|63] "raw" XXX
 SG_ CONST_222_2 : 222|2@1+ (1,0) [0|3] "raw" XXX
 SG_ UNK_224_7 : 224|7@1+ (1,0) [0|127] "raw" XXX
 SG_ CONST_231_1 : 231|1@1+ (1,0) [0|1] "raw" XXX
 SG_ UNK_232_8 : 232|8@1+ (1,0) [0|255] "raw" XXX
 SG_ UNK_240_7 : 240|7@1+ (1,0) [0|127] "raw" XXX
 SG_ CONST_247_1 : 247|1@1+ (1,0) [0|1] "raw" XXX
 SG_ UNK_248_7 : 248|7@1+ (1,0) [0|127] "raw" XXX
 SG_ CONST_255_1 : 255|1@1+ (1,0) [0|1] "raw" XXX
 SG_ UNK_256_8 : 256|8@1+ (1,0) [0|255] "raw" XXX
 SG_ UNK_264_8 : 264|8@1+ (1,0) [0|255] "raw" XXX
 SG_ UNK_272_5 : 272|5@1+ (1,0) [0|31] "raw" XXX
 SG_ UNK_277_11 : 277|11@1+ (1,0) [0|2047] "raw" XXX

BO_ 1800 ARS510_OBJ_08: 48 RADAR
 SG_ STATE_CODE : 0|2@1+ (1,0) [0|3] "raw" XXX
 SG_ SLOT_INDEX_CODE : 2|6@1+ (1,0) [0|63] "raw" XXX
 SG_ UNK_8_6 : 8|6@1+ (1,0) [0|63] "raw" XXX
 SG_ ONCOMING_FLAG : 14|1@1+ (1,0) [0|1] "" XXX
 SG_ UNK_15_1 : 15|1@1+ (1,0) [0|1] "raw" XXX
 SG_ SCORE_CODE : 16|8@1+ (1,0) [0|255] "raw" XXX
 SG_ AGE : 24|7@1+ (1,0) [0|126] "cycles" XXX
 SG_ CONST_31_1 : 31|1@1+ (1,0) [0|1] "raw" XXX
 SG_ DREL : 32|12@1+ (0.0625,-10) [-10|245.9375] "m" XXX
 SG_ YREL_LEFT : 44|12@1+ (0.015,-30.72) [-30.72|30.705] "m" XXX
 SG_ UNK_56_7 : 56|7@1+ (1,0) [0|127] "raw" XXX
 SG_ UNK_63_1 : 63|1@1+ (1,0) [0|1] "raw" XXX
 SG_ VLONG_OVER_GROUND : 64|10@1+ (0.15,-76.575) [-76.575|76.875] "m/s" XXX
 SG_ VLAT_OVER_GROUND_PROV : 74|10@1+ (0.15,-76.575) [-76.575|76.875] "m/s" XXX
 SG_ ALONG_LIKE_84 : 84|10@1+ (1,-511) [-511|512] "code" XXX
 SG_ CONST_94_2 : 94|2@1+ (1,0) [0|3] "raw" XXX
 SG_ UNK_96 : 96|10@1+ (1,0) [0|1023] "raw" XXX
 SG_ UNK_106_1 : 106|1@1+ (1,0) [0|1] "raw" XXX
 SG_ UNK_107_1 : 107|1@1+ (1,0) [0|1] "raw" XXX
 SG_ CONST_108_1 : 108|1@1+ (1,0) [0|1] "raw" XXX
 SG_ MOVE_STATE : 109|2@1+ (1,0) [0|3] "" XXX
 SG_ UNK_111_1 : 111|1@1+ (1,0) [0|1] "raw" XXX
 SG_ UNK_112_3 : 112|3@1+ (1,0) [0|7] "raw" XXX
 SG_ UNK_115_5 : 115|5@1+ (1,0) [0|31] "raw" XXX
 SG_ UNK_120_3 : 120|3@1+ (1,0) [0|7] "raw" XXX
 SG_ CONST_123_5 : 123|5@1+ (1,0) [0|31] "raw" XXX
 SG_ UNK_128_2 : 128|2@1+ (1,0) [0|3] "raw" XXX
 SG_ UNK_130_1 : 130|1@1+ (1,0) [0|1] "raw" XXX
 SG_ UNK_131_4 : 131|4@1+ (1,0) [0|15] "raw" XXX
 SG_ CONST_135_1 : 135|1@1+ (1,0) [0|1] "raw" XXX
 SG_ UNK_136_4 : 136|4@1+ (1,0) [0|15] "raw" XXX
 SG_ UNK_140_3 : 140|3@1+ (1,0) [0|7] "raw" XXX
 SG_ CONST_143_5 : 143|5@1+ (1,0) [0|31] "raw" XXX
 SG_ UNK_148_8 : 148|8@1+ (1,0) [0|255] "raw" XXX
 SG_ UNK_156_4 : 156|4@1+ (1,0) [0|15] "raw" XXX
 SG_ CONST_160_3 : 160|3@1+ (1,0) [0|7] "raw" XXX
 SG_ UNK_163_3 : 163|3@1+ (1,0) [0|7] "raw" XXX
 SG_ UNK_166_2 : 166|2@1+ (1,0) [0|3] "raw" XXX
 SG_ UNK_168_10 : 168|10@1+ (1,0) [0|1023] "raw" XXX
 SG_ CONST_178_3 : 178|3@1+ (1,0) [0|7] "raw" XXX
 SG_ UNK_181_1 : 181|1@1+ (1,0) [0|1] "raw" XXX
 SG_ UNK_182_1 : 182|1@1+ (1,0) [0|1] "raw" XXX
 SG_ UNK_183_7 : 183|7@1+ (1,0) [0|127] "raw" XXX
 SG_ UNK_190_10 : 190|10@1+ (1,0) [0|1023] "raw" XXX
 SG_ UNK_200_7 : 200|7@1+ (1,0) [0|127] "raw" XXX
 SG_ CONST_207_1 : 207|1@1+ (1,0) [0|1] "raw" XXX
 SG_ UNK_208_6 : 208|6@1+ (1,0) [0|63] "raw" XXX
 SG_ CONST_214_2 : 214|2@1+ (1,0) [0|3] "raw" XXX
 SG_ UNK_216_6 : 216|6@1+ (1,0) [0|63] "raw" XXX
 SG_ CONST_222_2 : 222|2@1+ (1,0) [0|3] "raw" XXX
 SG_ UNK_224_7 : 224|7@1+ (1,0) [0|127] "raw" XXX
 SG_ CONST_231_1 : 231|1@1+ (1,0) [0|1] "raw" XXX
 SG_ UNK_232_8 : 232|8@1+ (1,0) [0|255] "raw" XXX
 SG_ UNK_240_7 : 240|7@1+ (1,0) [0|127] "raw" XXX
 SG_ CONST_247_1 : 247|1@1+ (1,0) [0|1] "raw" XXX
 SG_ UNK_248_7 : 248|7@1+ (1,0) [0|127] "raw" XXX
 SG_ CONST_255_1 : 255|1@1+ (1,0) [0|1] "raw" XXX
 SG_ UNK_256_8 : 256|8@1+ (1,0) [0|255] "raw" XXX
 SG_ UNK_264_8 : 264|8@1+ (1,0) [0|255] "raw" XXX
 SG_ UNK_272_5 : 272|5@1+ (1,0) [0|31] "raw" XXX
 SG_ UNK_277_11 : 277|11@1+ (1,0) [0|2047] "raw" XXX

BO_ 1801 ARS510_OBJ_09: 48 RADAR
 SG_ STATE_CODE : 0|2@1+ (1,0) [0|3] "raw" XXX
 SG_ SLOT_INDEX_CODE : 2|6@1+ (1,0) [0|63] "raw" XXX
 SG_ UNK_8_6 : 8|6@1+ (1,0) [0|63] "raw" XXX
 SG_ ONCOMING_FLAG : 14|1@1+ (1,0) [0|1] "" XXX
 SG_ UNK_15_1 : 15|1@1+ (1,0) [0|1] "raw" XXX
 SG_ SCORE_CODE : 16|8@1+ (1,0) [0|255] "raw" XXX
 SG_ AGE : 24|7@1+ (1,0) [0|126] "cycles" XXX
 SG_ CONST_31_1 : 31|1@1+ (1,0) [0|1] "raw" XXX
 SG_ DREL : 32|12@1+ (0.0625,-10) [-10|245.9375] "m" XXX
 SG_ YREL_LEFT : 44|12@1+ (0.015,-30.72) [-30.72|30.705] "m" XXX
 SG_ UNK_56_7 : 56|7@1+ (1,0) [0|127] "raw" XXX
 SG_ UNK_63_1 : 63|1@1+ (1,0) [0|1] "raw" XXX
 SG_ VLONG_OVER_GROUND : 64|10@1+ (0.15,-76.575) [-76.575|76.875] "m/s" XXX
 SG_ VLAT_OVER_GROUND_PROV : 74|10@1+ (0.15,-76.575) [-76.575|76.875] "m/s" XXX
 SG_ ALONG_LIKE_84 : 84|10@1+ (1,-511) [-511|512] "code" XXX
 SG_ CONST_94_2 : 94|2@1+ (1,0) [0|3] "raw" XXX
 SG_ UNK_96 : 96|10@1+ (1,0) [0|1023] "raw" XXX
 SG_ UNK_106_1 : 106|1@1+ (1,0) [0|1] "raw" XXX
 SG_ UNK_107_1 : 107|1@1+ (1,0) [0|1] "raw" XXX
 SG_ CONST_108_1 : 108|1@1+ (1,0) [0|1] "raw" XXX
 SG_ MOVE_STATE : 109|2@1+ (1,0) [0|3] "" XXX
 SG_ UNK_111_1 : 111|1@1+ (1,0) [0|1] "raw" XXX
 SG_ UNK_112_3 : 112|3@1+ (1,0) [0|7] "raw" XXX
 SG_ UNK_115_5 : 115|5@1+ (1,0) [0|31] "raw" XXX
 SG_ UNK_120_3 : 120|3@1+ (1,0) [0|7] "raw" XXX
 SG_ CONST_123_5 : 123|5@1+ (1,0) [0|31] "raw" XXX
 SG_ UNK_128_2 : 128|2@1+ (1,0) [0|3] "raw" XXX
 SG_ UNK_130_1 : 130|1@1+ (1,0) [0|1] "raw" XXX
 SG_ UNK_131_4 : 131|4@1+ (1,0) [0|15] "raw" XXX
 SG_ CONST_135_1 : 135|1@1+ (1,0) [0|1] "raw" XXX
 SG_ UNK_136_4 : 136|4@1+ (1,0) [0|15] "raw" XXX
 SG_ UNK_140_3 : 140|3@1+ (1,0) [0|7] "raw" XXX
 SG_ CONST_143_5 : 143|5@1+ (1,0) [0|31] "raw" XXX
 SG_ UNK_148_8 : 148|8@1+ (1,0) [0|255] "raw" XXX
 SG_ UNK_156_4 : 156|4@1+ (1,0) [0|15] "raw" XXX
 SG_ CONST_160_3 : 160|3@1+ (1,0) [0|7] "raw" XXX
 SG_ UNK_163_3 : 163|3@1+ (1,0) [0|7] "raw" XXX
 SG_ UNK_166_2 : 166|2@1+ (1,0) [0|3] "raw" XXX
 SG_ UNK_168_10 : 168|10@1+ (1,0) [0|1023] "raw" XXX
 SG_ CONST_178_3 : 178|3@1+ (1,0) [0|7] "raw" XXX
 SG_ UNK_181_1 : 181|1@1+ (1,0) [0|1] "raw" XXX
 SG_ UNK_182_1 : 182|1@1+ (1,0) [0|1] "raw" XXX
 SG_ UNK_183_7 : 183|7@1+ (1,0) [0|127] "raw" XXX
 SG_ UNK_190_10 : 190|10@1+ (1,0) [0|1023] "raw" XXX
 SG_ UNK_200_7 : 200|7@1+ (1,0) [0|127] "raw" XXX
 SG_ CONST_207_1 : 207|1@1+ (1,0) [0|1] "raw" XXX
 SG_ UNK_208_6 : 208|6@1+ (1,0) [0|63] "raw" XXX
 SG_ CONST_214_2 : 214|2@1+ (1,0) [0|3] "raw" XXX
 SG_ UNK_216_6 : 216|6@1+ (1,0) [0|63] "raw" XXX
 SG_ CONST_222_2 : 222|2@1+ (1,0) [0|3] "raw" XXX
 SG_ UNK_224_7 : 224|7@1+ (1,0) [0|127] "raw" XXX
 SG_ CONST_231_1 : 231|1@1+ (1,0) [0|1] "raw" XXX
 SG_ UNK_232_8 : 232|8@1+ (1,0) [0|255] "raw" XXX
 SG_ UNK_240_7 : 240|7@1+ (1,0) [0|127] "raw" XXX
 SG_ CONST_247_1 : 247|1@1+ (1,0) [0|1] "raw" XXX
 SG_ UNK_248_7 : 248|7@1+ (1,0) [0|127] "raw" XXX
 SG_ CONST_255_1 : 255|1@1+ (1,0) [0|1] "raw" XXX
 SG_ UNK_256_8 : 256|8@1+ (1,0) [0|255] "raw" XXX
 SG_ UNK_264_8 : 264|8@1+ (1,0) [0|255] "raw" XXX
 SG_ UNK_272_5 : 272|5@1+ (1,0) [0|31] "raw" XXX
 SG_ UNK_277_11 : 277|11@1+ (1,0) [0|2047] "raw" XXX

BO_ 1802 ARS510_OBJ_10: 48 RADAR
 SG_ STATE_CODE : 0|2@1+ (1,0) [0|3] "raw" XXX
 SG_ SLOT_INDEX_CODE : 2|6@1+ (1,0) [0|63] "raw" XXX
 SG_ UNK_8_6 : 8|6@1+ (1,0) [0|63] "raw" XXX
 SG_ ONCOMING_FLAG : 14|1@1+ (1,0) [0|1] "" XXX
 SG_ UNK_15_1 : 15|1@1+ (1,0) [0|1] "raw" XXX
 SG_ SCORE_CODE : 16|8@1+ (1,0) [0|255] "raw" XXX
 SG_ AGE : 24|7@1+ (1,0) [0|126] "cycles" XXX
 SG_ CONST_31_1 : 31|1@1+ (1,0) [0|1] "raw" XXX
 SG_ DREL : 32|12@1+ (0.0625,-10) [-10|245.9375] "m" XXX
 SG_ YREL_LEFT : 44|12@1+ (0.015,-30.72) [-30.72|30.705] "m" XXX
 SG_ UNK_56_7 : 56|7@1+ (1,0) [0|127] "raw" XXX
 SG_ UNK_63_1 : 63|1@1+ (1,0) [0|1] "raw" XXX
 SG_ VLONG_OVER_GROUND : 64|10@1+ (0.15,-76.575) [-76.575|76.875] "m/s" XXX
 SG_ VLAT_OVER_GROUND_PROV : 74|10@1+ (0.15,-76.575) [-76.575|76.875] "m/s" XXX
 SG_ ALONG_LIKE_84 : 84|10@1+ (1,-511) [-511|512] "code" XXX
 SG_ CONST_94_2 : 94|2@1+ (1,0) [0|3] "raw" XXX
 SG_ UNK_96 : 96|10@1+ (1,0) [0|1023] "raw" XXX
 SG_ UNK_106_1 : 106|1@1+ (1,0) [0|1] "raw" XXX
 SG_ UNK_107_1 : 107|1@1+ (1,0) [0|1] "raw" XXX
 SG_ CONST_108_1 : 108|1@1+ (1,0) [0|1] "raw" XXX
 SG_ MOVE_STATE : 109|2@1+ (1,0) [0|3] "" XXX
 SG_ UNK_111_1 : 111|1@1+ (1,0) [0|1] "raw" XXX
 SG_ UNK_112_3 : 112|3@1+ (1,0) [0|7] "raw" XXX
 SG_ UNK_115_5 : 115|5@1+ (1,0) [0|31] "raw" XXX
 SG_ UNK_120_3 : 120|3@1+ (1,0) [0|7] "raw" XXX
 SG_ CONST_123_5 : 123|5@1+ (1,0) [0|31] "raw" XXX
 SG_ UNK_128_2 : 128|2@1+ (1,0) [0|3] "raw" XXX
 SG_ UNK_130_1 : 130|1@1+ (1,0) [0|1] "raw" XXX
 SG_ UNK_131_4 : 131|4@1+ (1,0) [0|15] "raw" XXX
 SG_ CONST_135_1 : 135|1@1+ (1,0) [0|1] "raw" XXX
 SG_ UNK_136_4 : 136|4@1+ (1,0) [0|15] "raw" XXX
 SG_ UNK_140_3 : 140|3@1+ (1,0) [0|7] "raw" XXX
 SG_ CONST_143_5 : 143|5@1+ (1,0) [0|31] "raw" XXX
 SG_ UNK_148_8 : 148|8@1+ (1,0) [0|255] "raw" XXX
 SG_ UNK_156_4 : 156|4@1+ (1,0) [0|15] "raw" XXX
 SG_ CONST_160_3 : 160|3@1+ (1,0) [0|7] "raw" XXX
 SG_ UNK_163_3 : 163|3@1+ (1,0) [0|7] "raw" XXX
 SG_ UNK_166_2 : 166|2@1+ (1,0) [0|3] "raw" XXX
 SG_ UNK_168_10 : 168|10@1+ (1,0) [0|1023] "raw" XXX
 SG_ CONST_178_3 : 178|3@1+ (1,0) [0|7] "raw" XXX
 SG_ UNK_181_1 : 181|1@1+ (1,0) [0|1] "raw" XXX
 SG_ UNK_182_1 : 182|1@1+ (1,0) [0|1] "raw" XXX
 SG_ UNK_183_7 : 183|7@1+ (1,0) [0|127] "raw" XXX
 SG_ UNK_190_10 : 190|10@1+ (1,0) [0|1023] "raw" XXX
 SG_ UNK_200_7 : 200|7@1+ (1,0) [0|127] "raw" XXX
 SG_ CONST_207_1 : 207|1@1+ (1,0) [0|1] "raw" XXX
 SG_ UNK_208_6 : 208|6@1+ (1,0) [0|63] "raw" XXX
 SG_ CONST_214_2 : 214|2@1+ (1,0) [0|3] "raw" XXX
 SG_ UNK_216_6 : 216|6@1+ (1,0) [0|63] "raw" XXX
 SG_ CONST_222_2 : 222|2@1+ (1,0) [0|3] "raw" XXX
 SG_ UNK_224_7 : 224|7@1+ (1,0) [0|127] "raw" XXX
 SG_ CONST_231_1 : 231|1@1+ (1,0) [0|1] "raw" XXX
 SG_ UNK_232_8 : 232|8@1+ (1,0) [0|255] "raw" XXX
 SG_ UNK_240_7 : 240|7@1+ (1,0) [0|127] "raw" XXX
 SG_ CONST_247_1 : 247|1@1+ (1,0) [0|1] "raw" XXX
 SG_ UNK_248_7 : 248|7@1+ (1,0) [0|127] "raw" XXX
 SG_ CONST_255_1 : 255|1@1+ (1,0) [0|1] "raw" XXX
 SG_ UNK_256_8 : 256|8@1+ (1,0) [0|255] "raw" XXX
 SG_ UNK_264_8 : 264|8@1+ (1,0) [0|255] "raw" XXX
 SG_ UNK_272_5 : 272|5@1+ (1,0) [0|31] "raw" XXX
 SG_ UNK_277_11 : 277|11@1+ (1,0) [0|2047] "raw" XXX

BO_ 1803 ARS510_OBJ_11: 48 RADAR
 SG_ STATE_CODE : 0|2@1+ (1,0) [0|3] "raw" XXX
 SG_ SLOT_INDEX_CODE : 2|6@1+ (1,0) [0|63] "raw" XXX
 SG_ UNK_8_6 : 8|6@1+ (1,0) [0|63] "raw" XXX
 SG_ ONCOMING_FLAG : 14|1@1+ (1,0) [0|1] "" XXX
 SG_ UNK_15_1 : 15|1@1+ (1,0) [0|1] "raw" XXX
 SG_ SCORE_CODE : 16|8@1+ (1,0) [0|255] "raw" XXX
 SG_ AGE : 24|7@1+ (1,0) [0|126] "cycles" XXX
 SG_ CONST_31_1 : 31|1@1+ (1,0) [0|1] "raw" XXX
 SG_ DREL : 32|12@1+ (0.0625,-10) [-10|245.9375] "m" XXX
 SG_ YREL_LEFT : 44|12@1+ (0.015,-30.72) [-30.72|30.705] "m" XXX
 SG_ UNK_56_7 : 56|7@1+ (1,0) [0|127] "raw" XXX
 SG_ UNK_63_1 : 63|1@1+ (1,0) [0|1] "raw" XXX
 SG_ VLONG_OVER_GROUND : 64|10@1+ (0.15,-76.575) [-76.575|76.875] "m/s" XXX
 SG_ VLAT_OVER_GROUND_PROV : 74|10@1+ (0.15,-76.575) [-76.575|76.875] "m/s" XXX
 SG_ ALONG_LIKE_84 : 84|10@1+ (1,-511) [-511|512] "code" XXX
 SG_ CONST_94_2 : 94|2@1+ (1,0) [0|3] "raw" XXX
 SG_ UNK_96 : 96|10@1+ (1,0) [0|1023] "raw" XXX
 SG_ UNK_106_1 : 106|1@1+ (1,0) [0|1] "raw" XXX
 SG_ UNK_107_1 : 107|1@1+ (1,0) [0|1] "raw" XXX
 SG_ CONST_108_1 : 108|1@1+ (1,0) [0|1] "raw" XXX
 SG_ MOVE_STATE : 109|2@1+ (1,0) [0|3] "" XXX
 SG_ UNK_111_1 : 111|1@1+ (1,0) [0|1] "raw" XXX
 SG_ UNK_112_3 : 112|3@1+ (1,0) [0|7] "raw" XXX
 SG_ UNK_115_5 : 115|5@1+ (1,0) [0|31] "raw" XXX
 SG_ UNK_120_3 : 120|3@1+ (1,0) [0|7] "raw" XXX
 SG_ CONST_123_5 : 123|5@1+ (1,0) [0|31] "raw" XXX
 SG_ UNK_128_2 : 128|2@1+ (1,0) [0|3] "raw" XXX
 SG_ UNK_130_1 : 130|1@1+ (1,0) [0|1] "raw" XXX
 SG_ UNK_131_4 : 131|4@1+ (1,0) [0|15] "raw" XXX
 SG_ CONST_135_1 : 135|1@1+ (1,0) [0|1] "raw" XXX
 SG_ UNK_136_4 : 136|4@1+ (1,0) [0|15] "raw" XXX
 SG_ UNK_140_3 : 140|3@1+ (1,0) [0|7] "raw" XXX
 SG_ CONST_143_5 : 143|5@1+ (1,0) [0|31] "raw" XXX
 SG_ UNK_148_8 : 148|8@1+ (1,0) [0|255] "raw" XXX
 SG_ UNK_156_4 : 156|4@1+ (1,0) [0|15] "raw" XXX
 SG_ CONST_160_3 : 160|3@1+ (1,0) [0|7] "raw" XXX
 SG_ UNK_163_3 : 163|3@1+ (1,0) [0|7] "raw" XXX
 SG_ UNK_166_2 : 166|2@1+ (1,0) [0|3] "raw" XXX
 SG_ UNK_168_10 : 168|10@1+ (1,0) [0|1023] "raw" XXX
 SG_ CONST_178_3 : 178|3@1+ (1,0) [0|7] "raw" XXX
 SG_ UNK_181_1 : 181|1@1+ (1,0) [0|1] "raw" XXX
 SG_ UNK_182_1 : 182|1@1+ (1,0) [0|1] "raw" XXX
 SG_ UNK_183_7 : 183|7@1+ (1,0) [0|127] "raw" XXX
 SG_ UNK_190_10 : 190|10@1+ (1,0) [0|1023] "raw" XXX
 SG_ UNK_200_7 : 200|7@1+ (1,0) [0|127] "raw" XXX
 SG_ CONST_207_1 : 207|1@1+ (1,0) [0|1] "raw" XXX
 SG_ UNK_208_6 : 208|6@1+ (1,0) [0|63] "raw" XXX
 SG_ CONST_214_2 : 214|2@1+ (1,0) [0|3] "raw" XXX
 SG_ UNK_216_6 : 216|6@1+ (1,0) [0|63] "raw" XXX
 SG_ CONST_222_2 : 222|2@1+ (1,0) [0|3] "raw" XXX
 SG_ UNK_224_7 : 224|7@1+ (1,0) [0|127] "raw" XXX
 SG_ CONST_231_1 : 231|1@1+ (1,0) [0|1] "raw" XXX
 SG_ UNK_232_8 : 232|8@1+ (1,0) [0|255] "raw" XXX
 SG_ UNK_240_7 : 240|7@1+ (1,0) [0|127] "raw" XXX
 SG_ CONST_247_1 : 247|1@1+ (1,0) [0|1] "raw" XXX
 SG_ UNK_248_7 : 248|7@1+ (1,0) [0|127] "raw" XXX
 SG_ CONST_255_1 : 255|1@1+ (1,0) [0|1] "raw" XXX
 SG_ UNK_256_8 : 256|8@1+ (1,0) [0|255] "raw" XXX
 SG_ UNK_264_8 : 264|8@1+ (1,0) [0|255] "raw" XXX
 SG_ UNK_272_5 : 272|5@1+ (1,0) [0|31] "raw" XXX
 SG_ UNK_277_11 : 277|11@1+ (1,0) [0|2047] "raw" XXX

BO_ 1804 ARS510_OBJ_12: 48 RADAR
 SG_ STATE_CODE : 0|2@1+ (1,0) [0|3] "raw" XXX
 SG_ SLOT_INDEX_CODE : 2|6@1+ (1,0) [0|63] "raw" XXX
 SG_ UNK_8_6 : 8|6@1+ (1,0) [0|63] "raw" XXX
 SG_ ONCOMING_FLAG : 14|1@1+ (1,0) [0|1] "" XXX
 SG_ UNK_15_1 : 15|1@1+ (1,0) [0|1] "raw" XXX
 SG_ SCORE_CODE : 16|8@1+ (1,0) [0|255] "raw" XXX
 SG_ AGE : 24|7@1+ (1,0) [0|126] "cycles" XXX
 SG_ CONST_31_1 : 31|1@1+ (1,0) [0|1] "raw" XXX
 SG_ DREL : 32|12@1+ (0.0625,-10) [-10|245.9375] "m" XXX
 SG_ YREL_LEFT : 44|12@1+ (0.015,-30.72) [-30.72|30.705] "m" XXX
 SG_ UNK_56_7 : 56|7@1+ (1,0) [0|127] "raw" XXX
 SG_ UNK_63_1 : 63|1@1+ (1,0) [0|1] "raw" XXX
 SG_ VLONG_OVER_GROUND : 64|10@1+ (0.15,-76.575) [-76.575|76.875] "m/s" XXX
 SG_ VLAT_OVER_GROUND_PROV : 74|10@1+ (0.15,-76.575) [-76.575|76.875] "m/s" XXX
 SG_ ALONG_LIKE_84 : 84|10@1+ (1,-511) [-511|512] "code" XXX
 SG_ CONST_94_2 : 94|2@1+ (1,0) [0|3] "raw" XXX
 SG_ UNK_96 : 96|10@1+ (1,0) [0|1023] "raw" XXX
 SG_ UNK_106_1 : 106|1@1+ (1,0) [0|1] "raw" XXX
 SG_ UNK_107_1 : 107|1@1+ (1,0) [0|1] "raw" XXX
 SG_ CONST_108_1 : 108|1@1+ (1,0) [0|1] "raw" XXX
 SG_ MOVE_STATE : 109|2@1+ (1,0) [0|3] "" XXX
 SG_ UNK_111_1 : 111|1@1+ (1,0) [0|1] "raw" XXX
 SG_ UNK_112_3 : 112|3@1+ (1,0) [0|7] "raw" XXX
 SG_ UNK_115_5 : 115|5@1+ (1,0) [0|31] "raw" XXX
 SG_ UNK_120_3 : 120|3@1+ (1,0) [0|7] "raw" XXX
 SG_ CONST_123_5 : 123|5@1+ (1,0) [0|31] "raw" XXX
 SG_ UNK_128_2 : 128|2@1+ (1,0) [0|3] "raw" XXX
 SG_ UNK_130_1 : 130|1@1+ (1,0) [0|1] "raw" XXX
 SG_ UNK_131_4 : 131|4@1+ (1,0) [0|15] "raw" XXX
 SG_ CONST_135_1 : 135|1@1+ (1,0) [0|1] "raw" XXX
 SG_ UNK_136_4 : 136|4@1+ (1,0) [0|15] "raw" XXX
 SG_ UNK_140_3 : 140|3@1+ (1,0) [0|7] "raw" XXX
 SG_ CONST_143_5 : 143|5@1+ (1,0) [0|31] "raw" XXX
 SG_ UNK_148_8 : 148|8@1+ (1,0) [0|255] "raw" XXX
 SG_ UNK_156_4 : 156|4@1+ (1,0) [0|15] "raw" XXX
 SG_ CONST_160_3 : 160|3@1+ (1,0) [0|7] "raw" XXX
 SG_ UNK_163_3 : 163|3@1+ (1,0) [0|7] "raw" XXX
 SG_ UNK_166_2 : 166|2@1+ (1,0) [0|3] "raw" XXX
 SG_ UNK_168_10 : 168|10@1+ (1,0) [0|1023] "raw" XXX
 SG_ CONST_178_3 : 178|3@1+ (1,0) [0|7] "raw" XXX
 SG_ UNK_181_1 : 181|1@1+ (1,0) [0|1] "raw" XXX
 SG_ UNK_182_1 : 182|1@1+ (1,0) [0|1] "raw" XXX
 SG_ UNK_183_7 : 183|7@1+ (1,0) [0|127] "raw" XXX
 SG_ UNK_190_10 : 190|10@1+ (1,0) [0|1023] "raw" XXX
 SG_ UNK_200_7 : 200|7@1+ (1,0) [0|127] "raw" XXX
 SG_ CONST_207_1 : 207|1@1+ (1,0) [0|1] "raw" XXX
 SG_ UNK_208_6 : 208|6@1+ (1,0) [0|63] "raw" XXX
 SG_ CONST_214_2 : 214|2@1+ (1,0) [0|3] "raw" XXX
 SG_ UNK_216_6 : 216|6@1+ (1,0) [0|63] "raw" XXX
 SG_ CONST_222_2 : 222|2@1+ (1,0) [0|3] "raw" XXX
 SG_ UNK_224_7 : 224|7@1+ (1,0) [0|127] "raw" XXX
 SG_ CONST_231_1 : 231|1@1+ (1,0) [0|1] "raw" XXX
 SG_ UNK_232_8 : 232|8@1+ (1,0) [0|255] "raw" XXX
 SG_ UNK_240_7 : 240|7@1+ (1,0) [0|127] "raw" XXX
 SG_ CONST_247_1 : 247|1@1+ (1,0) [0|1] "raw" XXX
 SG_ UNK_248_7 : 248|7@1+ (1,0) [0|127] "raw" XXX
 SG_ CONST_255_1 : 255|1@1+ (1,0) [0|1] "raw" XXX
 SG_ UNK_256_8 : 256|8@1+ (1,0) [0|255] "raw" XXX
 SG_ UNK_264_8 : 264|8@1+ (1,0) [0|255] "raw" XXX
 SG_ UNK_272_5 : 272|5@1+ (1,0) [0|31] "raw" XXX
 SG_ UNK_277_11 : 277|11@1+ (1,0) [0|2047] "raw" XXX

CM_ "Virtual-bus view of the ARS510 0x80 / 0x85 records. Only valid for logs produced by tools/build_cabana_route.py.";
CM_ BO_ 1792 "Reassembled 0x80 object slot 0 (record bytes 17-52), sent only when occupied. Little-endian bit field: bit 0 = LSB of slot byte 0.";
CM_ SG_ 1792 STATE_CODE "Track state: 0 deleted (the track's final age-0 record), 1 measured, 2 coasting (predicted without a new measurement). While 2, SCORE_CODE drops by 20 (or 1) per cycle.";
CM_ SG_ 1792 SLOT_INDEX_CODE "Physical slot index 0-19; 63 when the slot is unallocated.";
CM_ SG_ 1792 UNK_8_6 "Bits 8-12: startup code, min(30, floor(31 * (2/3)^max(age - 4, 0))) while the motion code is 5 (initializing). Bit 13: separate raw flag.";
CM_ SG_ 1792 ONCOMING_FLAG "Oncoming-like internal motion state. Can persist after slowing and reset before the native allocation ends.";
CM_ SG_ 1792 UNK_15_1 "Placeholder flag: set exactly on the age-1 first output whose range, lateral and size codes are placeholders.";
CM_ SG_ 1792 SCORE_CODE "Existence probability, percent (10-100): can decline in either state; drops by exactly 20 (or 1) per cycle in state 2 and may stay lowered after a return to state 1. Bits 20-22 are its bits 4-6 (score // 16). The slot is freed near 20.";
CM_ SG_ 1792 AGE "Track age in radar cycles (60 ms): 1 at birth, saturates at 126; 0 = slot retiring. A restart is a new track. Converged from about 60.";
CM_ SG_ 1792 CONST_31_1 "Constant in the captured data.";
CM_ SG_ 1792 DREL "Distance forward of the radar, m: (code - 160) / 16. Add 1.52 m (openpilot's RADAR_TO_CAMERA) for a camera-referenced distance; radard compares radar dRel with the vision distance minus 1.52 m.";
CM_ SG_ 1792 YREL_LEFT "Lateral offset, m, left positive: (code - 2048) * 0.015. |code - 2048| >= 2000 is a sentinel.";
CM_ SG_ 1792 UNK_56_7 "Object length, about 0.1 m per code: car ~4.9 m, large vehicle ~5.7 m, two-wheeler ~1.7 m, pedestrian ~0.4 m.";
CM_ SG_ 1792 UNK_63_1 "Raw, unnamed.";
CM_ SG_ 1792 VLONG_OVER_GROUND "Longitudinal velocity over ground, m/s: (code - 510.5) * 0.15. vRel = this - ego speed. Code 1023 is a saturated reading.";
CM_ SG_ 1792 VLAT_OVER_GROUND_PROV "Lateral velocity over ground, m/s, left positive: (code - 510.5) * about 0.142-0.155 (0.15 used).";
CM_ SG_ 1792 ALONG_LIKE_84 "Longitudinal acceleration over ground, filtered: (code - 510.3) * about 0.04-0.09 m/s^2 with ego stopped (estimate depends on drives and estimator); follows the track's own speed by about 0.3 s; moves by about 0.4 of ego's acceleration.";
CM_ SG_ 1792 CONST_94_2 "Constant in the captured data.";
CM_ SG_ 1792 UNK_96 "Lateral acceleration over ground, filtered: (code - 511) * 0.05 m/s^2; follows the kinematic value by about 0.5 s.";
CM_ SG_ 1792 UNK_106_1 "Raw, unnamed.";
CM_ SG_ 1792 UNK_107_1 "Predicted record (the radar's own prediction), like Tesla's Meas = 0: set on 45 % of a track's last five records, 2.6 % elsewhere.";
CM_ SG_ 1792 CONST_108_1 "Constant in the captured data.";
CM_ SG_ 1792 MOVE_STATE "Low two bits of the motion code. Full code = MOVE_STATE | (UNK_111_1 << 2): 0 moving forward, 1 slow or standing, 2 oncoming, 3 moving right, 4 moving left, 5 initializing, 7 stopped after moving.";
CM_ SG_ 1792 UNK_111_1 "Bit 2 of the motion code (see MOVE_STATE).";
CM_ SG_ 1792 UNK_112_3 "Camera-association state: 0 radar only, 1 (rarely 2-4) while the camera has the vehicle. By day non-zero on nearly all in-lane vehicles inside 40 m and almost never beyond 50 m; at night also at long range.";
CM_ SG_ 1792 UNK_115_5 "Class confidence in 5 % steps: mostly 0 while not yet classified (83 % of those rows), 4-20 otherwise (20 = 100 %); moves by one step per cycle on 95-96 % of its changes. A large vehicle is re-classified as a car when it falls to 5.";
CM_ SG_ 1792 UNK_120_3 "Raw; non-zero on 0.2 % of rows (mature cars).";
CM_ SG_ 1792 CONST_123_5 "Constant in the captured data.";
CM_ SG_ 1792 UNK_128_2 "Lane-assignment state, low bits (full = UNK_128_2 | UNK_130_1 << 2): 3 ego lane, 2 right lane, 4 left lane; 1, 5, 7 = no lane weights.";
CM_ SG_ 1792 UNK_130_1 "Lane-assignment state, bit 2 (see UNK_128_2).";
CM_ SG_ 1792 UNK_131_4 "Dominant lane weight: the largest of the three lane weights or one less (99.6 % of rows with a nonzero weight).";
CM_ SG_ 1792 CONST_135_1 "Constant in the captured data.";
CM_ SG_ 1792 UNK_136_4 "Camera-association confidence: 15 without association; restarts at 3-9 when UNK_112_3 becomes non-zero and climbs to 14.";
CM_ SG_ 1792 UNK_140_3 "Object class, second encoding of UNK_163_3: 0, 5, 7, 1, 3, 4 = class 1, 2, 3, 4, 5, 6.";
CM_ SG_ 1792 CONST_143_5 "Constant in the captured data.";
CM_ SG_ 1792 UNK_148_8 "Lane weights in 1/15 steps: low nibble (148|4) right lane, high nibble (152|4) left lane. With UNK_156_4 (ego lane) they sum to 15 or 16 whenever any is nonzero.";
CM_ SG_ 1792 UNK_156_4 "Ego-lane weight in 1/15 steps (see UNK_148_8).";
CM_ SG_ 1792 CONST_160_3 "Constant in the captured data.";
CM_ SG_ 1792 UNK_163_3 "Object class: 1 not yet classified, 2 car, 3 large vehicle, 4 pedestrian, 5 provisional (cyclist / person associations), 6 two-wheeler.";
CM_ SG_ 1792 UNK_166_2 "Raw, unnamed.";
CM_ SG_ 1792 UNK_168_10 "All ones or all zeros (768 / 832 rare): five sticky per-track latches by age mod 5; a phase latches on a cycle without a near-scan measurement, so most tracks born far out have it set from birth.";
CM_ SG_ 1792 CONST_178_3 "Constant in the captured data.";
CM_ SG_ 1792 UNK_181_1 "Daylight latch: one of five sticky per-track latches by age mod 5 (a phase latches after an existence dip); set on a quarter of mature vehicle rows by day, 2 of 59,988 night rows.";
CM_ SG_ 1792 UNK_182_1 "Raw, unnamed.";
CM_ SG_ 1792 UNK_183_7 "Bit 183: velocity re-initialisation latch (five sticky per-track latches by age mod 5); bits 184-189 are the low bits of a secondary score byte 184|8 (percent: 100 on 98 % of rows; lower mostly on young tracks, far lateral objects and stationary large vehicles / pedestrians).";
CM_ SG_ 1792 UNK_190_10 "Bits 190-191 = top of the secondary score byte 184|8; bits 192-199 are zero.";
CM_ SG_ 1792 UNK_200_7 "Orientation uncertainty: about 3.1 * UNK_248_7 / speed (m/s) on moving objects; 63 for stopped objects, 127 sentinel. Keep all seven bits.";
CM_ SG_ 1792 CONST_207_1 "Constant in the captured data.";
CM_ SG_ 1792 UNK_208_6 "Coarse heading over ground, left positive, about pi/64 rad per code: matches floor(max(atan2(vy, vx), 0) * 64 / pi) on 98 % of settled moving samples; can update while both velocity codes hold.";
CM_ SG_ 1792 CONST_214_2 "Constant in the captured data.";
CM_ SG_ 1792 UNK_216_6 "Object width, about (code + 1) * 0.1 m: car ~1.8 m, large vehicle ~2.0 m, two-wheeler ~0.7 m, pedestrian ~0.5 m.";
CM_ SG_ 1792 CONST_222_2 "Constant in the captured data.";
CM_ SG_ 1792 UNK_224_7 "Range standard deviation (sigma dRel), about 0.23 m per count (0.24 below 40 m; beyond 40 m a 4-8 m error floor dominates): grows with range, shrinks with track age.";
CM_ SG_ 1792 CONST_231_1 "Constant in the captured data.";
CM_ SG_ 1792 UNK_232_8 "Lateral standard deviation (sigma yRel), about 0.10 m per count: grows with |yRel|, shrinks with age. Eight bits: far young tracks reach 128-255 (255 = saturated).";
CM_ SG_ 1792 UNK_240_7 "Longitudinal velocity standard deviation (sigma vx), about 0.043-0.045 m/s per count against the ACC target: grows with range, higher during velocity excursions below 40 m. 127 accompanies saturated velocity.";
CM_ SG_ 1792 CONST_247_1 "Constant in the captured data.";
CM_ SG_ 1792 UNK_248_7 "Lateral velocity standard deviation (sigma vy), linear in the code: about 0.085 + 0.03 m/s per count against stationary objects, about 0.09 per count on moving leads.";
CM_ SG_ 1792 CONST_255_1 "Constant in the captured data.";
CM_ SG_ 1792 UNK_256_8 "Longitudinal-acceleration uncertainty (sigma ax candidate): grows with the spread between ALONG_LIKE_84 and the track's own speed slope (about 0.06-0.07 m/s^2 per code pooled); within a range band it grades that spread only within about 20 m.";
CM_ SG_ 1792 UNK_264_8 "Lateral-acceleration uncertainty (sigma ay candidate), covariance-like: moves with UNK_248_7 in every range band and shrinks with track age (about 11 at age 5-10, 2 from age 60).";
CM_ SG_ 1792 UNK_272_5 "Coarse length code: about round(length / 0.555 m) for vehicles (within one code on 91 %); not a length for pedestrians / two-wheelers.";
CM_ SG_ 1792 UNK_277_11 "Raw; bit 277 rarely set on newborn tracks.";
CM_ BO_ 1793 "Reassembled 0x80 object slot 1 (record bytes 53-88), sent only when occupied. Little-endian bit field: bit 0 = LSB of slot byte 0.";
CM_ SG_ 1793 STATE_CODE "Track state: 0 deleted (the track's final age-0 record), 1 measured, 2 coasting (predicted without a new measurement). While 2, SCORE_CODE drops by 20 (or 1) per cycle.";
CM_ SG_ 1793 SLOT_INDEX_CODE "Physical slot index 0-19; 63 when the slot is unallocated.";
CM_ SG_ 1793 UNK_8_6 "Bits 8-12: startup code, min(30, floor(31 * (2/3)^max(age - 4, 0))) while the motion code is 5 (initializing). Bit 13: separate raw flag.";
CM_ SG_ 1793 ONCOMING_FLAG "Oncoming-like internal motion state. Can persist after slowing and reset before the native allocation ends.";
CM_ SG_ 1793 UNK_15_1 "Placeholder flag: set exactly on the age-1 first output whose range, lateral and size codes are placeholders.";
CM_ SG_ 1793 SCORE_CODE "Existence probability, percent (10-100): can decline in either state; drops by exactly 20 (or 1) per cycle in state 2 and may stay lowered after a return to state 1. Bits 20-22 are its bits 4-6 (score // 16). The slot is freed near 20.";
CM_ SG_ 1793 AGE "Track age in radar cycles (60 ms): 1 at birth, saturates at 126; 0 = slot retiring. A restart is a new track. Converged from about 60.";
CM_ SG_ 1793 CONST_31_1 "Constant in the captured data.";
CM_ SG_ 1793 DREL "Distance forward of the radar, m: (code - 160) / 16. Add 1.52 m (openpilot's RADAR_TO_CAMERA) for a camera-referenced distance; radard compares radar dRel with the vision distance minus 1.52 m.";
CM_ SG_ 1793 YREL_LEFT "Lateral offset, m, left positive: (code - 2048) * 0.015. |code - 2048| >= 2000 is a sentinel.";
CM_ SG_ 1793 UNK_56_7 "Object length, about 0.1 m per code: car ~4.9 m, large vehicle ~5.7 m, two-wheeler ~1.7 m, pedestrian ~0.4 m.";
CM_ SG_ 1793 UNK_63_1 "Raw, unnamed.";
CM_ SG_ 1793 VLONG_OVER_GROUND "Longitudinal velocity over ground, m/s: (code - 510.5) * 0.15. vRel = this - ego speed. Code 1023 is a saturated reading.";
CM_ SG_ 1793 VLAT_OVER_GROUND_PROV "Lateral velocity over ground, m/s, left positive: (code - 510.5) * about 0.142-0.155 (0.15 used).";
CM_ SG_ 1793 ALONG_LIKE_84 "Longitudinal acceleration over ground, filtered: (code - 510.3) * about 0.04-0.09 m/s^2 with ego stopped (estimate depends on drives and estimator); follows the track's own speed by about 0.3 s; moves by about 0.4 of ego's acceleration.";
CM_ SG_ 1793 CONST_94_2 "Constant in the captured data.";
CM_ SG_ 1793 UNK_96 "Lateral acceleration over ground, filtered: (code - 511) * 0.05 m/s^2; follows the kinematic value by about 0.5 s.";
CM_ SG_ 1793 UNK_106_1 "Raw, unnamed.";
CM_ SG_ 1793 UNK_107_1 "Predicted record (the radar's own prediction), like Tesla's Meas = 0: set on 45 % of a track's last five records, 2.6 % elsewhere.";
CM_ SG_ 1793 CONST_108_1 "Constant in the captured data.";
CM_ SG_ 1793 MOVE_STATE "Low two bits of the motion code. Full code = MOVE_STATE | (UNK_111_1 << 2): 0 moving forward, 1 slow or standing, 2 oncoming, 3 moving right, 4 moving left, 5 initializing, 7 stopped after moving.";
CM_ SG_ 1793 UNK_111_1 "Bit 2 of the motion code (see MOVE_STATE).";
CM_ SG_ 1793 UNK_112_3 "Camera-association state: 0 radar only, 1 (rarely 2-4) while the camera has the vehicle. By day non-zero on nearly all in-lane vehicles inside 40 m and almost never beyond 50 m; at night also at long range.";
CM_ SG_ 1793 UNK_115_5 "Class confidence in 5 % steps: mostly 0 while not yet classified (83 % of those rows), 4-20 otherwise (20 = 100 %); moves by one step per cycle on 95-96 % of its changes. A large vehicle is re-classified as a car when it falls to 5.";
CM_ SG_ 1793 UNK_120_3 "Raw; non-zero on 0.2 % of rows (mature cars).";
CM_ SG_ 1793 CONST_123_5 "Constant in the captured data.";
CM_ SG_ 1793 UNK_128_2 "Lane-assignment state, low bits (full = UNK_128_2 | UNK_130_1 << 2): 3 ego lane, 2 right lane, 4 left lane; 1, 5, 7 = no lane weights.";
CM_ SG_ 1793 UNK_130_1 "Lane-assignment state, bit 2 (see UNK_128_2).";
CM_ SG_ 1793 UNK_131_4 "Dominant lane weight: the largest of the three lane weights or one less (99.6 % of rows with a nonzero weight).";
CM_ SG_ 1793 CONST_135_1 "Constant in the captured data.";
CM_ SG_ 1793 UNK_136_4 "Camera-association confidence: 15 without association; restarts at 3-9 when UNK_112_3 becomes non-zero and climbs to 14.";
CM_ SG_ 1793 UNK_140_3 "Object class, second encoding of UNK_163_3: 0, 5, 7, 1, 3, 4 = class 1, 2, 3, 4, 5, 6.";
CM_ SG_ 1793 CONST_143_5 "Constant in the captured data.";
CM_ SG_ 1793 UNK_148_8 "Lane weights in 1/15 steps: low nibble (148|4) right lane, high nibble (152|4) left lane. With UNK_156_4 (ego lane) they sum to 15 or 16 whenever any is nonzero.";
CM_ SG_ 1793 UNK_156_4 "Ego-lane weight in 1/15 steps (see UNK_148_8).";
CM_ SG_ 1793 CONST_160_3 "Constant in the captured data.";
CM_ SG_ 1793 UNK_163_3 "Object class: 1 not yet classified, 2 car, 3 large vehicle, 4 pedestrian, 5 provisional (cyclist / person associations), 6 two-wheeler.";
CM_ SG_ 1793 UNK_166_2 "Raw, unnamed.";
CM_ SG_ 1793 UNK_168_10 "All ones or all zeros (768 / 832 rare): five sticky per-track latches by age mod 5; a phase latches on a cycle without a near-scan measurement, so most tracks born far out have it set from birth.";
CM_ SG_ 1793 CONST_178_3 "Constant in the captured data.";
CM_ SG_ 1793 UNK_181_1 "Daylight latch: one of five sticky per-track latches by age mod 5 (a phase latches after an existence dip); set on a quarter of mature vehicle rows by day, 2 of 59,988 night rows.";
CM_ SG_ 1793 UNK_182_1 "Raw, unnamed.";
CM_ SG_ 1793 UNK_183_7 "Bit 183: velocity re-initialisation latch (five sticky per-track latches by age mod 5); bits 184-189 are the low bits of a secondary score byte 184|8 (percent: 100 on 98 % of rows; lower mostly on young tracks, far lateral objects and stationary large vehicles / pedestrians).";
CM_ SG_ 1793 UNK_190_10 "Bits 190-191 = top of the secondary score byte 184|8; bits 192-199 are zero.";
CM_ SG_ 1793 UNK_200_7 "Orientation uncertainty: about 3.1 * UNK_248_7 / speed (m/s) on moving objects; 63 for stopped objects, 127 sentinel. Keep all seven bits.";
CM_ SG_ 1793 CONST_207_1 "Constant in the captured data.";
CM_ SG_ 1793 UNK_208_6 "Coarse heading over ground, left positive, about pi/64 rad per code: matches floor(max(atan2(vy, vx), 0) * 64 / pi) on 98 % of settled moving samples; can update while both velocity codes hold.";
CM_ SG_ 1793 CONST_214_2 "Constant in the captured data.";
CM_ SG_ 1793 UNK_216_6 "Object width, about (code + 1) * 0.1 m: car ~1.8 m, large vehicle ~2.0 m, two-wheeler ~0.7 m, pedestrian ~0.5 m.";
CM_ SG_ 1793 CONST_222_2 "Constant in the captured data.";
CM_ SG_ 1793 UNK_224_7 "Range standard deviation (sigma dRel), about 0.23 m per count (0.24 below 40 m; beyond 40 m a 4-8 m error floor dominates): grows with range, shrinks with track age.";
CM_ SG_ 1793 CONST_231_1 "Constant in the captured data.";
CM_ SG_ 1793 UNK_232_8 "Lateral standard deviation (sigma yRel), about 0.10 m per count: grows with |yRel|, shrinks with age. Eight bits: far young tracks reach 128-255 (255 = saturated).";
CM_ SG_ 1793 UNK_240_7 "Longitudinal velocity standard deviation (sigma vx), about 0.043-0.045 m/s per count against the ACC target: grows with range, higher during velocity excursions below 40 m. 127 accompanies saturated velocity.";
CM_ SG_ 1793 CONST_247_1 "Constant in the captured data.";
CM_ SG_ 1793 UNK_248_7 "Lateral velocity standard deviation (sigma vy), linear in the code: about 0.085 + 0.03 m/s per count against stationary objects, about 0.09 per count on moving leads.";
CM_ SG_ 1793 CONST_255_1 "Constant in the captured data.";
CM_ SG_ 1793 UNK_256_8 "Longitudinal-acceleration uncertainty (sigma ax candidate): grows with the spread between ALONG_LIKE_84 and the track's own speed slope (about 0.06-0.07 m/s^2 per code pooled); within a range band it grades that spread only within about 20 m.";
CM_ SG_ 1793 UNK_264_8 "Lateral-acceleration uncertainty (sigma ay candidate), covariance-like: moves with UNK_248_7 in every range band and shrinks with track age (about 11 at age 5-10, 2 from age 60).";
CM_ SG_ 1793 UNK_272_5 "Coarse length code: about round(length / 0.555 m) for vehicles (within one code on 91 %); not a length for pedestrians / two-wheelers.";
CM_ SG_ 1793 UNK_277_11 "Raw; bit 277 rarely set on newborn tracks.";
CM_ BO_ 1794 "Reassembled 0x80 object slot 2 (record bytes 89-124), sent only when occupied. Little-endian bit field: bit 0 = LSB of slot byte 0.";
CM_ SG_ 1794 STATE_CODE "Track state: 0 deleted (the track's final age-0 record), 1 measured, 2 coasting (predicted without a new measurement). While 2, SCORE_CODE drops by 20 (or 1) per cycle.";
CM_ SG_ 1794 SLOT_INDEX_CODE "Physical slot index 0-19; 63 when the slot is unallocated.";
CM_ SG_ 1794 UNK_8_6 "Bits 8-12: startup code, min(30, floor(31 * (2/3)^max(age - 4, 0))) while the motion code is 5 (initializing). Bit 13: separate raw flag.";
CM_ SG_ 1794 ONCOMING_FLAG "Oncoming-like internal motion state. Can persist after slowing and reset before the native allocation ends.";
CM_ SG_ 1794 UNK_15_1 "Placeholder flag: set exactly on the age-1 first output whose range, lateral and size codes are placeholders.";
CM_ SG_ 1794 SCORE_CODE "Existence probability, percent (10-100): can decline in either state; drops by exactly 20 (or 1) per cycle in state 2 and may stay lowered after a return to state 1. Bits 20-22 are its bits 4-6 (score // 16). The slot is freed near 20.";
CM_ SG_ 1794 AGE "Track age in radar cycles (60 ms): 1 at birth, saturates at 126; 0 = slot retiring. A restart is a new track. Converged from about 60.";
CM_ SG_ 1794 CONST_31_1 "Constant in the captured data.";
CM_ SG_ 1794 DREL "Distance forward of the radar, m: (code - 160) / 16. Add 1.52 m (openpilot's RADAR_TO_CAMERA) for a camera-referenced distance; radard compares radar dRel with the vision distance minus 1.52 m.";
CM_ SG_ 1794 YREL_LEFT "Lateral offset, m, left positive: (code - 2048) * 0.015. |code - 2048| >= 2000 is a sentinel.";
CM_ SG_ 1794 UNK_56_7 "Object length, about 0.1 m per code: car ~4.9 m, large vehicle ~5.7 m, two-wheeler ~1.7 m, pedestrian ~0.4 m.";
CM_ SG_ 1794 UNK_63_1 "Raw, unnamed.";
CM_ SG_ 1794 VLONG_OVER_GROUND "Longitudinal velocity over ground, m/s: (code - 510.5) * 0.15. vRel = this - ego speed. Code 1023 is a saturated reading.";
CM_ SG_ 1794 VLAT_OVER_GROUND_PROV "Lateral velocity over ground, m/s, left positive: (code - 510.5) * about 0.142-0.155 (0.15 used).";
CM_ SG_ 1794 ALONG_LIKE_84 "Longitudinal acceleration over ground, filtered: (code - 510.3) * about 0.04-0.09 m/s^2 with ego stopped (estimate depends on drives and estimator); follows the track's own speed by about 0.3 s; moves by about 0.4 of ego's acceleration.";
CM_ SG_ 1794 CONST_94_2 "Constant in the captured data.";
CM_ SG_ 1794 UNK_96 "Lateral acceleration over ground, filtered: (code - 511) * 0.05 m/s^2; follows the kinematic value by about 0.5 s.";
CM_ SG_ 1794 UNK_106_1 "Raw, unnamed.";
CM_ SG_ 1794 UNK_107_1 "Predicted record (the radar's own prediction), like Tesla's Meas = 0: set on 45 % of a track's last five records, 2.6 % elsewhere.";
CM_ SG_ 1794 CONST_108_1 "Constant in the captured data.";
CM_ SG_ 1794 MOVE_STATE "Low two bits of the motion code. Full code = MOVE_STATE | (UNK_111_1 << 2): 0 moving forward, 1 slow or standing, 2 oncoming, 3 moving right, 4 moving left, 5 initializing, 7 stopped after moving.";
CM_ SG_ 1794 UNK_111_1 "Bit 2 of the motion code (see MOVE_STATE).";
CM_ SG_ 1794 UNK_112_3 "Camera-association state: 0 radar only, 1 (rarely 2-4) while the camera has the vehicle. By day non-zero on nearly all in-lane vehicles inside 40 m and almost never beyond 50 m; at night also at long range.";
CM_ SG_ 1794 UNK_115_5 "Class confidence in 5 % steps: mostly 0 while not yet classified (83 % of those rows), 4-20 otherwise (20 = 100 %); moves by one step per cycle on 95-96 % of its changes. A large vehicle is re-classified as a car when it falls to 5.";
CM_ SG_ 1794 UNK_120_3 "Raw; non-zero on 0.2 % of rows (mature cars).";
CM_ SG_ 1794 CONST_123_5 "Constant in the captured data.";
CM_ SG_ 1794 UNK_128_2 "Lane-assignment state, low bits (full = UNK_128_2 | UNK_130_1 << 2): 3 ego lane, 2 right lane, 4 left lane; 1, 5, 7 = no lane weights.";
CM_ SG_ 1794 UNK_130_1 "Lane-assignment state, bit 2 (see UNK_128_2).";
CM_ SG_ 1794 UNK_131_4 "Dominant lane weight: the largest of the three lane weights or one less (99.6 % of rows with a nonzero weight).";
CM_ SG_ 1794 CONST_135_1 "Constant in the captured data.";
CM_ SG_ 1794 UNK_136_4 "Camera-association confidence: 15 without association; restarts at 3-9 when UNK_112_3 becomes non-zero and climbs to 14.";
CM_ SG_ 1794 UNK_140_3 "Object class, second encoding of UNK_163_3: 0, 5, 7, 1, 3, 4 = class 1, 2, 3, 4, 5, 6.";
CM_ SG_ 1794 CONST_143_5 "Constant in the captured data.";
CM_ SG_ 1794 UNK_148_8 "Lane weights in 1/15 steps: low nibble (148|4) right lane, high nibble (152|4) left lane. With UNK_156_4 (ego lane) they sum to 15 or 16 whenever any is nonzero.";
CM_ SG_ 1794 UNK_156_4 "Ego-lane weight in 1/15 steps (see UNK_148_8).";
CM_ SG_ 1794 CONST_160_3 "Constant in the captured data.";
CM_ SG_ 1794 UNK_163_3 "Object class: 1 not yet classified, 2 car, 3 large vehicle, 4 pedestrian, 5 provisional (cyclist / person associations), 6 two-wheeler.";
CM_ SG_ 1794 UNK_166_2 "Raw, unnamed.";
CM_ SG_ 1794 UNK_168_10 "All ones or all zeros (768 / 832 rare): five sticky per-track latches by age mod 5; a phase latches on a cycle without a near-scan measurement, so most tracks born far out have it set from birth.";
CM_ SG_ 1794 CONST_178_3 "Constant in the captured data.";
CM_ SG_ 1794 UNK_181_1 "Daylight latch: one of five sticky per-track latches by age mod 5 (a phase latches after an existence dip); set on a quarter of mature vehicle rows by day, 2 of 59,988 night rows.";
CM_ SG_ 1794 UNK_182_1 "Raw, unnamed.";
CM_ SG_ 1794 UNK_183_7 "Bit 183: velocity re-initialisation latch (five sticky per-track latches by age mod 5); bits 184-189 are the low bits of a secondary score byte 184|8 (percent: 100 on 98 % of rows; lower mostly on young tracks, far lateral objects and stationary large vehicles / pedestrians).";
CM_ SG_ 1794 UNK_190_10 "Bits 190-191 = top of the secondary score byte 184|8; bits 192-199 are zero.";
CM_ SG_ 1794 UNK_200_7 "Orientation uncertainty: about 3.1 * UNK_248_7 / speed (m/s) on moving objects; 63 for stopped objects, 127 sentinel. Keep all seven bits.";
CM_ SG_ 1794 CONST_207_1 "Constant in the captured data.";
CM_ SG_ 1794 UNK_208_6 "Coarse heading over ground, left positive, about pi/64 rad per code: matches floor(max(atan2(vy, vx), 0) * 64 / pi) on 98 % of settled moving samples; can update while both velocity codes hold.";
CM_ SG_ 1794 CONST_214_2 "Constant in the captured data.";
CM_ SG_ 1794 UNK_216_6 "Object width, about (code + 1) * 0.1 m: car ~1.8 m, large vehicle ~2.0 m, two-wheeler ~0.7 m, pedestrian ~0.5 m.";
CM_ SG_ 1794 CONST_222_2 "Constant in the captured data.";
CM_ SG_ 1794 UNK_224_7 "Range standard deviation (sigma dRel), about 0.23 m per count (0.24 below 40 m; beyond 40 m a 4-8 m error floor dominates): grows with range, shrinks with track age.";
CM_ SG_ 1794 CONST_231_1 "Constant in the captured data.";
CM_ SG_ 1794 UNK_232_8 "Lateral standard deviation (sigma yRel), about 0.10 m per count: grows with |yRel|, shrinks with age. Eight bits: far young tracks reach 128-255 (255 = saturated).";
CM_ SG_ 1794 UNK_240_7 "Longitudinal velocity standard deviation (sigma vx), about 0.043-0.045 m/s per count against the ACC target: grows with range, higher during velocity excursions below 40 m. 127 accompanies saturated velocity.";
CM_ SG_ 1794 CONST_247_1 "Constant in the captured data.";
CM_ SG_ 1794 UNK_248_7 "Lateral velocity standard deviation (sigma vy), linear in the code: about 0.085 + 0.03 m/s per count against stationary objects, about 0.09 per count on moving leads.";
CM_ SG_ 1794 CONST_255_1 "Constant in the captured data.";
CM_ SG_ 1794 UNK_256_8 "Longitudinal-acceleration uncertainty (sigma ax candidate): grows with the spread between ALONG_LIKE_84 and the track's own speed slope (about 0.06-0.07 m/s^2 per code pooled); within a range band it grades that spread only within about 20 m.";
CM_ SG_ 1794 UNK_264_8 "Lateral-acceleration uncertainty (sigma ay candidate), covariance-like: moves with UNK_248_7 in every range band and shrinks with track age (about 11 at age 5-10, 2 from age 60).";
CM_ SG_ 1794 UNK_272_5 "Coarse length code: about round(length / 0.555 m) for vehicles (within one code on 91 %); not a length for pedestrians / two-wheelers.";
CM_ SG_ 1794 UNK_277_11 "Raw; bit 277 rarely set on newborn tracks.";
CM_ BO_ 1795 "Reassembled 0x80 object slot 3 (record bytes 125-160), sent only when occupied. Little-endian bit field: bit 0 = LSB of slot byte 0.";
CM_ SG_ 1795 STATE_CODE "Track state: 0 deleted (the track's final age-0 record), 1 measured, 2 coasting (predicted without a new measurement). While 2, SCORE_CODE drops by 20 (or 1) per cycle.";
CM_ SG_ 1795 SLOT_INDEX_CODE "Physical slot index 0-19; 63 when the slot is unallocated.";
CM_ SG_ 1795 UNK_8_6 "Bits 8-12: startup code, min(30, floor(31 * (2/3)^max(age - 4, 0))) while the motion code is 5 (initializing). Bit 13: separate raw flag.";
CM_ SG_ 1795 ONCOMING_FLAG "Oncoming-like internal motion state. Can persist after slowing and reset before the native allocation ends.";
CM_ SG_ 1795 UNK_15_1 "Placeholder flag: set exactly on the age-1 first output whose range, lateral and size codes are placeholders.";
CM_ SG_ 1795 SCORE_CODE "Existence probability, percent (10-100): can decline in either state; drops by exactly 20 (or 1) per cycle in state 2 and may stay lowered after a return to state 1. Bits 20-22 are its bits 4-6 (score // 16). The slot is freed near 20.";
CM_ SG_ 1795 AGE "Track age in radar cycles (60 ms): 1 at birth, saturates at 126; 0 = slot retiring. A restart is a new track. Converged from about 60.";
CM_ SG_ 1795 CONST_31_1 "Constant in the captured data.";
CM_ SG_ 1795 DREL "Distance forward of the radar, m: (code - 160) / 16. Add 1.52 m (openpilot's RADAR_TO_CAMERA) for a camera-referenced distance; radard compares radar dRel with the vision distance minus 1.52 m.";
CM_ SG_ 1795 YREL_LEFT "Lateral offset, m, left positive: (code - 2048) * 0.015. |code - 2048| >= 2000 is a sentinel.";
CM_ SG_ 1795 UNK_56_7 "Object length, about 0.1 m per code: car ~4.9 m, large vehicle ~5.7 m, two-wheeler ~1.7 m, pedestrian ~0.4 m.";
CM_ SG_ 1795 UNK_63_1 "Raw, unnamed.";
CM_ SG_ 1795 VLONG_OVER_GROUND "Longitudinal velocity over ground, m/s: (code - 510.5) * 0.15. vRel = this - ego speed. Code 1023 is a saturated reading.";
CM_ SG_ 1795 VLAT_OVER_GROUND_PROV "Lateral velocity over ground, m/s, left positive: (code - 510.5) * about 0.142-0.155 (0.15 used).";
CM_ SG_ 1795 ALONG_LIKE_84 "Longitudinal acceleration over ground, filtered: (code - 510.3) * about 0.04-0.09 m/s^2 with ego stopped (estimate depends on drives and estimator); follows the track's own speed by about 0.3 s; moves by about 0.4 of ego's acceleration.";
CM_ SG_ 1795 CONST_94_2 "Constant in the captured data.";
CM_ SG_ 1795 UNK_96 "Lateral acceleration over ground, filtered: (code - 511) * 0.05 m/s^2; follows the kinematic value by about 0.5 s.";
CM_ SG_ 1795 UNK_106_1 "Raw, unnamed.";
CM_ SG_ 1795 UNK_107_1 "Predicted record (the radar's own prediction), like Tesla's Meas = 0: set on 45 % of a track's last five records, 2.6 % elsewhere.";
CM_ SG_ 1795 CONST_108_1 "Constant in the captured data.";
CM_ SG_ 1795 MOVE_STATE "Low two bits of the motion code. Full code = MOVE_STATE | (UNK_111_1 << 2): 0 moving forward, 1 slow or standing, 2 oncoming, 3 moving right, 4 moving left, 5 initializing, 7 stopped after moving.";
CM_ SG_ 1795 UNK_111_1 "Bit 2 of the motion code (see MOVE_STATE).";
CM_ SG_ 1795 UNK_112_3 "Camera-association state: 0 radar only, 1 (rarely 2-4) while the camera has the vehicle. By day non-zero on nearly all in-lane vehicles inside 40 m and almost never beyond 50 m; at night also at long range.";
CM_ SG_ 1795 UNK_115_5 "Class confidence in 5 % steps: mostly 0 while not yet classified (83 % of those rows), 4-20 otherwise (20 = 100 %); moves by one step per cycle on 95-96 % of its changes. A large vehicle is re-classified as a car when it falls to 5.";
CM_ SG_ 1795 UNK_120_3 "Raw; non-zero on 0.2 % of rows (mature cars).";
CM_ SG_ 1795 CONST_123_5 "Constant in the captured data.";
CM_ SG_ 1795 UNK_128_2 "Lane-assignment state, low bits (full = UNK_128_2 | UNK_130_1 << 2): 3 ego lane, 2 right lane, 4 left lane; 1, 5, 7 = no lane weights.";
CM_ SG_ 1795 UNK_130_1 "Lane-assignment state, bit 2 (see UNK_128_2).";
CM_ SG_ 1795 UNK_131_4 "Dominant lane weight: the largest of the three lane weights or one less (99.6 % of rows with a nonzero weight).";
CM_ SG_ 1795 CONST_135_1 "Constant in the captured data.";
CM_ SG_ 1795 UNK_136_4 "Camera-association confidence: 15 without association; restarts at 3-9 when UNK_112_3 becomes non-zero and climbs to 14.";
CM_ SG_ 1795 UNK_140_3 "Object class, second encoding of UNK_163_3: 0, 5, 7, 1, 3, 4 = class 1, 2, 3, 4, 5, 6.";
CM_ SG_ 1795 CONST_143_5 "Constant in the captured data.";
CM_ SG_ 1795 UNK_148_8 "Lane weights in 1/15 steps: low nibble (148|4) right lane, high nibble (152|4) left lane. With UNK_156_4 (ego lane) they sum to 15 or 16 whenever any is nonzero.";
CM_ SG_ 1795 UNK_156_4 "Ego-lane weight in 1/15 steps (see UNK_148_8).";
CM_ SG_ 1795 CONST_160_3 "Constant in the captured data.";
CM_ SG_ 1795 UNK_163_3 "Object class: 1 not yet classified, 2 car, 3 large vehicle, 4 pedestrian, 5 provisional (cyclist / person associations), 6 two-wheeler.";
CM_ SG_ 1795 UNK_166_2 "Raw, unnamed.";
CM_ SG_ 1795 UNK_168_10 "All ones or all zeros (768 / 832 rare): five sticky per-track latches by age mod 5; a phase latches on a cycle without a near-scan measurement, so most tracks born far out have it set from birth.";
CM_ SG_ 1795 CONST_178_3 "Constant in the captured data.";
CM_ SG_ 1795 UNK_181_1 "Daylight latch: one of five sticky per-track latches by age mod 5 (a phase latches after an existence dip); set on a quarter of mature vehicle rows by day, 2 of 59,988 night rows.";
CM_ SG_ 1795 UNK_182_1 "Raw, unnamed.";
CM_ SG_ 1795 UNK_183_7 "Bit 183: velocity re-initialisation latch (five sticky per-track latches by age mod 5); bits 184-189 are the low bits of a secondary score byte 184|8 (percent: 100 on 98 % of rows; lower mostly on young tracks, far lateral objects and stationary large vehicles / pedestrians).";
CM_ SG_ 1795 UNK_190_10 "Bits 190-191 = top of the secondary score byte 184|8; bits 192-199 are zero.";
CM_ SG_ 1795 UNK_200_7 "Orientation uncertainty: about 3.1 * UNK_248_7 / speed (m/s) on moving objects; 63 for stopped objects, 127 sentinel. Keep all seven bits.";
CM_ SG_ 1795 CONST_207_1 "Constant in the captured data.";
CM_ SG_ 1795 UNK_208_6 "Coarse heading over ground, left positive, about pi/64 rad per code: matches floor(max(atan2(vy, vx), 0) * 64 / pi) on 98 % of settled moving samples; can update while both velocity codes hold.";
CM_ SG_ 1795 CONST_214_2 "Constant in the captured data.";
CM_ SG_ 1795 UNK_216_6 "Object width, about (code + 1) * 0.1 m: car ~1.8 m, large vehicle ~2.0 m, two-wheeler ~0.7 m, pedestrian ~0.5 m.";
CM_ SG_ 1795 CONST_222_2 "Constant in the captured data.";
CM_ SG_ 1795 UNK_224_7 "Range standard deviation (sigma dRel), about 0.23 m per count (0.24 below 40 m; beyond 40 m a 4-8 m error floor dominates): grows with range, shrinks with track age.";
CM_ SG_ 1795 CONST_231_1 "Constant in the captured data.";
CM_ SG_ 1795 UNK_232_8 "Lateral standard deviation (sigma yRel), about 0.10 m per count: grows with |yRel|, shrinks with age. Eight bits: far young tracks reach 128-255 (255 = saturated).";
CM_ SG_ 1795 UNK_240_7 "Longitudinal velocity standard deviation (sigma vx), about 0.043-0.045 m/s per count against the ACC target: grows with range, higher during velocity excursions below 40 m. 127 accompanies saturated velocity.";
CM_ SG_ 1795 CONST_247_1 "Constant in the captured data.";
CM_ SG_ 1795 UNK_248_7 "Lateral velocity standard deviation (sigma vy), linear in the code: about 0.085 + 0.03 m/s per count against stationary objects, about 0.09 per count on moving leads.";
CM_ SG_ 1795 CONST_255_1 "Constant in the captured data.";
CM_ SG_ 1795 UNK_256_8 "Longitudinal-acceleration uncertainty (sigma ax candidate): grows with the spread between ALONG_LIKE_84 and the track's own speed slope (about 0.06-0.07 m/s^2 per code pooled); within a range band it grades that spread only within about 20 m.";
CM_ SG_ 1795 UNK_264_8 "Lateral-acceleration uncertainty (sigma ay candidate), covariance-like: moves with UNK_248_7 in every range band and shrinks with track age (about 11 at age 5-10, 2 from age 60).";
CM_ SG_ 1795 UNK_272_5 "Coarse length code: about round(length / 0.555 m) for vehicles (within one code on 91 %); not a length for pedestrians / two-wheelers.";
CM_ SG_ 1795 UNK_277_11 "Raw; bit 277 rarely set on newborn tracks.";
CM_ BO_ 1796 "Reassembled 0x80 object slot 4 (record bytes 161-196), sent only when occupied. Little-endian bit field: bit 0 = LSB of slot byte 0.";
CM_ SG_ 1796 STATE_CODE "Track state: 0 deleted (the track's final age-0 record), 1 measured, 2 coasting (predicted without a new measurement). While 2, SCORE_CODE drops by 20 (or 1) per cycle.";
CM_ SG_ 1796 SLOT_INDEX_CODE "Physical slot index 0-19; 63 when the slot is unallocated.";
CM_ SG_ 1796 UNK_8_6 "Bits 8-12: startup code, min(30, floor(31 * (2/3)^max(age - 4, 0))) while the motion code is 5 (initializing). Bit 13: separate raw flag.";
CM_ SG_ 1796 ONCOMING_FLAG "Oncoming-like internal motion state. Can persist after slowing and reset before the native allocation ends.";
CM_ SG_ 1796 UNK_15_1 "Placeholder flag: set exactly on the age-1 first output whose range, lateral and size codes are placeholders.";
CM_ SG_ 1796 SCORE_CODE "Existence probability, percent (10-100): can decline in either state; drops by exactly 20 (or 1) per cycle in state 2 and may stay lowered after a return to state 1. Bits 20-22 are its bits 4-6 (score // 16). The slot is freed near 20.";
CM_ SG_ 1796 AGE "Track age in radar cycles (60 ms): 1 at birth, saturates at 126; 0 = slot retiring. A restart is a new track. Converged from about 60.";
CM_ SG_ 1796 CONST_31_1 "Constant in the captured data.";
CM_ SG_ 1796 DREL "Distance forward of the radar, m: (code - 160) / 16. Add 1.52 m (openpilot's RADAR_TO_CAMERA) for a camera-referenced distance; radard compares radar dRel with the vision distance minus 1.52 m.";
CM_ SG_ 1796 YREL_LEFT "Lateral offset, m, left positive: (code - 2048) * 0.015. |code - 2048| >= 2000 is a sentinel.";
CM_ SG_ 1796 UNK_56_7 "Object length, about 0.1 m per code: car ~4.9 m, large vehicle ~5.7 m, two-wheeler ~1.7 m, pedestrian ~0.4 m.";
CM_ SG_ 1796 UNK_63_1 "Raw, unnamed.";
CM_ SG_ 1796 VLONG_OVER_GROUND "Longitudinal velocity over ground, m/s: (code - 510.5) * 0.15. vRel = this - ego speed. Code 1023 is a saturated reading.";
CM_ SG_ 1796 VLAT_OVER_GROUND_PROV "Lateral velocity over ground, m/s, left positive: (code - 510.5) * about 0.142-0.155 (0.15 used).";
CM_ SG_ 1796 ALONG_LIKE_84 "Longitudinal acceleration over ground, filtered: (code - 510.3) * about 0.04-0.09 m/s^2 with ego stopped (estimate depends on drives and estimator); follows the track's own speed by about 0.3 s; moves by about 0.4 of ego's acceleration.";
CM_ SG_ 1796 CONST_94_2 "Constant in the captured data.";
CM_ SG_ 1796 UNK_96 "Lateral acceleration over ground, filtered: (code - 511) * 0.05 m/s^2; follows the kinematic value by about 0.5 s.";
CM_ SG_ 1796 UNK_106_1 "Raw, unnamed.";
CM_ SG_ 1796 UNK_107_1 "Predicted record (the radar's own prediction), like Tesla's Meas = 0: set on 45 % of a track's last five records, 2.6 % elsewhere.";
CM_ SG_ 1796 CONST_108_1 "Constant in the captured data.";
CM_ SG_ 1796 MOVE_STATE "Low two bits of the motion code. Full code = MOVE_STATE | (UNK_111_1 << 2): 0 moving forward, 1 slow or standing, 2 oncoming, 3 moving right, 4 moving left, 5 initializing, 7 stopped after moving.";
CM_ SG_ 1796 UNK_111_1 "Bit 2 of the motion code (see MOVE_STATE).";
CM_ SG_ 1796 UNK_112_3 "Camera-association state: 0 radar only, 1 (rarely 2-4) while the camera has the vehicle. By day non-zero on nearly all in-lane vehicles inside 40 m and almost never beyond 50 m; at night also at long range.";
CM_ SG_ 1796 UNK_115_5 "Class confidence in 5 % steps: mostly 0 while not yet classified (83 % of those rows), 4-20 otherwise (20 = 100 %); moves by one step per cycle on 95-96 % of its changes. A large vehicle is re-classified as a car when it falls to 5.";
CM_ SG_ 1796 UNK_120_3 "Raw; non-zero on 0.2 % of rows (mature cars).";
CM_ SG_ 1796 CONST_123_5 "Constant in the captured data.";
CM_ SG_ 1796 UNK_128_2 "Lane-assignment state, low bits (full = UNK_128_2 | UNK_130_1 << 2): 3 ego lane, 2 right lane, 4 left lane; 1, 5, 7 = no lane weights.";
CM_ SG_ 1796 UNK_130_1 "Lane-assignment state, bit 2 (see UNK_128_2).";
CM_ SG_ 1796 UNK_131_4 "Dominant lane weight: the largest of the three lane weights or one less (99.6 % of rows with a nonzero weight).";
CM_ SG_ 1796 CONST_135_1 "Constant in the captured data.";
CM_ SG_ 1796 UNK_136_4 "Camera-association confidence: 15 without association; restarts at 3-9 when UNK_112_3 becomes non-zero and climbs to 14.";
CM_ SG_ 1796 UNK_140_3 "Object class, second encoding of UNK_163_3: 0, 5, 7, 1, 3, 4 = class 1, 2, 3, 4, 5, 6.";
CM_ SG_ 1796 CONST_143_5 "Constant in the captured data.";
CM_ SG_ 1796 UNK_148_8 "Lane weights in 1/15 steps: low nibble (148|4) right lane, high nibble (152|4) left lane. With UNK_156_4 (ego lane) they sum to 15 or 16 whenever any is nonzero.";
CM_ SG_ 1796 UNK_156_4 "Ego-lane weight in 1/15 steps (see UNK_148_8).";
CM_ SG_ 1796 CONST_160_3 "Constant in the captured data.";
CM_ SG_ 1796 UNK_163_3 "Object class: 1 not yet classified, 2 car, 3 large vehicle, 4 pedestrian, 5 provisional (cyclist / person associations), 6 two-wheeler.";
CM_ SG_ 1796 UNK_166_2 "Raw, unnamed.";
CM_ SG_ 1796 UNK_168_10 "All ones or all zeros (768 / 832 rare): five sticky per-track latches by age mod 5; a phase latches on a cycle without a near-scan measurement, so most tracks born far out have it set from birth.";
CM_ SG_ 1796 CONST_178_3 "Constant in the captured data.";
CM_ SG_ 1796 UNK_181_1 "Daylight latch: one of five sticky per-track latches by age mod 5 (a phase latches after an existence dip); set on a quarter of mature vehicle rows by day, 2 of 59,988 night rows.";
CM_ SG_ 1796 UNK_182_1 "Raw, unnamed.";
CM_ SG_ 1796 UNK_183_7 "Bit 183: velocity re-initialisation latch (five sticky per-track latches by age mod 5); bits 184-189 are the low bits of a secondary score byte 184|8 (percent: 100 on 98 % of rows; lower mostly on young tracks, far lateral objects and stationary large vehicles / pedestrians).";
CM_ SG_ 1796 UNK_190_10 "Bits 190-191 = top of the secondary score byte 184|8; bits 192-199 are zero.";
CM_ SG_ 1796 UNK_200_7 "Orientation uncertainty: about 3.1 * UNK_248_7 / speed (m/s) on moving objects; 63 for stopped objects, 127 sentinel. Keep all seven bits.";
CM_ SG_ 1796 CONST_207_1 "Constant in the captured data.";
CM_ SG_ 1796 UNK_208_6 "Coarse heading over ground, left positive, about pi/64 rad per code: matches floor(max(atan2(vy, vx), 0) * 64 / pi) on 98 % of settled moving samples; can update while both velocity codes hold.";
CM_ SG_ 1796 CONST_214_2 "Constant in the captured data.";
CM_ SG_ 1796 UNK_216_6 "Object width, about (code + 1) * 0.1 m: car ~1.8 m, large vehicle ~2.0 m, two-wheeler ~0.7 m, pedestrian ~0.5 m.";
CM_ SG_ 1796 CONST_222_2 "Constant in the captured data.";
CM_ SG_ 1796 UNK_224_7 "Range standard deviation (sigma dRel), about 0.23 m per count (0.24 below 40 m; beyond 40 m a 4-8 m error floor dominates): grows with range, shrinks with track age.";
CM_ SG_ 1796 CONST_231_1 "Constant in the captured data.";
CM_ SG_ 1796 UNK_232_8 "Lateral standard deviation (sigma yRel), about 0.10 m per count: grows with |yRel|, shrinks with age. Eight bits: far young tracks reach 128-255 (255 = saturated).";
CM_ SG_ 1796 UNK_240_7 "Longitudinal velocity standard deviation (sigma vx), about 0.043-0.045 m/s per count against the ACC target: grows with range, higher during velocity excursions below 40 m. 127 accompanies saturated velocity.";
CM_ SG_ 1796 CONST_247_1 "Constant in the captured data.";
CM_ SG_ 1796 UNK_248_7 "Lateral velocity standard deviation (sigma vy), linear in the code: about 0.085 + 0.03 m/s per count against stationary objects, about 0.09 per count on moving leads.";
CM_ SG_ 1796 CONST_255_1 "Constant in the captured data.";
CM_ SG_ 1796 UNK_256_8 "Longitudinal-acceleration uncertainty (sigma ax candidate): grows with the spread between ALONG_LIKE_84 and the track's own speed slope (about 0.06-0.07 m/s^2 per code pooled); within a range band it grades that spread only within about 20 m.";
CM_ SG_ 1796 UNK_264_8 "Lateral-acceleration uncertainty (sigma ay candidate), covariance-like: moves with UNK_248_7 in every range band and shrinks with track age (about 11 at age 5-10, 2 from age 60).";
CM_ SG_ 1796 UNK_272_5 "Coarse length code: about round(length / 0.555 m) for vehicles (within one code on 91 %); not a length for pedestrians / two-wheelers.";
CM_ SG_ 1796 UNK_277_11 "Raw; bit 277 rarely set on newborn tracks.";
CM_ BO_ 1797 "Reassembled 0x80 object slot 5 (record bytes 197-232), sent only when occupied. Little-endian bit field: bit 0 = LSB of slot byte 0.";
CM_ SG_ 1797 STATE_CODE "Track state: 0 deleted (the track's final age-0 record), 1 measured, 2 coasting (predicted without a new measurement). While 2, SCORE_CODE drops by 20 (or 1) per cycle.";
CM_ SG_ 1797 SLOT_INDEX_CODE "Physical slot index 0-19; 63 when the slot is unallocated.";
CM_ SG_ 1797 UNK_8_6 "Bits 8-12: startup code, min(30, floor(31 * (2/3)^max(age - 4, 0))) while the motion code is 5 (initializing). Bit 13: separate raw flag.";
CM_ SG_ 1797 ONCOMING_FLAG "Oncoming-like internal motion state. Can persist after slowing and reset before the native allocation ends.";
CM_ SG_ 1797 UNK_15_1 "Placeholder flag: set exactly on the age-1 first output whose range, lateral and size codes are placeholders.";
CM_ SG_ 1797 SCORE_CODE "Existence probability, percent (10-100): can decline in either state; drops by exactly 20 (or 1) per cycle in state 2 and may stay lowered after a return to state 1. Bits 20-22 are its bits 4-6 (score // 16). The slot is freed near 20.";
CM_ SG_ 1797 AGE "Track age in radar cycles (60 ms): 1 at birth, saturates at 126; 0 = slot retiring. A restart is a new track. Converged from about 60.";
CM_ SG_ 1797 CONST_31_1 "Constant in the captured data.";
CM_ SG_ 1797 DREL "Distance forward of the radar, m: (code - 160) / 16. Add 1.52 m (openpilot's RADAR_TO_CAMERA) for a camera-referenced distance; radard compares radar dRel with the vision distance minus 1.52 m.";
CM_ SG_ 1797 YREL_LEFT "Lateral offset, m, left positive: (code - 2048) * 0.015. |code - 2048| >= 2000 is a sentinel.";
CM_ SG_ 1797 UNK_56_7 "Object length, about 0.1 m per code: car ~4.9 m, large vehicle ~5.7 m, two-wheeler ~1.7 m, pedestrian ~0.4 m.";
CM_ SG_ 1797 UNK_63_1 "Raw, unnamed.";
CM_ SG_ 1797 VLONG_OVER_GROUND "Longitudinal velocity over ground, m/s: (code - 510.5) * 0.15. vRel = this - ego speed. Code 1023 is a saturated reading.";
CM_ SG_ 1797 VLAT_OVER_GROUND_PROV "Lateral velocity over ground, m/s, left positive: (code - 510.5) * about 0.142-0.155 (0.15 used).";
CM_ SG_ 1797 ALONG_LIKE_84 "Longitudinal acceleration over ground, filtered: (code - 510.3) * about 0.04-0.09 m/s^2 with ego stopped (estimate depends on drives and estimator); follows the track's own speed by about 0.3 s; moves by about 0.4 of ego's acceleration.";
CM_ SG_ 1797 CONST_94_2 "Constant in the captured data.";
CM_ SG_ 1797 UNK_96 "Lateral acceleration over ground, filtered: (code - 511) * 0.05 m/s^2; follows the kinematic value by about 0.5 s.";
CM_ SG_ 1797 UNK_106_1 "Raw, unnamed.";
CM_ SG_ 1797 UNK_107_1 "Predicted record (the radar's own prediction), like Tesla's Meas = 0: set on 45 % of a track's last five records, 2.6 % elsewhere.";
CM_ SG_ 1797 CONST_108_1 "Constant in the captured data.";
CM_ SG_ 1797 MOVE_STATE "Low two bits of the motion code. Full code = MOVE_STATE | (UNK_111_1 << 2): 0 moving forward, 1 slow or standing, 2 oncoming, 3 moving right, 4 moving left, 5 initializing, 7 stopped after moving.";
CM_ SG_ 1797 UNK_111_1 "Bit 2 of the motion code (see MOVE_STATE).";
CM_ SG_ 1797 UNK_112_3 "Camera-association state: 0 radar only, 1 (rarely 2-4) while the camera has the vehicle. By day non-zero on nearly all in-lane vehicles inside 40 m and almost never beyond 50 m; at night also at long range.";
CM_ SG_ 1797 UNK_115_5 "Class confidence in 5 % steps: mostly 0 while not yet classified (83 % of those rows), 4-20 otherwise (20 = 100 %); moves by one step per cycle on 95-96 % of its changes. A large vehicle is re-classified as a car when it falls to 5.";
CM_ SG_ 1797 UNK_120_3 "Raw; non-zero on 0.2 % of rows (mature cars).";
CM_ SG_ 1797 CONST_123_5 "Constant in the captured data.";
CM_ SG_ 1797 UNK_128_2 "Lane-assignment state, low bits (full = UNK_128_2 | UNK_130_1 << 2): 3 ego lane, 2 right lane, 4 left lane; 1, 5, 7 = no lane weights.";
CM_ SG_ 1797 UNK_130_1 "Lane-assignment state, bit 2 (see UNK_128_2).";
CM_ SG_ 1797 UNK_131_4 "Dominant lane weight: the largest of the three lane weights or one less (99.6 % of rows with a nonzero weight).";
CM_ SG_ 1797 CONST_135_1 "Constant in the captured data.";
CM_ SG_ 1797 UNK_136_4 "Camera-association confidence: 15 without association; restarts at 3-9 when UNK_112_3 becomes non-zero and climbs to 14.";
CM_ SG_ 1797 UNK_140_3 "Object class, second encoding of UNK_163_3: 0, 5, 7, 1, 3, 4 = class 1, 2, 3, 4, 5, 6.";
CM_ SG_ 1797 CONST_143_5 "Constant in the captured data.";
CM_ SG_ 1797 UNK_148_8 "Lane weights in 1/15 steps: low nibble (148|4) right lane, high nibble (152|4) left lane. With UNK_156_4 (ego lane) they sum to 15 or 16 whenever any is nonzero.";
CM_ SG_ 1797 UNK_156_4 "Ego-lane weight in 1/15 steps (see UNK_148_8).";
CM_ SG_ 1797 CONST_160_3 "Constant in the captured data.";
CM_ SG_ 1797 UNK_163_3 "Object class: 1 not yet classified, 2 car, 3 large vehicle, 4 pedestrian, 5 provisional (cyclist / person associations), 6 two-wheeler.";
CM_ SG_ 1797 UNK_166_2 "Raw, unnamed.";
CM_ SG_ 1797 UNK_168_10 "All ones or all zeros (768 / 832 rare): five sticky per-track latches by age mod 5; a phase latches on a cycle without a near-scan measurement, so most tracks born far out have it set from birth.";
CM_ SG_ 1797 CONST_178_3 "Constant in the captured data.";
CM_ SG_ 1797 UNK_181_1 "Daylight latch: one of five sticky per-track latches by age mod 5 (a phase latches after an existence dip); set on a quarter of mature vehicle rows by day, 2 of 59,988 night rows.";
CM_ SG_ 1797 UNK_182_1 "Raw, unnamed.";
CM_ SG_ 1797 UNK_183_7 "Bit 183: velocity re-initialisation latch (five sticky per-track latches by age mod 5); bits 184-189 are the low bits of a secondary score byte 184|8 (percent: 100 on 98 % of rows; lower mostly on young tracks, far lateral objects and stationary large vehicles / pedestrians).";
CM_ SG_ 1797 UNK_190_10 "Bits 190-191 = top of the secondary score byte 184|8; bits 192-199 are zero.";
CM_ SG_ 1797 UNK_200_7 "Orientation uncertainty: about 3.1 * UNK_248_7 / speed (m/s) on moving objects; 63 for stopped objects, 127 sentinel. Keep all seven bits.";
CM_ SG_ 1797 CONST_207_1 "Constant in the captured data.";
CM_ SG_ 1797 UNK_208_6 "Coarse heading over ground, left positive, about pi/64 rad per code: matches floor(max(atan2(vy, vx), 0) * 64 / pi) on 98 % of settled moving samples; can update while both velocity codes hold.";
CM_ SG_ 1797 CONST_214_2 "Constant in the captured data.";
CM_ SG_ 1797 UNK_216_6 "Object width, about (code + 1) * 0.1 m: car ~1.8 m, large vehicle ~2.0 m, two-wheeler ~0.7 m, pedestrian ~0.5 m.";
CM_ SG_ 1797 CONST_222_2 "Constant in the captured data.";
CM_ SG_ 1797 UNK_224_7 "Range standard deviation (sigma dRel), about 0.23 m per count (0.24 below 40 m; beyond 40 m a 4-8 m error floor dominates): grows with range, shrinks with track age.";
CM_ SG_ 1797 CONST_231_1 "Constant in the captured data.";
CM_ SG_ 1797 UNK_232_8 "Lateral standard deviation (sigma yRel), about 0.10 m per count: grows with |yRel|, shrinks with age. Eight bits: far young tracks reach 128-255 (255 = saturated).";
CM_ SG_ 1797 UNK_240_7 "Longitudinal velocity standard deviation (sigma vx), about 0.043-0.045 m/s per count against the ACC target: grows with range, higher during velocity excursions below 40 m. 127 accompanies saturated velocity.";
CM_ SG_ 1797 CONST_247_1 "Constant in the captured data.";
CM_ SG_ 1797 UNK_248_7 "Lateral velocity standard deviation (sigma vy), linear in the code: about 0.085 + 0.03 m/s per count against stationary objects, about 0.09 per count on moving leads.";
CM_ SG_ 1797 CONST_255_1 "Constant in the captured data.";
CM_ SG_ 1797 UNK_256_8 "Longitudinal-acceleration uncertainty (sigma ax candidate): grows with the spread between ALONG_LIKE_84 and the track's own speed slope (about 0.06-0.07 m/s^2 per code pooled); within a range band it grades that spread only within about 20 m.";
CM_ SG_ 1797 UNK_264_8 "Lateral-acceleration uncertainty (sigma ay candidate), covariance-like: moves with UNK_248_7 in every range band and shrinks with track age (about 11 at age 5-10, 2 from age 60).";
CM_ SG_ 1797 UNK_272_5 "Coarse length code: about round(length / 0.555 m) for vehicles (within one code on 91 %); not a length for pedestrians / two-wheelers.";
CM_ SG_ 1797 UNK_277_11 "Raw; bit 277 rarely set on newborn tracks.";
CM_ BO_ 1798 "Reassembled 0x80 object slot 6 (record bytes 233-268), sent only when occupied. Little-endian bit field: bit 0 = LSB of slot byte 0.";
CM_ SG_ 1798 STATE_CODE "Track state: 0 deleted (the track's final age-0 record), 1 measured, 2 coasting (predicted without a new measurement). While 2, SCORE_CODE drops by 20 (or 1) per cycle.";
CM_ SG_ 1798 SLOT_INDEX_CODE "Physical slot index 0-19; 63 when the slot is unallocated.";
CM_ SG_ 1798 UNK_8_6 "Bits 8-12: startup code, min(30, floor(31 * (2/3)^max(age - 4, 0))) while the motion code is 5 (initializing). Bit 13: separate raw flag.";
CM_ SG_ 1798 ONCOMING_FLAG "Oncoming-like internal motion state. Can persist after slowing and reset before the native allocation ends.";
CM_ SG_ 1798 UNK_15_1 "Placeholder flag: set exactly on the age-1 first output whose range, lateral and size codes are placeholders.";
CM_ SG_ 1798 SCORE_CODE "Existence probability, percent (10-100): can decline in either state; drops by exactly 20 (or 1) per cycle in state 2 and may stay lowered after a return to state 1. Bits 20-22 are its bits 4-6 (score // 16). The slot is freed near 20.";
CM_ SG_ 1798 AGE "Track age in radar cycles (60 ms): 1 at birth, saturates at 126; 0 = slot retiring. A restart is a new track. Converged from about 60.";
CM_ SG_ 1798 CONST_31_1 "Constant in the captured data.";
CM_ SG_ 1798 DREL "Distance forward of the radar, m: (code - 160) / 16. Add 1.52 m (openpilot's RADAR_TO_CAMERA) for a camera-referenced distance; radard compares radar dRel with the vision distance minus 1.52 m.";
CM_ SG_ 1798 YREL_LEFT "Lateral offset, m, left positive: (code - 2048) * 0.015. |code - 2048| >= 2000 is a sentinel.";
CM_ SG_ 1798 UNK_56_7 "Object length, about 0.1 m per code: car ~4.9 m, large vehicle ~5.7 m, two-wheeler ~1.7 m, pedestrian ~0.4 m.";
CM_ SG_ 1798 UNK_63_1 "Raw, unnamed.";
CM_ SG_ 1798 VLONG_OVER_GROUND "Longitudinal velocity over ground, m/s: (code - 510.5) * 0.15. vRel = this - ego speed. Code 1023 is a saturated reading.";
CM_ SG_ 1798 VLAT_OVER_GROUND_PROV "Lateral velocity over ground, m/s, left positive: (code - 510.5) * about 0.142-0.155 (0.15 used).";
CM_ SG_ 1798 ALONG_LIKE_84 "Longitudinal acceleration over ground, filtered: (code - 510.3) * about 0.04-0.09 m/s^2 with ego stopped (estimate depends on drives and estimator); follows the track's own speed by about 0.3 s; moves by about 0.4 of ego's acceleration.";
CM_ SG_ 1798 CONST_94_2 "Constant in the captured data.";
CM_ SG_ 1798 UNK_96 "Lateral acceleration over ground, filtered: (code - 511) * 0.05 m/s^2; follows the kinematic value by about 0.5 s.";
CM_ SG_ 1798 UNK_106_1 "Raw, unnamed.";
CM_ SG_ 1798 UNK_107_1 "Predicted record (the radar's own prediction), like Tesla's Meas = 0: set on 45 % of a track's last five records, 2.6 % elsewhere.";
CM_ SG_ 1798 CONST_108_1 "Constant in the captured data.";
CM_ SG_ 1798 MOVE_STATE "Low two bits of the motion code. Full code = MOVE_STATE | (UNK_111_1 << 2): 0 moving forward, 1 slow or standing, 2 oncoming, 3 moving right, 4 moving left, 5 initializing, 7 stopped after moving.";
CM_ SG_ 1798 UNK_111_1 "Bit 2 of the motion code (see MOVE_STATE).";
CM_ SG_ 1798 UNK_112_3 "Camera-association state: 0 radar only, 1 (rarely 2-4) while the camera has the vehicle. By day non-zero on nearly all in-lane vehicles inside 40 m and almost never beyond 50 m; at night also at long range.";
CM_ SG_ 1798 UNK_115_5 "Class confidence in 5 % steps: mostly 0 while not yet classified (83 % of those rows), 4-20 otherwise (20 = 100 %); moves by one step per cycle on 95-96 % of its changes. A large vehicle is re-classified as a car when it falls to 5.";
CM_ SG_ 1798 UNK_120_3 "Raw; non-zero on 0.2 % of rows (mature cars).";
CM_ SG_ 1798 CONST_123_5 "Constant in the captured data.";
CM_ SG_ 1798 UNK_128_2 "Lane-assignment state, low bits (full = UNK_128_2 | UNK_130_1 << 2): 3 ego lane, 2 right lane, 4 left lane; 1, 5, 7 = no lane weights.";
CM_ SG_ 1798 UNK_130_1 "Lane-assignment state, bit 2 (see UNK_128_2).";
CM_ SG_ 1798 UNK_131_4 "Dominant lane weight: the largest of the three lane weights or one less (99.6 % of rows with a nonzero weight).";
CM_ SG_ 1798 CONST_135_1 "Constant in the captured data.";
CM_ SG_ 1798 UNK_136_4 "Camera-association confidence: 15 without association; restarts at 3-9 when UNK_112_3 becomes non-zero and climbs to 14.";
CM_ SG_ 1798 UNK_140_3 "Object class, second encoding of UNK_163_3: 0, 5, 7, 1, 3, 4 = class 1, 2, 3, 4, 5, 6.";
CM_ SG_ 1798 CONST_143_5 "Constant in the captured data.";
CM_ SG_ 1798 UNK_148_8 "Lane weights in 1/15 steps: low nibble (148|4) right lane, high nibble (152|4) left lane. With UNK_156_4 (ego lane) they sum to 15 or 16 whenever any is nonzero.";
CM_ SG_ 1798 UNK_156_4 "Ego-lane weight in 1/15 steps (see UNK_148_8).";
CM_ SG_ 1798 CONST_160_3 "Constant in the captured data.";
CM_ SG_ 1798 UNK_163_3 "Object class: 1 not yet classified, 2 car, 3 large vehicle, 4 pedestrian, 5 provisional (cyclist / person associations), 6 two-wheeler.";
CM_ SG_ 1798 UNK_166_2 "Raw, unnamed.";
CM_ SG_ 1798 UNK_168_10 "All ones or all zeros (768 / 832 rare): five sticky per-track latches by age mod 5; a phase latches on a cycle without a near-scan measurement, so most tracks born far out have it set from birth.";
CM_ SG_ 1798 CONST_178_3 "Constant in the captured data.";
CM_ SG_ 1798 UNK_181_1 "Daylight latch: one of five sticky per-track latches by age mod 5 (a phase latches after an existence dip); set on a quarter of mature vehicle rows by day, 2 of 59,988 night rows.";
CM_ SG_ 1798 UNK_182_1 "Raw, unnamed.";
CM_ SG_ 1798 UNK_183_7 "Bit 183: velocity re-initialisation latch (five sticky per-track latches by age mod 5); bits 184-189 are the low bits of a secondary score byte 184|8 (percent: 100 on 98 % of rows; lower mostly on young tracks, far lateral objects and stationary large vehicles / pedestrians).";
CM_ SG_ 1798 UNK_190_10 "Bits 190-191 = top of the secondary score byte 184|8; bits 192-199 are zero.";
CM_ SG_ 1798 UNK_200_7 "Orientation uncertainty: about 3.1 * UNK_248_7 / speed (m/s) on moving objects; 63 for stopped objects, 127 sentinel. Keep all seven bits.";
CM_ SG_ 1798 CONST_207_1 "Constant in the captured data.";
CM_ SG_ 1798 UNK_208_6 "Coarse heading over ground, left positive, about pi/64 rad per code: matches floor(max(atan2(vy, vx), 0) * 64 / pi) on 98 % of settled moving samples; can update while both velocity codes hold.";
CM_ SG_ 1798 CONST_214_2 "Constant in the captured data.";
CM_ SG_ 1798 UNK_216_6 "Object width, about (code + 1) * 0.1 m: car ~1.8 m, large vehicle ~2.0 m, two-wheeler ~0.7 m, pedestrian ~0.5 m.";
CM_ SG_ 1798 CONST_222_2 "Constant in the captured data.";
CM_ SG_ 1798 UNK_224_7 "Range standard deviation (sigma dRel), about 0.23 m per count (0.24 below 40 m; beyond 40 m a 4-8 m error floor dominates): grows with range, shrinks with track age.";
CM_ SG_ 1798 CONST_231_1 "Constant in the captured data.";
CM_ SG_ 1798 UNK_232_8 "Lateral standard deviation (sigma yRel), about 0.10 m per count: grows with |yRel|, shrinks with age. Eight bits: far young tracks reach 128-255 (255 = saturated).";
CM_ SG_ 1798 UNK_240_7 "Longitudinal velocity standard deviation (sigma vx), about 0.043-0.045 m/s per count against the ACC target: grows with range, higher during velocity excursions below 40 m. 127 accompanies saturated velocity.";
CM_ SG_ 1798 CONST_247_1 "Constant in the captured data.";
CM_ SG_ 1798 UNK_248_7 "Lateral velocity standard deviation (sigma vy), linear in the code: about 0.085 + 0.03 m/s per count against stationary objects, about 0.09 per count on moving leads.";
CM_ SG_ 1798 CONST_255_1 "Constant in the captured data.";
CM_ SG_ 1798 UNK_256_8 "Longitudinal-acceleration uncertainty (sigma ax candidate): grows with the spread between ALONG_LIKE_84 and the track's own speed slope (about 0.06-0.07 m/s^2 per code pooled); within a range band it grades that spread only within about 20 m.";
CM_ SG_ 1798 UNK_264_8 "Lateral-acceleration uncertainty (sigma ay candidate), covariance-like: moves with UNK_248_7 in every range band and shrinks with track age (about 11 at age 5-10, 2 from age 60).";
CM_ SG_ 1798 UNK_272_5 "Coarse length code: about round(length / 0.555 m) for vehicles (within one code on 91 %); not a length for pedestrians / two-wheelers.";
CM_ SG_ 1798 UNK_277_11 "Raw; bit 277 rarely set on newborn tracks.";
CM_ BO_ 1799 "Reassembled 0x80 object slot 7 (record bytes 269-304), sent only when occupied. Little-endian bit field: bit 0 = LSB of slot byte 0.";
CM_ SG_ 1799 STATE_CODE "Track state: 0 deleted (the track's final age-0 record), 1 measured, 2 coasting (predicted without a new measurement). While 2, SCORE_CODE drops by 20 (or 1) per cycle.";
CM_ SG_ 1799 SLOT_INDEX_CODE "Physical slot index 0-19; 63 when the slot is unallocated.";
CM_ SG_ 1799 UNK_8_6 "Bits 8-12: startup code, min(30, floor(31 * (2/3)^max(age - 4, 0))) while the motion code is 5 (initializing). Bit 13: separate raw flag.";
CM_ SG_ 1799 ONCOMING_FLAG "Oncoming-like internal motion state. Can persist after slowing and reset before the native allocation ends.";
CM_ SG_ 1799 UNK_15_1 "Placeholder flag: set exactly on the age-1 first output whose range, lateral and size codes are placeholders.";
CM_ SG_ 1799 SCORE_CODE "Existence probability, percent (10-100): can decline in either state; drops by exactly 20 (or 1) per cycle in state 2 and may stay lowered after a return to state 1. Bits 20-22 are its bits 4-6 (score // 16). The slot is freed near 20.";
CM_ SG_ 1799 AGE "Track age in radar cycles (60 ms): 1 at birth, saturates at 126; 0 = slot retiring. A restart is a new track. Converged from about 60.";
CM_ SG_ 1799 CONST_31_1 "Constant in the captured data.";
CM_ SG_ 1799 DREL "Distance forward of the radar, m: (code - 160) / 16. Add 1.52 m (openpilot's RADAR_TO_CAMERA) for a camera-referenced distance; radard compares radar dRel with the vision distance minus 1.52 m.";
CM_ SG_ 1799 YREL_LEFT "Lateral offset, m, left positive: (code - 2048) * 0.015. |code - 2048| >= 2000 is a sentinel.";
CM_ SG_ 1799 UNK_56_7 "Object length, about 0.1 m per code: car ~4.9 m, large vehicle ~5.7 m, two-wheeler ~1.7 m, pedestrian ~0.4 m.";
CM_ SG_ 1799 UNK_63_1 "Raw, unnamed.";
CM_ SG_ 1799 VLONG_OVER_GROUND "Longitudinal velocity over ground, m/s: (code - 510.5) * 0.15. vRel = this - ego speed. Code 1023 is a saturated reading.";
CM_ SG_ 1799 VLAT_OVER_GROUND_PROV "Lateral velocity over ground, m/s, left positive: (code - 510.5) * about 0.142-0.155 (0.15 used).";
CM_ SG_ 1799 ALONG_LIKE_84 "Longitudinal acceleration over ground, filtered: (code - 510.3) * about 0.04-0.09 m/s^2 with ego stopped (estimate depends on drives and estimator); follows the track's own speed by about 0.3 s; moves by about 0.4 of ego's acceleration.";
CM_ SG_ 1799 CONST_94_2 "Constant in the captured data.";
CM_ SG_ 1799 UNK_96 "Lateral acceleration over ground, filtered: (code - 511) * 0.05 m/s^2; follows the kinematic value by about 0.5 s.";
CM_ SG_ 1799 UNK_106_1 "Raw, unnamed.";
CM_ SG_ 1799 UNK_107_1 "Predicted record (the radar's own prediction), like Tesla's Meas = 0: set on 45 % of a track's last five records, 2.6 % elsewhere.";
CM_ SG_ 1799 CONST_108_1 "Constant in the captured data.";
CM_ SG_ 1799 MOVE_STATE "Low two bits of the motion code. Full code = MOVE_STATE | (UNK_111_1 << 2): 0 moving forward, 1 slow or standing, 2 oncoming, 3 moving right, 4 moving left, 5 initializing, 7 stopped after moving.";
CM_ SG_ 1799 UNK_111_1 "Bit 2 of the motion code (see MOVE_STATE).";
CM_ SG_ 1799 UNK_112_3 "Camera-association state: 0 radar only, 1 (rarely 2-4) while the camera has the vehicle. By day non-zero on nearly all in-lane vehicles inside 40 m and almost never beyond 50 m; at night also at long range.";
CM_ SG_ 1799 UNK_115_5 "Class confidence in 5 % steps: mostly 0 while not yet classified (83 % of those rows), 4-20 otherwise (20 = 100 %); moves by one step per cycle on 95-96 % of its changes. A large vehicle is re-classified as a car when it falls to 5.";
CM_ SG_ 1799 UNK_120_3 "Raw; non-zero on 0.2 % of rows (mature cars).";
CM_ SG_ 1799 CONST_123_5 "Constant in the captured data.";
CM_ SG_ 1799 UNK_128_2 "Lane-assignment state, low bits (full = UNK_128_2 | UNK_130_1 << 2): 3 ego lane, 2 right lane, 4 left lane; 1, 5, 7 = no lane weights.";
CM_ SG_ 1799 UNK_130_1 "Lane-assignment state, bit 2 (see UNK_128_2).";
CM_ SG_ 1799 UNK_131_4 "Dominant lane weight: the largest of the three lane weights or one less (99.6 % of rows with a nonzero weight).";
CM_ SG_ 1799 CONST_135_1 "Constant in the captured data.";
CM_ SG_ 1799 UNK_136_4 "Camera-association confidence: 15 without association; restarts at 3-9 when UNK_112_3 becomes non-zero and climbs to 14.";
CM_ SG_ 1799 UNK_140_3 "Object class, second encoding of UNK_163_3: 0, 5, 7, 1, 3, 4 = class 1, 2, 3, 4, 5, 6.";
CM_ SG_ 1799 CONST_143_5 "Constant in the captured data.";
CM_ SG_ 1799 UNK_148_8 "Lane weights in 1/15 steps: low nibble (148|4) right lane, high nibble (152|4) left lane. With UNK_156_4 (ego lane) they sum to 15 or 16 whenever any is nonzero.";
CM_ SG_ 1799 UNK_156_4 "Ego-lane weight in 1/15 steps (see UNK_148_8).";
CM_ SG_ 1799 CONST_160_3 "Constant in the captured data.";
CM_ SG_ 1799 UNK_163_3 "Object class: 1 not yet classified, 2 car, 3 large vehicle, 4 pedestrian, 5 provisional (cyclist / person associations), 6 two-wheeler.";
CM_ SG_ 1799 UNK_166_2 "Raw, unnamed.";
CM_ SG_ 1799 UNK_168_10 "All ones or all zeros (768 / 832 rare): five sticky per-track latches by age mod 5; a phase latches on a cycle without a near-scan measurement, so most tracks born far out have it set from birth.";
CM_ SG_ 1799 CONST_178_3 "Constant in the captured data.";
CM_ SG_ 1799 UNK_181_1 "Daylight latch: one of five sticky per-track latches by age mod 5 (a phase latches after an existence dip); set on a quarter of mature vehicle rows by day, 2 of 59,988 night rows.";
CM_ SG_ 1799 UNK_182_1 "Raw, unnamed.";
CM_ SG_ 1799 UNK_183_7 "Bit 183: velocity re-initialisation latch (five sticky per-track latches by age mod 5); bits 184-189 are the low bits of a secondary score byte 184|8 (percent: 100 on 98 % of rows; lower mostly on young tracks, far lateral objects and stationary large vehicles / pedestrians).";
CM_ SG_ 1799 UNK_190_10 "Bits 190-191 = top of the secondary score byte 184|8; bits 192-199 are zero.";
CM_ SG_ 1799 UNK_200_7 "Orientation uncertainty: about 3.1 * UNK_248_7 / speed (m/s) on moving objects; 63 for stopped objects, 127 sentinel. Keep all seven bits.";
CM_ SG_ 1799 CONST_207_1 "Constant in the captured data.";
CM_ SG_ 1799 UNK_208_6 "Coarse heading over ground, left positive, about pi/64 rad per code: matches floor(max(atan2(vy, vx), 0) * 64 / pi) on 98 % of settled moving samples; can update while both velocity codes hold.";
CM_ SG_ 1799 CONST_214_2 "Constant in the captured data.";
CM_ SG_ 1799 UNK_216_6 "Object width, about (code + 1) * 0.1 m: car ~1.8 m, large vehicle ~2.0 m, two-wheeler ~0.7 m, pedestrian ~0.5 m.";
CM_ SG_ 1799 CONST_222_2 "Constant in the captured data.";
CM_ SG_ 1799 UNK_224_7 "Range standard deviation (sigma dRel), about 0.23 m per count (0.24 below 40 m; beyond 40 m a 4-8 m error floor dominates): grows with range, shrinks with track age.";
CM_ SG_ 1799 CONST_231_1 "Constant in the captured data.";
CM_ SG_ 1799 UNK_232_8 "Lateral standard deviation (sigma yRel), about 0.10 m per count: grows with |yRel|, shrinks with age. Eight bits: far young tracks reach 128-255 (255 = saturated).";
CM_ SG_ 1799 UNK_240_7 "Longitudinal velocity standard deviation (sigma vx), about 0.043-0.045 m/s per count against the ACC target: grows with range, higher during velocity excursions below 40 m. 127 accompanies saturated velocity.";
CM_ SG_ 1799 CONST_247_1 "Constant in the captured data.";
CM_ SG_ 1799 UNK_248_7 "Lateral velocity standard deviation (sigma vy), linear in the code: about 0.085 + 0.03 m/s per count against stationary objects, about 0.09 per count on moving leads.";
CM_ SG_ 1799 CONST_255_1 "Constant in the captured data.";
CM_ SG_ 1799 UNK_256_8 "Longitudinal-acceleration uncertainty (sigma ax candidate): grows with the spread between ALONG_LIKE_84 and the track's own speed slope (about 0.06-0.07 m/s^2 per code pooled); within a range band it grades that spread only within about 20 m.";
CM_ SG_ 1799 UNK_264_8 "Lateral-acceleration uncertainty (sigma ay candidate), covariance-like: moves with UNK_248_7 in every range band and shrinks with track age (about 11 at age 5-10, 2 from age 60).";
CM_ SG_ 1799 UNK_272_5 "Coarse length code: about round(length / 0.555 m) for vehicles (within one code on 91 %); not a length for pedestrians / two-wheelers.";
CM_ SG_ 1799 UNK_277_11 "Raw; bit 277 rarely set on newborn tracks.";
CM_ BO_ 1800 "Reassembled 0x80 object slot 8 (record bytes 305-340), sent only when occupied. Little-endian bit field: bit 0 = LSB of slot byte 0.";
CM_ SG_ 1800 STATE_CODE "Track state: 0 deleted (the track's final age-0 record), 1 measured, 2 coasting (predicted without a new measurement). While 2, SCORE_CODE drops by 20 (or 1) per cycle.";
CM_ SG_ 1800 SLOT_INDEX_CODE "Physical slot index 0-19; 63 when the slot is unallocated.";
CM_ SG_ 1800 UNK_8_6 "Bits 8-12: startup code, min(30, floor(31 * (2/3)^max(age - 4, 0))) while the motion code is 5 (initializing). Bit 13: separate raw flag.";
CM_ SG_ 1800 ONCOMING_FLAG "Oncoming-like internal motion state. Can persist after slowing and reset before the native allocation ends.";
CM_ SG_ 1800 UNK_15_1 "Placeholder flag: set exactly on the age-1 first output whose range, lateral and size codes are placeholders.";
CM_ SG_ 1800 SCORE_CODE "Existence probability, percent (10-100): can decline in either state; drops by exactly 20 (or 1) per cycle in state 2 and may stay lowered after a return to state 1. Bits 20-22 are its bits 4-6 (score // 16). The slot is freed near 20.";
CM_ SG_ 1800 AGE "Track age in radar cycles (60 ms): 1 at birth, saturates at 126; 0 = slot retiring. A restart is a new track. Converged from about 60.";
CM_ SG_ 1800 CONST_31_1 "Constant in the captured data.";
CM_ SG_ 1800 DREL "Distance forward of the radar, m: (code - 160) / 16. Add 1.52 m (openpilot's RADAR_TO_CAMERA) for a camera-referenced distance; radard compares radar dRel with the vision distance minus 1.52 m.";
CM_ SG_ 1800 YREL_LEFT "Lateral offset, m, left positive: (code - 2048) * 0.015. |code - 2048| >= 2000 is a sentinel.";
CM_ SG_ 1800 UNK_56_7 "Object length, about 0.1 m per code: car ~4.9 m, large vehicle ~5.7 m, two-wheeler ~1.7 m, pedestrian ~0.4 m.";
CM_ SG_ 1800 UNK_63_1 "Raw, unnamed.";
CM_ SG_ 1800 VLONG_OVER_GROUND "Longitudinal velocity over ground, m/s: (code - 510.5) * 0.15. vRel = this - ego speed. Code 1023 is a saturated reading.";
CM_ SG_ 1800 VLAT_OVER_GROUND_PROV "Lateral velocity over ground, m/s, left positive: (code - 510.5) * about 0.142-0.155 (0.15 used).";
CM_ SG_ 1800 ALONG_LIKE_84 "Longitudinal acceleration over ground, filtered: (code - 510.3) * about 0.04-0.09 m/s^2 with ego stopped (estimate depends on drives and estimator); follows the track's own speed by about 0.3 s; moves by about 0.4 of ego's acceleration.";
CM_ SG_ 1800 CONST_94_2 "Constant in the captured data.";
CM_ SG_ 1800 UNK_96 "Lateral acceleration over ground, filtered: (code - 511) * 0.05 m/s^2; follows the kinematic value by about 0.5 s.";
CM_ SG_ 1800 UNK_106_1 "Raw, unnamed.";
CM_ SG_ 1800 UNK_107_1 "Predicted record (the radar's own prediction), like Tesla's Meas = 0: set on 45 % of a track's last five records, 2.6 % elsewhere.";
CM_ SG_ 1800 CONST_108_1 "Constant in the captured data.";
CM_ SG_ 1800 MOVE_STATE "Low two bits of the motion code. Full code = MOVE_STATE | (UNK_111_1 << 2): 0 moving forward, 1 slow or standing, 2 oncoming, 3 moving right, 4 moving left, 5 initializing, 7 stopped after moving.";
CM_ SG_ 1800 UNK_111_1 "Bit 2 of the motion code (see MOVE_STATE).";
CM_ SG_ 1800 UNK_112_3 "Camera-association state: 0 radar only, 1 (rarely 2-4) while the camera has the vehicle. By day non-zero on nearly all in-lane vehicles inside 40 m and almost never beyond 50 m; at night also at long range.";
CM_ SG_ 1800 UNK_115_5 "Class confidence in 5 % steps: mostly 0 while not yet classified (83 % of those rows), 4-20 otherwise (20 = 100 %); moves by one step per cycle on 95-96 % of its changes. A large vehicle is re-classified as a car when it falls to 5.";
CM_ SG_ 1800 UNK_120_3 "Raw; non-zero on 0.2 % of rows (mature cars).";
CM_ SG_ 1800 CONST_123_5 "Constant in the captured data.";
CM_ SG_ 1800 UNK_128_2 "Lane-assignment state, low bits (full = UNK_128_2 | UNK_130_1 << 2): 3 ego lane, 2 right lane, 4 left lane; 1, 5, 7 = no lane weights.";
CM_ SG_ 1800 UNK_130_1 "Lane-assignment state, bit 2 (see UNK_128_2).";
CM_ SG_ 1800 UNK_131_4 "Dominant lane weight: the largest of the three lane weights or one less (99.6 % of rows with a nonzero weight).";
CM_ SG_ 1800 CONST_135_1 "Constant in the captured data.";
CM_ SG_ 1800 UNK_136_4 "Camera-association confidence: 15 without association; restarts at 3-9 when UNK_112_3 becomes non-zero and climbs to 14.";
CM_ SG_ 1800 UNK_140_3 "Object class, second encoding of UNK_163_3: 0, 5, 7, 1, 3, 4 = class 1, 2, 3, 4, 5, 6.";
CM_ SG_ 1800 CONST_143_5 "Constant in the captured data.";
CM_ SG_ 1800 UNK_148_8 "Lane weights in 1/15 steps: low nibble (148|4) right lane, high nibble (152|4) left lane. With UNK_156_4 (ego lane) they sum to 15 or 16 whenever any is nonzero.";
CM_ SG_ 1800 UNK_156_4 "Ego-lane weight in 1/15 steps (see UNK_148_8).";
CM_ SG_ 1800 CONST_160_3 "Constant in the captured data.";
CM_ SG_ 1800 UNK_163_3 "Object class: 1 not yet classified, 2 car, 3 large vehicle, 4 pedestrian, 5 provisional (cyclist / person associations), 6 two-wheeler.";
CM_ SG_ 1800 UNK_166_2 "Raw, unnamed.";
CM_ SG_ 1800 UNK_168_10 "All ones or all zeros (768 / 832 rare): five sticky per-track latches by age mod 5; a phase latches on a cycle without a near-scan measurement, so most tracks born far out have it set from birth.";
CM_ SG_ 1800 CONST_178_3 "Constant in the captured data.";
CM_ SG_ 1800 UNK_181_1 "Daylight latch: one of five sticky per-track latches by age mod 5 (a phase latches after an existence dip); set on a quarter of mature vehicle rows by day, 2 of 59,988 night rows.";
CM_ SG_ 1800 UNK_182_1 "Raw, unnamed.";
CM_ SG_ 1800 UNK_183_7 "Bit 183: velocity re-initialisation latch (five sticky per-track latches by age mod 5); bits 184-189 are the low bits of a secondary score byte 184|8 (percent: 100 on 98 % of rows; lower mostly on young tracks, far lateral objects and stationary large vehicles / pedestrians).";
CM_ SG_ 1800 UNK_190_10 "Bits 190-191 = top of the secondary score byte 184|8; bits 192-199 are zero.";
CM_ SG_ 1800 UNK_200_7 "Orientation uncertainty: about 3.1 * UNK_248_7 / speed (m/s) on moving objects; 63 for stopped objects, 127 sentinel. Keep all seven bits.";
CM_ SG_ 1800 CONST_207_1 "Constant in the captured data.";
CM_ SG_ 1800 UNK_208_6 "Coarse heading over ground, left positive, about pi/64 rad per code: matches floor(max(atan2(vy, vx), 0) * 64 / pi) on 98 % of settled moving samples; can update while both velocity codes hold.";
CM_ SG_ 1800 CONST_214_2 "Constant in the captured data.";
CM_ SG_ 1800 UNK_216_6 "Object width, about (code + 1) * 0.1 m: car ~1.8 m, large vehicle ~2.0 m, two-wheeler ~0.7 m, pedestrian ~0.5 m.";
CM_ SG_ 1800 CONST_222_2 "Constant in the captured data.";
CM_ SG_ 1800 UNK_224_7 "Range standard deviation (sigma dRel), about 0.23 m per count (0.24 below 40 m; beyond 40 m a 4-8 m error floor dominates): grows with range, shrinks with track age.";
CM_ SG_ 1800 CONST_231_1 "Constant in the captured data.";
CM_ SG_ 1800 UNK_232_8 "Lateral standard deviation (sigma yRel), about 0.10 m per count: grows with |yRel|, shrinks with age. Eight bits: far young tracks reach 128-255 (255 = saturated).";
CM_ SG_ 1800 UNK_240_7 "Longitudinal velocity standard deviation (sigma vx), about 0.043-0.045 m/s per count against the ACC target: grows with range, higher during velocity excursions below 40 m. 127 accompanies saturated velocity.";
CM_ SG_ 1800 CONST_247_1 "Constant in the captured data.";
CM_ SG_ 1800 UNK_248_7 "Lateral velocity standard deviation (sigma vy), linear in the code: about 0.085 + 0.03 m/s per count against stationary objects, about 0.09 per count on moving leads.";
CM_ SG_ 1800 CONST_255_1 "Constant in the captured data.";
CM_ SG_ 1800 UNK_256_8 "Longitudinal-acceleration uncertainty (sigma ax candidate): grows with the spread between ALONG_LIKE_84 and the track's own speed slope (about 0.06-0.07 m/s^2 per code pooled); within a range band it grades that spread only within about 20 m.";
CM_ SG_ 1800 UNK_264_8 "Lateral-acceleration uncertainty (sigma ay candidate), covariance-like: moves with UNK_248_7 in every range band and shrinks with track age (about 11 at age 5-10, 2 from age 60).";
CM_ SG_ 1800 UNK_272_5 "Coarse length code: about round(length / 0.555 m) for vehicles (within one code on 91 %); not a length for pedestrians / two-wheelers.";
CM_ SG_ 1800 UNK_277_11 "Raw; bit 277 rarely set on newborn tracks.";
CM_ BO_ 1801 "Reassembled 0x80 object slot 9 (record bytes 341-376), sent only when occupied. Little-endian bit field: bit 0 = LSB of slot byte 0.";
CM_ SG_ 1801 STATE_CODE "Track state: 0 deleted (the track's final age-0 record), 1 measured, 2 coasting (predicted without a new measurement). While 2, SCORE_CODE drops by 20 (or 1) per cycle.";
CM_ SG_ 1801 SLOT_INDEX_CODE "Physical slot index 0-19; 63 when the slot is unallocated.";
CM_ SG_ 1801 UNK_8_6 "Bits 8-12: startup code, min(30, floor(31 * (2/3)^max(age - 4, 0))) while the motion code is 5 (initializing). Bit 13: separate raw flag.";
CM_ SG_ 1801 ONCOMING_FLAG "Oncoming-like internal motion state. Can persist after slowing and reset before the native allocation ends.";
CM_ SG_ 1801 UNK_15_1 "Placeholder flag: set exactly on the age-1 first output whose range, lateral and size codes are placeholders.";
CM_ SG_ 1801 SCORE_CODE "Existence probability, percent (10-100): can decline in either state; drops by exactly 20 (or 1) per cycle in state 2 and may stay lowered after a return to state 1. Bits 20-22 are its bits 4-6 (score // 16). The slot is freed near 20.";
CM_ SG_ 1801 AGE "Track age in radar cycles (60 ms): 1 at birth, saturates at 126; 0 = slot retiring. A restart is a new track. Converged from about 60.";
CM_ SG_ 1801 CONST_31_1 "Constant in the captured data.";
CM_ SG_ 1801 DREL "Distance forward of the radar, m: (code - 160) / 16. Add 1.52 m (openpilot's RADAR_TO_CAMERA) for a camera-referenced distance; radard compares radar dRel with the vision distance minus 1.52 m.";
CM_ SG_ 1801 YREL_LEFT "Lateral offset, m, left positive: (code - 2048) * 0.015. |code - 2048| >= 2000 is a sentinel.";
CM_ SG_ 1801 UNK_56_7 "Object length, about 0.1 m per code: car ~4.9 m, large vehicle ~5.7 m, two-wheeler ~1.7 m, pedestrian ~0.4 m.";
CM_ SG_ 1801 UNK_63_1 "Raw, unnamed.";
CM_ SG_ 1801 VLONG_OVER_GROUND "Longitudinal velocity over ground, m/s: (code - 510.5) * 0.15. vRel = this - ego speed. Code 1023 is a saturated reading.";
CM_ SG_ 1801 VLAT_OVER_GROUND_PROV "Lateral velocity over ground, m/s, left positive: (code - 510.5) * about 0.142-0.155 (0.15 used).";
CM_ SG_ 1801 ALONG_LIKE_84 "Longitudinal acceleration over ground, filtered: (code - 510.3) * about 0.04-0.09 m/s^2 with ego stopped (estimate depends on drives and estimator); follows the track's own speed by about 0.3 s; moves by about 0.4 of ego's acceleration.";
CM_ SG_ 1801 CONST_94_2 "Constant in the captured data.";
CM_ SG_ 1801 UNK_96 "Lateral acceleration over ground, filtered: (code - 511) * 0.05 m/s^2; follows the kinematic value by about 0.5 s.";
CM_ SG_ 1801 UNK_106_1 "Raw, unnamed.";
CM_ SG_ 1801 UNK_107_1 "Predicted record (the radar's own prediction), like Tesla's Meas = 0: set on 45 % of a track's last five records, 2.6 % elsewhere.";
CM_ SG_ 1801 CONST_108_1 "Constant in the captured data.";
CM_ SG_ 1801 MOVE_STATE "Low two bits of the motion code. Full code = MOVE_STATE | (UNK_111_1 << 2): 0 moving forward, 1 slow or standing, 2 oncoming, 3 moving right, 4 moving left, 5 initializing, 7 stopped after moving.";
CM_ SG_ 1801 UNK_111_1 "Bit 2 of the motion code (see MOVE_STATE).";
CM_ SG_ 1801 UNK_112_3 "Camera-association state: 0 radar only, 1 (rarely 2-4) while the camera has the vehicle. By day non-zero on nearly all in-lane vehicles inside 40 m and almost never beyond 50 m; at night also at long range.";
CM_ SG_ 1801 UNK_115_5 "Class confidence in 5 % steps: mostly 0 while not yet classified (83 % of those rows), 4-20 otherwise (20 = 100 %); moves by one step per cycle on 95-96 % of its changes. A large vehicle is re-classified as a car when it falls to 5.";
CM_ SG_ 1801 UNK_120_3 "Raw; non-zero on 0.2 % of rows (mature cars).";
CM_ SG_ 1801 CONST_123_5 "Constant in the captured data.";
CM_ SG_ 1801 UNK_128_2 "Lane-assignment state, low bits (full = UNK_128_2 | UNK_130_1 << 2): 3 ego lane, 2 right lane, 4 left lane; 1, 5, 7 = no lane weights.";
CM_ SG_ 1801 UNK_130_1 "Lane-assignment state, bit 2 (see UNK_128_2).";
CM_ SG_ 1801 UNK_131_4 "Dominant lane weight: the largest of the three lane weights or one less (99.6 % of rows with a nonzero weight).";
CM_ SG_ 1801 CONST_135_1 "Constant in the captured data.";
CM_ SG_ 1801 UNK_136_4 "Camera-association confidence: 15 without association; restarts at 3-9 when UNK_112_3 becomes non-zero and climbs to 14.";
CM_ SG_ 1801 UNK_140_3 "Object class, second encoding of UNK_163_3: 0, 5, 7, 1, 3, 4 = class 1, 2, 3, 4, 5, 6.";
CM_ SG_ 1801 CONST_143_5 "Constant in the captured data.";
CM_ SG_ 1801 UNK_148_8 "Lane weights in 1/15 steps: low nibble (148|4) right lane, high nibble (152|4) left lane. With UNK_156_4 (ego lane) they sum to 15 or 16 whenever any is nonzero.";
CM_ SG_ 1801 UNK_156_4 "Ego-lane weight in 1/15 steps (see UNK_148_8).";
CM_ SG_ 1801 CONST_160_3 "Constant in the captured data.";
CM_ SG_ 1801 UNK_163_3 "Object class: 1 not yet classified, 2 car, 3 large vehicle, 4 pedestrian, 5 provisional (cyclist / person associations), 6 two-wheeler.";
CM_ SG_ 1801 UNK_166_2 "Raw, unnamed.";
CM_ SG_ 1801 UNK_168_10 "All ones or all zeros (768 / 832 rare): five sticky per-track latches by age mod 5; a phase latches on a cycle without a near-scan measurement, so most tracks born far out have it set from birth.";
CM_ SG_ 1801 CONST_178_3 "Constant in the captured data.";
CM_ SG_ 1801 UNK_181_1 "Daylight latch: one of five sticky per-track latches by age mod 5 (a phase latches after an existence dip); set on a quarter of mature vehicle rows by day, 2 of 59,988 night rows.";
CM_ SG_ 1801 UNK_182_1 "Raw, unnamed.";
CM_ SG_ 1801 UNK_183_7 "Bit 183: velocity re-initialisation latch (five sticky per-track latches by age mod 5); bits 184-189 are the low bits of a secondary score byte 184|8 (percent: 100 on 98 % of rows; lower mostly on young tracks, far lateral objects and stationary large vehicles / pedestrians).";
CM_ SG_ 1801 UNK_190_10 "Bits 190-191 = top of the secondary score byte 184|8; bits 192-199 are zero.";
CM_ SG_ 1801 UNK_200_7 "Orientation uncertainty: about 3.1 * UNK_248_7 / speed (m/s) on moving objects; 63 for stopped objects, 127 sentinel. Keep all seven bits.";
CM_ SG_ 1801 CONST_207_1 "Constant in the captured data.";
CM_ SG_ 1801 UNK_208_6 "Coarse heading over ground, left positive, about pi/64 rad per code: matches floor(max(atan2(vy, vx), 0) * 64 / pi) on 98 % of settled moving samples; can update while both velocity codes hold.";
CM_ SG_ 1801 CONST_214_2 "Constant in the captured data.";
CM_ SG_ 1801 UNK_216_6 "Object width, about (code + 1) * 0.1 m: car ~1.8 m, large vehicle ~2.0 m, two-wheeler ~0.7 m, pedestrian ~0.5 m.";
CM_ SG_ 1801 CONST_222_2 "Constant in the captured data.";
CM_ SG_ 1801 UNK_224_7 "Range standard deviation (sigma dRel), about 0.23 m per count (0.24 below 40 m; beyond 40 m a 4-8 m error floor dominates): grows with range, shrinks with track age.";
CM_ SG_ 1801 CONST_231_1 "Constant in the captured data.";
CM_ SG_ 1801 UNK_232_8 "Lateral standard deviation (sigma yRel), about 0.10 m per count: grows with |yRel|, shrinks with age. Eight bits: far young tracks reach 128-255 (255 = saturated).";
CM_ SG_ 1801 UNK_240_7 "Longitudinal velocity standard deviation (sigma vx), about 0.043-0.045 m/s per count against the ACC target: grows with range, higher during velocity excursions below 40 m. 127 accompanies saturated velocity.";
CM_ SG_ 1801 CONST_247_1 "Constant in the captured data.";
CM_ SG_ 1801 UNK_248_7 "Lateral velocity standard deviation (sigma vy), linear in the code: about 0.085 + 0.03 m/s per count against stationary objects, about 0.09 per count on moving leads.";
CM_ SG_ 1801 CONST_255_1 "Constant in the captured data.";
CM_ SG_ 1801 UNK_256_8 "Longitudinal-acceleration uncertainty (sigma ax candidate): grows with the spread between ALONG_LIKE_84 and the track's own speed slope (about 0.06-0.07 m/s^2 per code pooled); within a range band it grades that spread only within about 20 m.";
CM_ SG_ 1801 UNK_264_8 "Lateral-acceleration uncertainty (sigma ay candidate), covariance-like: moves with UNK_248_7 in every range band and shrinks with track age (about 11 at age 5-10, 2 from age 60).";
CM_ SG_ 1801 UNK_272_5 "Coarse length code: about round(length / 0.555 m) for vehicles (within one code on 91 %); not a length for pedestrians / two-wheelers.";
CM_ SG_ 1801 UNK_277_11 "Raw; bit 277 rarely set on newborn tracks.";
CM_ BO_ 1802 "Reassembled 0x80 object slot 10 (record bytes 377-412), sent only when occupied. Little-endian bit field: bit 0 = LSB of slot byte 0.";
CM_ SG_ 1802 STATE_CODE "Track state: 0 deleted (the track's final age-0 record), 1 measured, 2 coasting (predicted without a new measurement). While 2, SCORE_CODE drops by 20 (or 1) per cycle.";
CM_ SG_ 1802 SLOT_INDEX_CODE "Physical slot index 0-19; 63 when the slot is unallocated.";
CM_ SG_ 1802 UNK_8_6 "Bits 8-12: startup code, min(30, floor(31 * (2/3)^max(age - 4, 0))) while the motion code is 5 (initializing). Bit 13: separate raw flag.";
CM_ SG_ 1802 ONCOMING_FLAG "Oncoming-like internal motion state. Can persist after slowing and reset before the native allocation ends.";
CM_ SG_ 1802 UNK_15_1 "Placeholder flag: set exactly on the age-1 first output whose range, lateral and size codes are placeholders.";
CM_ SG_ 1802 SCORE_CODE "Existence probability, percent (10-100): can decline in either state; drops by exactly 20 (or 1) per cycle in state 2 and may stay lowered after a return to state 1. Bits 20-22 are its bits 4-6 (score // 16). The slot is freed near 20.";
CM_ SG_ 1802 AGE "Track age in radar cycles (60 ms): 1 at birth, saturates at 126; 0 = slot retiring. A restart is a new track. Converged from about 60.";
CM_ SG_ 1802 CONST_31_1 "Constant in the captured data.";
CM_ SG_ 1802 DREL "Distance forward of the radar, m: (code - 160) / 16. Add 1.52 m (openpilot's RADAR_TO_CAMERA) for a camera-referenced distance; radard compares radar dRel with the vision distance minus 1.52 m.";
CM_ SG_ 1802 YREL_LEFT "Lateral offset, m, left positive: (code - 2048) * 0.015. |code - 2048| >= 2000 is a sentinel.";
CM_ SG_ 1802 UNK_56_7 "Object length, about 0.1 m per code: car ~4.9 m, large vehicle ~5.7 m, two-wheeler ~1.7 m, pedestrian ~0.4 m.";
CM_ SG_ 1802 UNK_63_1 "Raw, unnamed.";
CM_ SG_ 1802 VLONG_OVER_GROUND "Longitudinal velocity over ground, m/s: (code - 510.5) * 0.15. vRel = this - ego speed. Code 1023 is a saturated reading.";
CM_ SG_ 1802 VLAT_OVER_GROUND_PROV "Lateral velocity over ground, m/s, left positive: (code - 510.5) * about 0.142-0.155 (0.15 used).";
CM_ SG_ 1802 ALONG_LIKE_84 "Longitudinal acceleration over ground, filtered: (code - 510.3) * about 0.04-0.09 m/s^2 with ego stopped (estimate depends on drives and estimator); follows the track's own speed by about 0.3 s; moves by about 0.4 of ego's acceleration.";
CM_ SG_ 1802 CONST_94_2 "Constant in the captured data.";
CM_ SG_ 1802 UNK_96 "Lateral acceleration over ground, filtered: (code - 511) * 0.05 m/s^2; follows the kinematic value by about 0.5 s.";
CM_ SG_ 1802 UNK_106_1 "Raw, unnamed.";
CM_ SG_ 1802 UNK_107_1 "Predicted record (the radar's own prediction), like Tesla's Meas = 0: set on 45 % of a track's last five records, 2.6 % elsewhere.";
CM_ SG_ 1802 CONST_108_1 "Constant in the captured data.";
CM_ SG_ 1802 MOVE_STATE "Low two bits of the motion code. Full code = MOVE_STATE | (UNK_111_1 << 2): 0 moving forward, 1 slow or standing, 2 oncoming, 3 moving right, 4 moving left, 5 initializing, 7 stopped after moving.";
CM_ SG_ 1802 UNK_111_1 "Bit 2 of the motion code (see MOVE_STATE).";
CM_ SG_ 1802 UNK_112_3 "Camera-association state: 0 radar only, 1 (rarely 2-4) while the camera has the vehicle. By day non-zero on nearly all in-lane vehicles inside 40 m and almost never beyond 50 m; at night also at long range.";
CM_ SG_ 1802 UNK_115_5 "Class confidence in 5 % steps: mostly 0 while not yet classified (83 % of those rows), 4-20 otherwise (20 = 100 %); moves by one step per cycle on 95-96 % of its changes. A large vehicle is re-classified as a car when it falls to 5.";
CM_ SG_ 1802 UNK_120_3 "Raw; non-zero on 0.2 % of rows (mature cars).";
CM_ SG_ 1802 CONST_123_5 "Constant in the captured data.";
CM_ SG_ 1802 UNK_128_2 "Lane-assignment state, low bits (full = UNK_128_2 | UNK_130_1 << 2): 3 ego lane, 2 right lane, 4 left lane; 1, 5, 7 = no lane weights.";
CM_ SG_ 1802 UNK_130_1 "Lane-assignment state, bit 2 (see UNK_128_2).";
CM_ SG_ 1802 UNK_131_4 "Dominant lane weight: the largest of the three lane weights or one less (99.6 % of rows with a nonzero weight).";
CM_ SG_ 1802 CONST_135_1 "Constant in the captured data.";
CM_ SG_ 1802 UNK_136_4 "Camera-association confidence: 15 without association; restarts at 3-9 when UNK_112_3 becomes non-zero and climbs to 14.";
CM_ SG_ 1802 UNK_140_3 "Object class, second encoding of UNK_163_3: 0, 5, 7, 1, 3, 4 = class 1, 2, 3, 4, 5, 6.";
CM_ SG_ 1802 CONST_143_5 "Constant in the captured data.";
CM_ SG_ 1802 UNK_148_8 "Lane weights in 1/15 steps: low nibble (148|4) right lane, high nibble (152|4) left lane. With UNK_156_4 (ego lane) they sum to 15 or 16 whenever any is nonzero.";
CM_ SG_ 1802 UNK_156_4 "Ego-lane weight in 1/15 steps (see UNK_148_8).";
CM_ SG_ 1802 CONST_160_3 "Constant in the captured data.";
CM_ SG_ 1802 UNK_163_3 "Object class: 1 not yet classified, 2 car, 3 large vehicle, 4 pedestrian, 5 provisional (cyclist / person associations), 6 two-wheeler.";
CM_ SG_ 1802 UNK_166_2 "Raw, unnamed.";
CM_ SG_ 1802 UNK_168_10 "All ones or all zeros (768 / 832 rare): five sticky per-track latches by age mod 5; a phase latches on a cycle without a near-scan measurement, so most tracks born far out have it set from birth.";
CM_ SG_ 1802 CONST_178_3 "Constant in the captured data.";
CM_ SG_ 1802 UNK_181_1 "Daylight latch: one of five sticky per-track latches by age mod 5 (a phase latches after an existence dip); set on a quarter of mature vehicle rows by day, 2 of 59,988 night rows.";
CM_ SG_ 1802 UNK_182_1 "Raw, unnamed.";
CM_ SG_ 1802 UNK_183_7 "Bit 183: velocity re-initialisation latch (five sticky per-track latches by age mod 5); bits 184-189 are the low bits of a secondary score byte 184|8 (percent: 100 on 98 % of rows; lower mostly on young tracks, far lateral objects and stationary large vehicles / pedestrians).";
CM_ SG_ 1802 UNK_190_10 "Bits 190-191 = top of the secondary score byte 184|8; bits 192-199 are zero.";
CM_ SG_ 1802 UNK_200_7 "Orientation uncertainty: about 3.1 * UNK_248_7 / speed (m/s) on moving objects; 63 for stopped objects, 127 sentinel. Keep all seven bits.";
CM_ SG_ 1802 CONST_207_1 "Constant in the captured data.";
CM_ SG_ 1802 UNK_208_6 "Coarse heading over ground, left positive, about pi/64 rad per code: matches floor(max(atan2(vy, vx), 0) * 64 / pi) on 98 % of settled moving samples; can update while both velocity codes hold.";
CM_ SG_ 1802 CONST_214_2 "Constant in the captured data.";
CM_ SG_ 1802 UNK_216_6 "Object width, about (code + 1) * 0.1 m: car ~1.8 m, large vehicle ~2.0 m, two-wheeler ~0.7 m, pedestrian ~0.5 m.";
CM_ SG_ 1802 CONST_222_2 "Constant in the captured data.";
CM_ SG_ 1802 UNK_224_7 "Range standard deviation (sigma dRel), about 0.23 m per count (0.24 below 40 m; beyond 40 m a 4-8 m error floor dominates): grows with range, shrinks with track age.";
CM_ SG_ 1802 CONST_231_1 "Constant in the captured data.";
CM_ SG_ 1802 UNK_232_8 "Lateral standard deviation (sigma yRel), about 0.10 m per count: grows with |yRel|, shrinks with age. Eight bits: far young tracks reach 128-255 (255 = saturated).";
CM_ SG_ 1802 UNK_240_7 "Longitudinal velocity standard deviation (sigma vx), about 0.043-0.045 m/s per count against the ACC target: grows with range, higher during velocity excursions below 40 m. 127 accompanies saturated velocity.";
CM_ SG_ 1802 CONST_247_1 "Constant in the captured data.";
CM_ SG_ 1802 UNK_248_7 "Lateral velocity standard deviation (sigma vy), linear in the code: about 0.085 + 0.03 m/s per count against stationary objects, about 0.09 per count on moving leads.";
CM_ SG_ 1802 CONST_255_1 "Constant in the captured data.";
CM_ SG_ 1802 UNK_256_8 "Longitudinal-acceleration uncertainty (sigma ax candidate): grows with the spread between ALONG_LIKE_84 and the track's own speed slope (about 0.06-0.07 m/s^2 per code pooled); within a range band it grades that spread only within about 20 m.";
CM_ SG_ 1802 UNK_264_8 "Lateral-acceleration uncertainty (sigma ay candidate), covariance-like: moves with UNK_248_7 in every range band and shrinks with track age (about 11 at age 5-10, 2 from age 60).";
CM_ SG_ 1802 UNK_272_5 "Coarse length code: about round(length / 0.555 m) for vehicles (within one code on 91 %); not a length for pedestrians / two-wheelers.";
CM_ SG_ 1802 UNK_277_11 "Raw; bit 277 rarely set on newborn tracks.";
CM_ BO_ 1803 "Reassembled 0x80 object slot 11 (record bytes 413-448), sent only when occupied. Little-endian bit field: bit 0 = LSB of slot byte 0.";
CM_ SG_ 1803 STATE_CODE "Track state: 0 deleted (the track's final age-0 record), 1 measured, 2 coasting (predicted without a new measurement). While 2, SCORE_CODE drops by 20 (or 1) per cycle.";
CM_ SG_ 1803 SLOT_INDEX_CODE "Physical slot index 0-19; 63 when the slot is unallocated.";
CM_ SG_ 1803 UNK_8_6 "Bits 8-12: startup code, min(30, floor(31 * (2/3)^max(age - 4, 0))) while the motion code is 5 (initializing). Bit 13: separate raw flag.";
CM_ SG_ 1803 ONCOMING_FLAG "Oncoming-like internal motion state. Can persist after slowing and reset before the native allocation ends.";
CM_ SG_ 1803 UNK_15_1 "Placeholder flag: set exactly on the age-1 first output whose range, lateral and size codes are placeholders.";
CM_ SG_ 1803 SCORE_CODE "Existence probability, percent (10-100): can decline in either state; drops by exactly 20 (or 1) per cycle in state 2 and may stay lowered after a return to state 1. Bits 20-22 are its bits 4-6 (score // 16). The slot is freed near 20.";
CM_ SG_ 1803 AGE "Track age in radar cycles (60 ms): 1 at birth, saturates at 126; 0 = slot retiring. A restart is a new track. Converged from about 60.";
CM_ SG_ 1803 CONST_31_1 "Constant in the captured data.";
CM_ SG_ 1803 DREL "Distance forward of the radar, m: (code - 160) / 16. Add 1.52 m (openpilot's RADAR_TO_CAMERA) for a camera-referenced distance; radard compares radar dRel with the vision distance minus 1.52 m.";
CM_ SG_ 1803 YREL_LEFT "Lateral offset, m, left positive: (code - 2048) * 0.015. |code - 2048| >= 2000 is a sentinel.";
CM_ SG_ 1803 UNK_56_7 "Object length, about 0.1 m per code: car ~4.9 m, large vehicle ~5.7 m, two-wheeler ~1.7 m, pedestrian ~0.4 m.";
CM_ SG_ 1803 UNK_63_1 "Raw, unnamed.";
CM_ SG_ 1803 VLONG_OVER_GROUND "Longitudinal velocity over ground, m/s: (code - 510.5) * 0.15. vRel = this - ego speed. Code 1023 is a saturated reading.";
CM_ SG_ 1803 VLAT_OVER_GROUND_PROV "Lateral velocity over ground, m/s, left positive: (code - 510.5) * about 0.142-0.155 (0.15 used).";
CM_ SG_ 1803 ALONG_LIKE_84 "Longitudinal acceleration over ground, filtered: (code - 510.3) * about 0.04-0.09 m/s^2 with ego stopped (estimate depends on drives and estimator); follows the track's own speed by about 0.3 s; moves by about 0.4 of ego's acceleration.";
CM_ SG_ 1803 CONST_94_2 "Constant in the captured data.";
CM_ SG_ 1803 UNK_96 "Lateral acceleration over ground, filtered: (code - 511) * 0.05 m/s^2; follows the kinematic value by about 0.5 s.";
CM_ SG_ 1803 UNK_106_1 "Raw, unnamed.";
CM_ SG_ 1803 UNK_107_1 "Predicted record (the radar's own prediction), like Tesla's Meas = 0: set on 45 % of a track's last five records, 2.6 % elsewhere.";
CM_ SG_ 1803 CONST_108_1 "Constant in the captured data.";
CM_ SG_ 1803 MOVE_STATE "Low two bits of the motion code. Full code = MOVE_STATE | (UNK_111_1 << 2): 0 moving forward, 1 slow or standing, 2 oncoming, 3 moving right, 4 moving left, 5 initializing, 7 stopped after moving.";
CM_ SG_ 1803 UNK_111_1 "Bit 2 of the motion code (see MOVE_STATE).";
CM_ SG_ 1803 UNK_112_3 "Camera-association state: 0 radar only, 1 (rarely 2-4) while the camera has the vehicle. By day non-zero on nearly all in-lane vehicles inside 40 m and almost never beyond 50 m; at night also at long range.";
CM_ SG_ 1803 UNK_115_5 "Class confidence in 5 % steps: mostly 0 while not yet classified (83 % of those rows), 4-20 otherwise (20 = 100 %); moves by one step per cycle on 95-96 % of its changes. A large vehicle is re-classified as a car when it falls to 5.";
CM_ SG_ 1803 UNK_120_3 "Raw; non-zero on 0.2 % of rows (mature cars).";
CM_ SG_ 1803 CONST_123_5 "Constant in the captured data.";
CM_ SG_ 1803 UNK_128_2 "Lane-assignment state, low bits (full = UNK_128_2 | UNK_130_1 << 2): 3 ego lane, 2 right lane, 4 left lane; 1, 5, 7 = no lane weights.";
CM_ SG_ 1803 UNK_130_1 "Lane-assignment state, bit 2 (see UNK_128_2).";
CM_ SG_ 1803 UNK_131_4 "Dominant lane weight: the largest of the three lane weights or one less (99.6 % of rows with a nonzero weight).";
CM_ SG_ 1803 CONST_135_1 "Constant in the captured data.";
CM_ SG_ 1803 UNK_136_4 "Camera-association confidence: 15 without association; restarts at 3-9 when UNK_112_3 becomes non-zero and climbs to 14.";
CM_ SG_ 1803 UNK_140_3 "Object class, second encoding of UNK_163_3: 0, 5, 7, 1, 3, 4 = class 1, 2, 3, 4, 5, 6.";
CM_ SG_ 1803 CONST_143_5 "Constant in the captured data.";
CM_ SG_ 1803 UNK_148_8 "Lane weights in 1/15 steps: low nibble (148|4) right lane, high nibble (152|4) left lane. With UNK_156_4 (ego lane) they sum to 15 or 16 whenever any is nonzero.";
CM_ SG_ 1803 UNK_156_4 "Ego-lane weight in 1/15 steps (see UNK_148_8).";
CM_ SG_ 1803 CONST_160_3 "Constant in the captured data.";
CM_ SG_ 1803 UNK_163_3 "Object class: 1 not yet classified, 2 car, 3 large vehicle, 4 pedestrian, 5 provisional (cyclist / person associations), 6 two-wheeler.";
CM_ SG_ 1803 UNK_166_2 "Raw, unnamed.";
CM_ SG_ 1803 UNK_168_10 "All ones or all zeros (768 / 832 rare): five sticky per-track latches by age mod 5; a phase latches on a cycle without a near-scan measurement, so most tracks born far out have it set from birth.";
CM_ SG_ 1803 CONST_178_3 "Constant in the captured data.";
CM_ SG_ 1803 UNK_181_1 "Daylight latch: one of five sticky per-track latches by age mod 5 (a phase latches after an existence dip); set on a quarter of mature vehicle rows by day, 2 of 59,988 night rows.";
CM_ SG_ 1803 UNK_182_1 "Raw, unnamed.";
CM_ SG_ 1803 UNK_183_7 "Bit 183: velocity re-initialisation latch (five sticky per-track latches by age mod 5); bits 184-189 are the low bits of a secondary score byte 184|8 (percent: 100 on 98 % of rows; lower mostly on young tracks, far lateral objects and stationary large vehicles / pedestrians).";
CM_ SG_ 1803 UNK_190_10 "Bits 190-191 = top of the secondary score byte 184|8; bits 192-199 are zero.";
CM_ SG_ 1803 UNK_200_7 "Orientation uncertainty: about 3.1 * UNK_248_7 / speed (m/s) on moving objects; 63 for stopped objects, 127 sentinel. Keep all seven bits.";
CM_ SG_ 1803 CONST_207_1 "Constant in the captured data.";
CM_ SG_ 1803 UNK_208_6 "Coarse heading over ground, left positive, about pi/64 rad per code: matches floor(max(atan2(vy, vx), 0) * 64 / pi) on 98 % of settled moving samples; can update while both velocity codes hold.";
CM_ SG_ 1803 CONST_214_2 "Constant in the captured data.";
CM_ SG_ 1803 UNK_216_6 "Object width, about (code + 1) * 0.1 m: car ~1.8 m, large vehicle ~2.0 m, two-wheeler ~0.7 m, pedestrian ~0.5 m.";
CM_ SG_ 1803 CONST_222_2 "Constant in the captured data.";
CM_ SG_ 1803 UNK_224_7 "Range standard deviation (sigma dRel), about 0.23 m per count (0.24 below 40 m; beyond 40 m a 4-8 m error floor dominates): grows with range, shrinks with track age.";
CM_ SG_ 1803 CONST_231_1 "Constant in the captured data.";
CM_ SG_ 1803 UNK_232_8 "Lateral standard deviation (sigma yRel), about 0.10 m per count: grows with |yRel|, shrinks with age. Eight bits: far young tracks reach 128-255 (255 = saturated).";
CM_ SG_ 1803 UNK_240_7 "Longitudinal velocity standard deviation (sigma vx), about 0.043-0.045 m/s per count against the ACC target: grows with range, higher during velocity excursions below 40 m. 127 accompanies saturated velocity.";
CM_ SG_ 1803 CONST_247_1 "Constant in the captured data.";
CM_ SG_ 1803 UNK_248_7 "Lateral velocity standard deviation (sigma vy), linear in the code: about 0.085 + 0.03 m/s per count against stationary objects, about 0.09 per count on moving leads.";
CM_ SG_ 1803 CONST_255_1 "Constant in the captured data.";
CM_ SG_ 1803 UNK_256_8 "Longitudinal-acceleration uncertainty (sigma ax candidate): grows with the spread between ALONG_LIKE_84 and the track's own speed slope (about 0.06-0.07 m/s^2 per code pooled); within a range band it grades that spread only within about 20 m.";
CM_ SG_ 1803 UNK_264_8 "Lateral-acceleration uncertainty (sigma ay candidate), covariance-like: moves with UNK_248_7 in every range band and shrinks with track age (about 11 at age 5-10, 2 from age 60).";
CM_ SG_ 1803 UNK_272_5 "Coarse length code: about round(length / 0.555 m) for vehicles (within one code on 91 %); not a length for pedestrians / two-wheelers.";
CM_ SG_ 1803 UNK_277_11 "Raw; bit 277 rarely set on newborn tracks.";
CM_ BO_ 1804 "Reassembled 0x80 object slot 12 (record bytes 449-484), sent only when occupied. Little-endian bit field: bit 0 = LSB of slot byte 0.";
CM_ SG_ 1804 STATE_CODE "Track state: 0 deleted (the track's final age-0 record), 1 measured, 2 coasting (predicted without a new measurement). While 2, SCORE_CODE drops by 20 (or 1) per cycle.";
CM_ SG_ 1804 SLOT_INDEX_CODE "Physical slot index 0-19; 63 when the slot is unallocated.";
CM_ SG_ 1804 UNK_8_6 "Bits 8-12: startup code, min(30, floor(31 * (2/3)^max(age - 4, 0))) while the motion code is 5 (initializing). Bit 13: separate raw flag.";
CM_ SG_ 1804 ONCOMING_FLAG "Oncoming-like internal motion state. Can persist after slowing and reset before the native allocation ends.";
CM_ SG_ 1804 UNK_15_1 "Placeholder flag: set exactly on the age-1 first output whose range, lateral and size codes are placeholders.";
CM_ SG_ 1804 SCORE_CODE "Existence probability, percent (10-100): can decline in either state; drops by exactly 20 (or 1) per cycle in state 2 and may stay lowered after a return to state 1. Bits 20-22 are its bits 4-6 (score // 16). The slot is freed near 20.";
CM_ SG_ 1804 AGE "Track age in radar cycles (60 ms): 1 at birth, saturates at 126; 0 = slot retiring. A restart is a new track. Converged from about 60.";
CM_ SG_ 1804 CONST_31_1 "Constant in the captured data.";
CM_ SG_ 1804 DREL "Distance forward of the radar, m: (code - 160) / 16. Add 1.52 m (openpilot's RADAR_TO_CAMERA) for a camera-referenced distance; radard compares radar dRel with the vision distance minus 1.52 m.";
CM_ SG_ 1804 YREL_LEFT "Lateral offset, m, left positive: (code - 2048) * 0.015. |code - 2048| >= 2000 is a sentinel.";
CM_ SG_ 1804 UNK_56_7 "Object length, about 0.1 m per code: car ~4.9 m, large vehicle ~5.7 m, two-wheeler ~1.7 m, pedestrian ~0.4 m.";
CM_ SG_ 1804 UNK_63_1 "Raw, unnamed.";
CM_ SG_ 1804 VLONG_OVER_GROUND "Longitudinal velocity over ground, m/s: (code - 510.5) * 0.15. vRel = this - ego speed. Code 1023 is a saturated reading.";
CM_ SG_ 1804 VLAT_OVER_GROUND_PROV "Lateral velocity over ground, m/s, left positive: (code - 510.5) * about 0.142-0.155 (0.15 used).";
CM_ SG_ 1804 ALONG_LIKE_84 "Longitudinal acceleration over ground, filtered: (code - 510.3) * about 0.04-0.09 m/s^2 with ego stopped (estimate depends on drives and estimator); follows the track's own speed by about 0.3 s; moves by about 0.4 of ego's acceleration.";
CM_ SG_ 1804 CONST_94_2 "Constant in the captured data.";
CM_ SG_ 1804 UNK_96 "Lateral acceleration over ground, filtered: (code - 511) * 0.05 m/s^2; follows the kinematic value by about 0.5 s.";
CM_ SG_ 1804 UNK_106_1 "Raw, unnamed.";
CM_ SG_ 1804 UNK_107_1 "Predicted record (the radar's own prediction), like Tesla's Meas = 0: set on 45 % of a track's last five records, 2.6 % elsewhere.";
CM_ SG_ 1804 CONST_108_1 "Constant in the captured data.";
CM_ SG_ 1804 MOVE_STATE "Low two bits of the motion code. Full code = MOVE_STATE | (UNK_111_1 << 2): 0 moving forward, 1 slow or standing, 2 oncoming, 3 moving right, 4 moving left, 5 initializing, 7 stopped after moving.";
CM_ SG_ 1804 UNK_111_1 "Bit 2 of the motion code (see MOVE_STATE).";
CM_ SG_ 1804 UNK_112_3 "Camera-association state: 0 radar only, 1 (rarely 2-4) while the camera has the vehicle. By day non-zero on nearly all in-lane vehicles inside 40 m and almost never beyond 50 m; at night also at long range.";
CM_ SG_ 1804 UNK_115_5 "Class confidence in 5 % steps: mostly 0 while not yet classified (83 % of those rows), 4-20 otherwise (20 = 100 %); moves by one step per cycle on 95-96 % of its changes. A large vehicle is re-classified as a car when it falls to 5.";
CM_ SG_ 1804 UNK_120_3 "Raw; non-zero on 0.2 % of rows (mature cars).";
CM_ SG_ 1804 CONST_123_5 "Constant in the captured data.";
CM_ SG_ 1804 UNK_128_2 "Lane-assignment state, low bits (full = UNK_128_2 | UNK_130_1 << 2): 3 ego lane, 2 right lane, 4 left lane; 1, 5, 7 = no lane weights.";
CM_ SG_ 1804 UNK_130_1 "Lane-assignment state, bit 2 (see UNK_128_2).";
CM_ SG_ 1804 UNK_131_4 "Dominant lane weight: the largest of the three lane weights or one less (99.6 % of rows with a nonzero weight).";
CM_ SG_ 1804 CONST_135_1 "Constant in the captured data.";
CM_ SG_ 1804 UNK_136_4 "Camera-association confidence: 15 without association; restarts at 3-9 when UNK_112_3 becomes non-zero and climbs to 14.";
CM_ SG_ 1804 UNK_140_3 "Object class, second encoding of UNK_163_3: 0, 5, 7, 1, 3, 4 = class 1, 2, 3, 4, 5, 6.";
CM_ SG_ 1804 CONST_143_5 "Constant in the captured data.";
CM_ SG_ 1804 UNK_148_8 "Lane weights in 1/15 steps: low nibble (148|4) right lane, high nibble (152|4) left lane. With UNK_156_4 (ego lane) they sum to 15 or 16 whenever any is nonzero.";
CM_ SG_ 1804 UNK_156_4 "Ego-lane weight in 1/15 steps (see UNK_148_8).";
CM_ SG_ 1804 CONST_160_3 "Constant in the captured data.";
CM_ SG_ 1804 UNK_163_3 "Object class: 1 not yet classified, 2 car, 3 large vehicle, 4 pedestrian, 5 provisional (cyclist / person associations), 6 two-wheeler.";
CM_ SG_ 1804 UNK_166_2 "Raw, unnamed.";
CM_ SG_ 1804 UNK_168_10 "All ones or all zeros (768 / 832 rare): five sticky per-track latches by age mod 5; a phase latches on a cycle without a near-scan measurement, so most tracks born far out have it set from birth.";
CM_ SG_ 1804 CONST_178_3 "Constant in the captured data.";
CM_ SG_ 1804 UNK_181_1 "Daylight latch: one of five sticky per-track latches by age mod 5 (a phase latches after an existence dip); set on a quarter of mature vehicle rows by day, 2 of 59,988 night rows.";
CM_ SG_ 1804 UNK_182_1 "Raw, unnamed.";
CM_ SG_ 1804 UNK_183_7 "Bit 183: velocity re-initialisation latch (five sticky per-track latches by age mod 5); bits 184-189 are the low bits of a secondary score byte 184|8 (percent: 100 on 98 % of rows; lower mostly on young tracks, far lateral objects and stationary large vehicles / pedestrians).";
CM_ SG_ 1804 UNK_190_10 "Bits 190-191 = top of the secondary score byte 184|8; bits 192-199 are zero.";
CM_ SG_ 1804 UNK_200_7 "Orientation uncertainty: about 3.1 * UNK_248_7 / speed (m/s) on moving objects; 63 for stopped objects, 127 sentinel. Keep all seven bits.";
CM_ SG_ 1804 CONST_207_1 "Constant in the captured data.";
CM_ SG_ 1804 UNK_208_6 "Coarse heading over ground, left positive, about pi/64 rad per code: matches floor(max(atan2(vy, vx), 0) * 64 / pi) on 98 % of settled moving samples; can update while both velocity codes hold.";
CM_ SG_ 1804 CONST_214_2 "Constant in the captured data.";
CM_ SG_ 1804 UNK_216_6 "Object width, about (code + 1) * 0.1 m: car ~1.8 m, large vehicle ~2.0 m, two-wheeler ~0.7 m, pedestrian ~0.5 m.";
CM_ SG_ 1804 CONST_222_2 "Constant in the captured data.";
CM_ SG_ 1804 UNK_224_7 "Range standard deviation (sigma dRel), about 0.23 m per count (0.24 below 40 m; beyond 40 m a 4-8 m error floor dominates): grows with range, shrinks with track age.";
CM_ SG_ 1804 CONST_231_1 "Constant in the captured data.";
CM_ SG_ 1804 UNK_232_8 "Lateral standard deviation (sigma yRel), about 0.10 m per count: grows with |yRel|, shrinks with age. Eight bits: far young tracks reach 128-255 (255 = saturated).";
CM_ SG_ 1804 UNK_240_7 "Longitudinal velocity standard deviation (sigma vx), about 0.043-0.045 m/s per count against the ACC target: grows with range, higher during velocity excursions below 40 m. 127 accompanies saturated velocity.";
CM_ SG_ 1804 CONST_247_1 "Constant in the captured data.";
CM_ SG_ 1804 UNK_248_7 "Lateral velocity standard deviation (sigma vy), linear in the code: about 0.085 + 0.03 m/s per count against stationary objects, about 0.09 per count on moving leads.";
CM_ SG_ 1804 CONST_255_1 "Constant in the captured data.";
CM_ SG_ 1804 UNK_256_8 "Longitudinal-acceleration uncertainty (sigma ax candidate): grows with the spread between ALONG_LIKE_84 and the track's own speed slope (about 0.06-0.07 m/s^2 per code pooled); within a range band it grades that spread only within about 20 m.";
CM_ SG_ 1804 UNK_264_8 "Lateral-acceleration uncertainty (sigma ay candidate), covariance-like: moves with UNK_248_7 in every range band and shrinks with track age (about 11 at age 5-10, 2 from age 60).";
CM_ SG_ 1804 UNK_272_5 "Coarse length code: about round(length / 0.555 m) for vehicles (within one code on 91 %); not a length for pedestrians / two-wheelers.";
CM_ SG_ 1804 UNK_277_11 "Raw; bit 277 rarely set on newborn tracks.";
VAL_ 1792 ONCOMING_FLAG 0 "clear" 1 "oncoming-like state" ;
VAL_ 1792 MOVE_STATE 0 "moving forward (or left, with bit 111)" 1 "slow / standing (or initializing)" 2 "oncoming" 3 "moving right (or stopped after moving)" ;
VAL_ 1793 ONCOMING_FLAG 0 "clear" 1 "oncoming-like state" ;
VAL_ 1793 MOVE_STATE 0 "moving forward (or left, with bit 111)" 1 "slow / standing (or initializing)" 2 "oncoming" 3 "moving right (or stopped after moving)" ;
VAL_ 1794 ONCOMING_FLAG 0 "clear" 1 "oncoming-like state" ;
VAL_ 1794 MOVE_STATE 0 "moving forward (or left, with bit 111)" 1 "slow / standing (or initializing)" 2 "oncoming" 3 "moving right (or stopped after moving)" ;
VAL_ 1795 ONCOMING_FLAG 0 "clear" 1 "oncoming-like state" ;
VAL_ 1795 MOVE_STATE 0 "moving forward (or left, with bit 111)" 1 "slow / standing (or initializing)" 2 "oncoming" 3 "moving right (or stopped after moving)" ;
VAL_ 1796 ONCOMING_FLAG 0 "clear" 1 "oncoming-like state" ;
VAL_ 1796 MOVE_STATE 0 "moving forward (or left, with bit 111)" 1 "slow / standing (or initializing)" 2 "oncoming" 3 "moving right (or stopped after moving)" ;
VAL_ 1797 ONCOMING_FLAG 0 "clear" 1 "oncoming-like state" ;
VAL_ 1797 MOVE_STATE 0 "moving forward (or left, with bit 111)" 1 "slow / standing (or initializing)" 2 "oncoming" 3 "moving right (or stopped after moving)" ;
VAL_ 1798 ONCOMING_FLAG 0 "clear" 1 "oncoming-like state" ;
VAL_ 1798 MOVE_STATE 0 "moving forward (or left, with bit 111)" 1 "slow / standing (or initializing)" 2 "oncoming" 3 "moving right (or stopped after moving)" ;
VAL_ 1799 ONCOMING_FLAG 0 "clear" 1 "oncoming-like state" ;
VAL_ 1799 MOVE_STATE 0 "moving forward (or left, with bit 111)" 1 "slow / standing (or initializing)" 2 "oncoming" 3 "moving right (or stopped after moving)" ;
VAL_ 1800 ONCOMING_FLAG 0 "clear" 1 "oncoming-like state" ;
VAL_ 1800 MOVE_STATE 0 "moving forward (or left, with bit 111)" 1 "slow / standing (or initializing)" 2 "oncoming" 3 "moving right (or stopped after moving)" ;
VAL_ 1801 ONCOMING_FLAG 0 "clear" 1 "oncoming-like state" ;
VAL_ 1801 MOVE_STATE 0 "moving forward (or left, with bit 111)" 1 "slow / standing (or initializing)" 2 "oncoming" 3 "moving right (or stopped after moving)" ;
VAL_ 1802 ONCOMING_FLAG 0 "clear" 1 "oncoming-like state" ;
VAL_ 1802 MOVE_STATE 0 "moving forward (or left, with bit 111)" 1 "slow / standing (or initializing)" 2 "oncoming" 3 "moving right (or stopped after moving)" ;
VAL_ 1803 ONCOMING_FLAG 0 "clear" 1 "oncoming-like state" ;
VAL_ 1803 MOVE_STATE 0 "moving forward (or left, with bit 111)" 1 "slow / standing (or initializing)" 2 "oncoming" 3 "moving right (or stopped after moving)" ;
VAL_ 1804 ONCOMING_FLAG 0 "clear" 1 "oncoming-like state" ;
VAL_ 1804 MOVE_STATE 0 "moving forward (or left, with bit 111)" 1 "slow / standing (or initializing)" 2 "oncoming" 3 "moving right (or stopped after moving)" ;
